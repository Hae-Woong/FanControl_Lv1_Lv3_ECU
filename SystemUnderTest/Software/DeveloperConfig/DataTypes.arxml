AUTOSAR XML (schema 00050)
standard types defined: boolean, float32
package /VectorAutosarExplorerGeneratedObjects/UNIT
  unit Celsius: display-name=°C, factor-si-to-unit=1, offset-si-to-unit=0  # DegreeCelsius
  unit RPM: display-name=RPM, factor-si-to-unit=1, offset-si-to-unit=0
package /VectorAutosarExplorerGeneratedObjects/BASE_TYPES
  base type Temperature_BaseType: category=FIXED_LENGTH, base-type-size=16, base-type-encoding=2C, native-declaration=uint8
  base type Speed_BaseType: category=FIXED_LENGTH, base-type-size=16, base-type-encoding=NONE, native-declaration=uint16
  base type Boolean_BaseType: category=FIXED_LENGTH, base-type-size=8, base-type-encoding=NONE
package /VectorAutosarExplorerGeneratedObjects/COMPUMETHODS
  compu method Signal_Seat_HeatLevel_Encoding: 0=Off, 1=Minimum (Low), 2=Medium, 3=Maximum (High)
  compu method Signal_HeatPump_Setpoint_Encoding: phys=raw for raw 10..30; unit °C
  compu method Signal_Temperature_Control_Encoding: 1=Enabled (On), 0=Disabled (Off)
  compu method Signal_Fan_Setpoint_Encoding: phys=raw for raw 0..3500; unit RPM
  compu method Signal_DrivingCycle_Encoding: 1=Start Driving Cycle (START), 0=Stop Driving Cycle (STOP)
package /Predefined_DEV/DataConstraints
  range Dem_UdsStatusByteType: raw 0..255
package /Predefined_DEV/CompuMethods
  compu method Dem_UdsStatusByteType: mask 1: 1=DEM_UDS_STATUS_TF, mask 2: 2=DEM_UDS_STATUS_TFTOC, mask 4: 4=DEM_UDS_STATUS_PDTC, mask 8: 8=DEM_UDS_STATUS_CDTC, mask 16: 16=DEM_UDS_STATUS_TNCSLC, mask 32: 32=DEM_UDS_STATUS_TFSLC, mask 64: 64=DEM_UDS_STATUS_TNCTOC, mask 128: 128=DEM_UDS_STATUS_WIR
package /Predefined_DEV/ImplementationDataTypes
  impl type NvM_RequestResultType: compu {0=NVM_REQ_OK, 1=NVM_REQ_NOT_OK, 2=NVM_REQ_PENDING, 3=NVM_REQ_INTEGRITY_FAILED, 4=NVM_REQ_BLOCK_SKIPPED, 5=NVM_REQ_NV_INVALIDATED, 6=NVM_REQ_CANCELED, 7=NVM_REQ_REDUNDANCY_FAILED, 8=NVM_REQ_RESTORED_FROM_ROM}, implementation-data-type=uint8
  impl type NvM_ServiceIdType: compu {6=NVM_READ_BLOCK, 7=NVM_WRITE_BLOCK, 8=NVM_RESTORE_BLOCK_DEFAULTS, 9=NVM_ERASE_BLOCK, 11=NVM_INVALIDATE_NV_BLOCK, 12=NVM_READ_ALL}, implementation-data-type=uint8
package /DataTypes
  5 x impl type:
    IdtPwmValueType: range raw 0..32768, implementation-data-type=uint16, type-emitter=RTE
    IdtAdcResult: range raw >0..INF, implementation-data-type=float64, type-emitter=RTE
    Idt_Signal_Fan_Fault: category=VALUE, base-type=Temperature_BaseType, compu {1=Faulty, 0=NormalOperation}
    Idt_Signal_Fan_Setpoint: category=VALUE, base-type=Speed_BaseType, range raw 0..3500
    Idt_Speed_PWM_Struct: category=STRUCTURE, sw-calibration-access=READ-ONLY, type-emitter=RTE
      element Speed: range raw 0..3500, implementation-data-type=Idt_Signal_Fan_Setpoint
      element Pwm: range raw 0..32768, implementation-data-type=IdtPwmValueType
      element RequestedSpeed: range raw 0..3500, implementation-data-type=Idt_Signal_Fan_Setpoint
