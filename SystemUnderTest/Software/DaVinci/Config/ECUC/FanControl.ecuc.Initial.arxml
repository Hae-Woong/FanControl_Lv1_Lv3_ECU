AUTOSAR XML (schema 00050)
package /InitialEcuC
  ecuc value collection InitialEcuC: ecuc-values=[Can, CanIf, CanSM, Com, ComM, Dcm, Dem, EcuC, EcuM, PduR]
  module config Can
    CanConfigSet
      Controller_Fan_ECU_02f7c8db915351a9_92c03ed2 (CanController):  # Comfort
        CanBusName = Comfort
        CanControllerActivation = true
        CanControllerDefaultBaudrate = CanControllerBaudrateConfig
        CanControllerSystemRef = Controller_Fan_ECU_02f7c8db915351a9
        CanWakeupSourceRef = EcuMCommonConfiguration/Connector_Fan_ECU_fbc5880ce1a0cdea_90249745
        CanControllerBaudrateConfig: CanControllerBaudRate=500
      Connector_Fan_ECU_fbc5880ce1a0cdea_6fd0fec7_Rx (CanHardwareObject):
        CanHandleType = BASIC
        CanIdType = STANDARD
        CanIdValue = 0
        CanObjectType = RECEIVE
        CanControllerRef = CanConfigSet/Controller_Fan_ECU_02f7c8db915351a9_92c03ed2
      Connector_Fan_ECU_fbc5880ce1a0cdea_90249745_Tx (CanHardwareObject): CanHandleType=BASIC, CanIdValue=0, CanObjectType=TRANSMIT, CanControllerRef=CanConfigSet/Controller_Fan_ECU_02f7c8db915351a9_92c03ed2
    CanGeneral: CanIndex=0
  module config CanIf
    CanIfCtrlDrvCfg_7d254554 (CanIfCtrlDrvCfg): CanIfCtrlDrvInitHohConfigRef=CanIfInitHohCfg, CanIfCtrlDrvNameRef=CanGeneral
      Controller_Fan_ECU_02f7c8db915351a9_92c03ed2 (CanIfCtrlCfg): CanIfCtrlCanCtrlRef=CanConfigSet/Controller_Fan_ECU_02f7c8db915351a9_92c03ed2
    CanIfInitCfg
      CANChannel_213aa5c2 (CanIfBufferCfg): CanIfBufferSize=0, CanIfBufferHthRef=CanIfInitHohCfg/Connector_Fan_ECU_fbc5880ce1a0cdea_90249745_Tx
      CanIfInitHohCfg: CanIfInitRefCfgSet=CanConfigSet
        Connector_Fan_ECU_fbc5880ce1a0cdea_6fd0fec7_Rx (CanIfHrhCfg):
          CanIfHrhCanCtrlIdRef = CanIfCtrlDrvCfg_7d254554/Controller_Fan_ECU_02f7c8db915351a9_92c03ed2
          CanIfHrhIdSymRef = CanConfigSet/Connector_Fan_ECU_fbc5880ce1a0cdea_6fd0fec7_Rx
        Connector_Fan_ECU_fbc5880ce1a0cdea_90249745_Tx (CanIfHthCfg):
          CanIfHthCanCtrlIdRef = CanIfCtrlDrvCfg_7d254554/Controller_Fan_ECU_02f7c8db915351a9_92c03ed2
          CanIfHthIdSymRef = CanConfigSet/Connector_Fan_ECU_fbc5880ce1a0cdea_90249745_Tx
      4 x CanIfRxPduCfg, all with CanIfRxPduCanIdType=STANDARD_CAN, CanIfRxPduDlc=8, CanIfRxPduHrhIdRef=CanIfInitHohCfg/Connector_Fan_ECU_fbc5880ce1a0cdea_6fd0fec7_Rx:
        Comfort_DrivingCycle_Frame_PDU_1e43a3a1_Rx: CanIfRxPduCanId=9, CanIfRxPduUserRxIndicationName=PduR_CanIfRxIndication, CanIfRxPduUserRxIndicationUL=PDUR, CanIfRxPduRef=EcucPduCollection/Comfort_DrivingCycle_Frame_PDU_e1cdd903_Rx
        Comfort_Fan_NM_PDU_Rx_dd66e2e4_Rx: CanIfRxPduCanId=7, CanIfRxPduUserRxIndicationName=CanNm_RxIndication, CanIfRxPduUserRxIndicationUL=CAN_NM, CanIfRxPduRef=Comfort_Fan_NM_PDU_Rx_68476f29_Rx
        Comfort_HeadUnit_Frame_PDU_1743229a_Rx: CanIfRxPduCanId=10, CanIfRxPduUserRxIndicationName=PduR_CanIfRxIndication, CanIfRxPduUserRxIndicationUL=PDUR, CanIfRxPduRef=EcucPduCollection/Comfort_HeadUnit_Frame_PDU_80f4a911_Rx
        Comfort_TP_Diag_Request_Fan_ECU_Frame_PDU_91c512e3_Rx: CanIfRxPduCanId=1, CanIfRxPduUserRxIndicationUL=CDD, CanIfRxPduRef=Comfort_TP_Diag_Request_Fan_ECU_Frame_PDU_c4e708c3_Rx
      3 x CanIfTxPduCfg, all with CanIfTxPduCanIdType=STANDARD_CAN, CanIfTxPduDlc=8, CanIfTxPduBufferRef=CanIfInitCfg/CANChannel_213aa5c2:
        Comfort_Fan_Frame_PDU_ced33595_Tx: CanIfTxPduCanId=2, CanIfTxPduUserTxConfirmationName=PduR_CanIfTxConfirmation, CanIfTxPduUserTxConfirmationUL=PDUR, CanIfTxPduRef=EcucPduCollection/Comfort_Fan_Frame_PDU_b6a0c8d2_Tx
        Comfort_Fan_NM_PDU_Tx_3ac30fc9_Tx: CanIfTxPduCanId=6, CanIfTxPduUserTxConfirmationName=CanNm_TxConfirmation, CanIfTxPduUserTxConfirmationUL=CAN_NM, CanIfTxPduRef=Comfort_Fan_NM_PDU_Tx_3bb98271_Tx
        Comfort_TP_Diag_Response_Fan_ECU_Frame_PDU_550d529c_Tx: CanIfTxPduCanId=8, CanIfTxPduUserTxConfirmationUL=CDD, CanIfTxPduRef=Comfort_TP_Diag_Response_Fan_ECU_Frame_PDU_44cf1fc1_Tx
    CanIfPrivateCfg: CanIfPrivateSoftwareFilterType=LINEAR
    CanIfPublicCfg: CanIfPublicPnSupport=false
  module config CanSM
    CanSMConfiguration
      CANChannel_213aa5c2 (CanSMManagerNetwork): CanSMComMNetworkHandleRef=ComMConfigSet/Connector_Fan_ECU_fbc5880ce1a0cdea_90249745
        Controller_Fan_ECU_02f7c8db915351a9_f6205173 (CanSMController): CanSMControllerId=CanIfCtrlDrvCfg_7d254554/Controller_Fan_ECU_02f7c8db915351a9_92c03ed2
  module config Com
    ComConfig
      3 x ComIPdu, all with ComIPduType=NORMAL:
        Comfort_DrivingCycle_Frame_PDU_b08df3c0_Rx: ComIPduDirection=RECEIVE, ComIPduSignalRef=Signal_DrivingCycle_e990e847_Rx, ComPduIdRef=EcucPduCollection/Comfort_DrivingCycle_Frame_PDU_b08df3c0_Rx
        Comfort_Fan_Frame_PDU_68b7e774_Tx: ComIPduDirection=SEND, ComIPduSignalRef=Signal_Fan_Fault_da741978_Tx, ComPduIdRef=EcucPduCollection/Comfort_Fan_Frame_PDU_68b7e774_Tx
          ComTxIPdu
            ComTxModeTrue
              ComTxMode: ComTxModeMode=PERIODIC, ComTxModeTimePeriod=1
        Comfort_HeadUnit_Frame_PDU_6df1e8d4_Rx: ComIPduDirection=RECEIVE, ComIPduSignalRef=Signal_Fan_Speed_4a82392d_Rx, ComPduIdRef=EcucPduCollection/Comfort_HeadUnit_Frame_PDU_6df1e8d4_Rx
      3 x ComSignal, all with ComSignalEndianness=LITTLE_ENDIAN:
        Signal_DrivingCycle_e990e847_Rx: ComBitPosition=0, ComBitSize=8, ComSignalType=UINT8, ComSystemTemplateSystemSignalRef=SignalPduMapping_8352acddb81fe614
        Signal_Fan_Fault_da741978_Tx: ComBitPosition=0, ComBitSize=8, ComSignalType=UINT8, ComTransferProperty=TRIGGERED_ON_CHANGE, ComSystemTemplateSystemSignalRef=SignalPduMapping_712c3b5c8821b4c2
        Signal_Fan_Speed_4a82392d_Rx: ComBitPosition=8, ComBitSize=16, ComSignalType=UINT16, ComSystemTemplateSystemSignalRef=SignalPduMapping_eb5b8f262b3bf3e6
    ComGeneral
  module config ComM
    ComMConfigSet: ComMPncEnabled=false
      Connector_Fan_ECU_fbc5880ce1a0cdea_90249745 (ComMChannel): ComMBusType=COMM_BUS_TYPE_CAN, ComMChannelId=0
        ComMNetworkManagement: ComMNmVariant=NONE
        Connector_Fan_ECU_fbc5880ce1a0cdea_d2ce69be (ComMUserPerChannel): ComMUserChannel=Connector_Fan_ECU_fbc5880ce1a0cdea_1e36b570
      Connector_Fan_ECU_fbc5880ce1a0cdea_1e36b570 (ComMUser)
    ComMGeneral: ComMPncIdCounting=COMM_PNC_ID_COUNT_FROM_NM_MESSAGE, ComMPncSupport=false
  module config Dcm
    DcmConfigSet  # Diagnostics Data Import
      DcmDsp: DcmDspMaxDidToRead=5  # Diagnostics Data Import
        ComControl (DcmDspComControl)  # Diagnostics Data Import
          DspComContolAllChannel (DcmDspComControlAllChannel)  # Diagnostics Data Import
        DcmDspSession  # Diagnostics Data Import
          3 x DcmDspSessionRow, all with DcmDspSessionP2ServerMax=0.05, DcmDspSessionP2StarServerMax=5, DcmDspSessionForBoot=DCM_NO_BOOT:
            Extended: DcmDspSessionLevel=3  # Diagnostics Data Import
            Programming: DcmDspSessionLevel=2  # Diagnostics Data Import
            Default: DcmDspSessionLevel=1  # Diagnostics Data Import
        DcmDspAuthentication: DcmDspAuthenticationRoleSize=1, DcmDspAuthenticationDeauthenticatedRoleRef=Anybody  # Diagnostics Data Import
          6 x DcmDspAuthenticationRow:
            ePTI: DcmDspAuthenticationRoleBitPosition=5  # Diagnostics Data Import
            AfterSales: DcmDspAuthenticationRoleBitPosition=4  # Diagnostics Data Import
            Manufacturing: DcmDspAuthenticationRoleBitPosition=3  # Diagnostics Data Import
            Development: DcmDspAuthenticationRoleBitPosition=2  # Diagnostics Data Import
            Supplier: DcmDspAuthenticationRoleBitPosition=1  # Diagnostics Data Import
            Anybody: DcmDspAuthenticationRoleBitPosition=0  # Diagnostics Data Import
        DcmDspSecurity  # Diagnostics Data Import
          UnlockedL1 (DcmDspSecurityRow):  # Diagnostics Data Import
            DcmDspSecurityDelayTime = 10
            DcmDspSecurityDelayTimeOnBoot = 0
            DcmDspSecurityKeySize = 4
            DcmDspSecurityLevel = 1
            DcmDspSecurityNumAttDelay = 3
            DcmDspSecuritySeedSize = 4
        RoutineInfo_Example_New_Routine_Control (DcmDspRoutineInfo)  # Diagnostics Data Import
          DcmDspRoutineAuthorization: DcmDspRoutineSessionRef=DcmDspSession/Programming, DcmDspRoutineSessionRef=DcmDspSession/Extended  # Diagnostics Data Import
        Example_New_Routine_Control (DcmDspRoutine):  # Diagnostics Data Import
          DcmDspRequestResultsRoutineSupported = false
          DcmDspStopRoutineSupported = false
          DcmDspRoutineIdentifier = 256
          DcmDspRoutineInfoRef = RoutineInfo_Example_New_Routine_Control
        8 x DcmDspDidInfo:
          DidInfo_Hardware_Version  # Diagnostics Data Import
            DcmDspDidAccess  # Diagnostics Data Import
              DcmDspDidWrite  # Diagnostics Data Import
              DcmDspDidRead  # Diagnostics Data Import
          DidInfo_Vehicle_Identification  # Diagnostics Data Import
            DcmDspDidAccess  # Diagnostics Data Import
              DcmDspDidWrite  # Diagnostics Data Import
              DcmDspDidRead  # Diagnostics Data Import
          DidInfo_SerialNumber  # Diagnostics Data Import
            DcmDspDidAccess  # Diagnostics Data Import
              DcmDspDidWrite  # Diagnostics Data Import
              DcmDspDidRead  # Diagnostics Data Import
          DidInfo_EcuIdentification  # Diagnostics Data Import
            DcmDspDidAccess  # Diagnostics Data Import
              DcmDspDidWrite  # Diagnostics Data Import
              DcmDspDidRead  # Diagnostics Data Import
          DidInfo_Spare_Part_Number  # Diagnostics Data Import
            DcmDspDidAccess  # Diagnostics Data Import
              DcmDspDidWrite  # Diagnostics Data Import
              DcmDspDidRead  # Diagnostics Data Import
          DidInfo_Boot_Software  # Diagnostics Data Import
            DcmDspDidAccess  # Diagnostics Data Import
              DcmDspDidWrite  # Diagnostics Data Import
              DcmDspDidRead  # Diagnostics Data Import
          DidInfo_Example_DevelopmentData  # Diagnostics Data Import
            DcmDspDidAccess  # Diagnostics Data Import
              DcmDspDidWrite  # Diagnostics Data Import
              DcmDspDidRead  # Diagnostics Data Import
          DidInfo_Fan_Current_Power  # Diagnostics Data Import
            DcmDspDidAccess  # Diagnostics Data Import
              DcmDspDidRead  # Diagnostics Data Import
        8 x DcmDspDid:
          Hardware_Version: DcmDspDidIdentifier=61843, DcmDspDidInfoRef=DidInfo_Hardware_Version  # Diagnostics Data Import
            Hardware_Version_Number (DcmDspDidSignal): DcmDspDidDataPos=0, DcmDspDidDataRef=Hardware_Version_Hardware_Version_Number  # Diagnostics Data Import
          Vehicle_Identification: DcmDspDidIdentifier=61840, DcmDspDidInfoRef=DidInfo_Vehicle_Identification  # Diagnostics Data Import
            VIN (DcmDspDidSignal): DcmDspDidDataPos=0, DcmDspDidDataRef=Vehicle_Identification_VIN  # Diagnostics Data Import
          SerialNumber: DcmDspDidIdentifier=61836, DcmDspDidInfoRef=DidInfo_SerialNumber  # Diagnostics Data Import
            SerialNumber (DcmDspDidSignal): DcmDspDidDataPos=0, DcmDspDidDataRef=SerialNumber_SerialNumber  # Diagnostics Data Import
          EcuIdentification: DcmDspDidIdentifier=61833, DcmDspDidInfoRef=DidInfo_EcuIdentification  # Diagnostics Data Import
            Part_Number (DcmDspDidSignal): DcmDspDidDataPos=0, DcmDspDidDataRef=EcuIdentification_Part_Number  # Diagnostics Data Import
          Spare_Part_Number: DcmDspDidIdentifier=61831, DcmDspDidInfoRef=DidInfo_Spare_Part_Number  # Diagnostics Data Import
            Spare_Part_Number (DcmDspDidSignal): DcmDspDidDataPos=0, DcmDspDidDataRef=Spare_Part_Number_Spare_Part_Number  # Diagnostics Data Import
          Boot_Software: DcmDspDidIdentifier=61824, DcmDspDidInfoRef=DidInfo_Boot_Software  # Diagnostics Data Import
            Boot_Software_Identification (DcmDspDidSignal): DcmDspDidDataPos=8, DcmDspDidDataRef=Boot_Software_Boot_Software_Identification  # Diagnostics Data Import
            NumberOfModules (DcmDspDidSignal): DcmDspDidDataPos=0, DcmDspDidDataRef=Boot_Software_NumberOfModules  # Diagnostics Data Import
          Example_DevelopmentData: DcmDspDidIdentifier=256, DcmDspDidInfoRef=DidInfo_Example_DevelopmentData  # Diagnostics Data Import
            5 x DcmDspDidSignal:
              TransportLayerVersion: DcmDspDidDataPos=64, DcmDspDidDataRef=Example_DevelopmentData_TransportLayerVersion  # Diagnostics Data Import
              DiagnosticModuleVersion: DcmDspDidDataPos=48, DcmDspDidDataRef=Example_DevelopmentData_DiagnosticModuleVersion  # Diagnostics Data Import
              NmVersion: DcmDspDidDataPos=32, DcmDspDidDataRef=Example_DevelopmentData_NmVersion  # Diagnostics Data Import
              CanDriverVersion: DcmDspDidDataPos=16, DcmDspDidDataRef=Example_DevelopmentData_CanDriverVersion  # Diagnostics Data Import
              OperatingSystemVersion: DcmDspDidDataPos=0, DcmDspDidDataRef=Example_DevelopmentData_OperatingSystemVersion  # Diagnostics Data Import
          Fan_Current_Power: DcmDspDidIdentifier=2, DcmDspDidInfoRef=DidInfo_Fan_Current_Power  # Diagnostics Data Import
            Current (DcmDspDidSignal): DcmDspDidDataPos=0, DcmDspDidDataRef=Fan_Current_Power_Current  # Diagnostics Data Import
        DataInfo_Hardware_Version_Hardware_Version_Number (DcmDspDataInfo): DcmDspDataFixedLength=true  # Diagnostics Data Import
        Hardware_Version_Hardware_Version_Number (DcmDspData): DcmDspDataSize=32, DcmDspDataType=UINT32, DcmDspDataInfoRef=DataInfo_Hardware_Version_Hardware_Version_Number  # Diagnostics Data Import
        DataInfo_Vehicle_Identification_VIN (DcmDspDataInfo): DcmDspDataFixedLength=true  # Diagnostics Data Import
        Vehicle_Identification_VIN (DcmDspData): DcmDspDataSize=136, DcmDspDataType=UINT8_N, DcmDspDataInfoRef=DataInfo_Vehicle_Identification_VIN  # Diagnostics Data Import
        DataInfo_SerialNumber_SerialNumber (DcmDspDataInfo): DcmDspDataFixedLength=true  # Diagnostics Data Import
        SerialNumber_SerialNumber (DcmDspData): DcmDspDataSize=32, DcmDspDataType=UINT32, DcmDspDataInfoRef=DataInfo_SerialNumber_SerialNumber  # Diagnostics Data Import
        DataInfo_EcuIdentification_Part_Number (DcmDspDataInfo): DcmDspDataFixedLength=true  # Diagnostics Data Import
        EcuIdentification_Part_Number (DcmDspData): DcmDspDataSize=104, DcmDspDataType=UINT8_N, DcmDspDataInfoRef=DataInfo_EcuIdentification_Part_Number  # Diagnostics Data Import
        DataInfo_Spare_Part_Number_Spare_Part_Number (DcmDspDataInfo): DcmDspDataFixedLength=true  # Diagnostics Data Import
        Spare_Part_Number_Spare_Part_Number (DcmDspData): DcmDspDataSize=32, DcmDspDataType=UINT32, DcmDspDataInfoRef=DataInfo_Spare_Part_Number_Spare_Part_Number  # Diagnostics Data Import
        DataInfo_Boot_Software_Boot_Software_Identification (DcmDspDataInfo): DcmDspDataFixedLength=true  # Diagnostics Data Import
        Boot_Software_Boot_Software_Identification (DcmDspData): DcmDspDataSize=32, DcmDspDataType=UINT32, DcmDspDataInfoRef=DataInfo_Boot_Software_Boot_Software_Identification  # Diagnostics Data Import
        DataInfo_Boot_Software_NumberOfModules (DcmDspDataInfo): DcmDspDataFixedLength=true  # Diagnostics Data Import
        Boot_Software_NumberOfModules (DcmDspData): DcmDspDataSize=8, DcmDspDataType=UINT8, DcmDspDataInfoRef=DataInfo_Boot_Software_NumberOfModules  # Diagnostics Data Import
        DataInfo_Example_DevelopmentData_TransportLayerVersion (DcmDspDataInfo): DcmDspDataFixedLength=true  # Diagnostics Data Import
        Example_DevelopmentData_TransportLayerVersion (DcmDspData): DcmDspDataSize=16, DcmDspDataType=UINT16, DcmDspDataInfoRef=DataInfo_Example_DevelopmentData_TransportLayerVersion  # Diagnostics Data Import
        DataInfo_Example_DevelopmentData_DiagnosticModuleVersion (DcmDspDataInfo): DcmDspDataFixedLength=true  # Diagnostics Data Import
        Example_DevelopmentData_DiagnosticModuleVersion (DcmDspData): DcmDspDataSize=16, DcmDspDataType=UINT16, DcmDspDataInfoRef=DataInfo_Example_DevelopmentData_DiagnosticModuleVersion  # Diagnostics Data Import
        DataInfo_Example_DevelopmentData_NmVersion (DcmDspDataInfo): DcmDspDataFixedLength=true  # Diagnostics Data Import
        Example_DevelopmentData_NmVersion (DcmDspData): DcmDspDataSize=16, DcmDspDataType=UINT16, DcmDspDataInfoRef=DataInfo_Example_DevelopmentData_NmVersion  # Diagnostics Data Import
        DataInfo_Example_DevelopmentData_CanDriverVersion (DcmDspDataInfo): DcmDspDataFixedLength=true  # Diagnostics Data Import
        Example_DevelopmentData_CanDriverVersion (DcmDspData): DcmDspDataSize=16, DcmDspDataType=UINT16, DcmDspDataInfoRef=DataInfo_Example_DevelopmentData_CanDriverVersion  # Diagnostics Data Import
        DataInfo_Example_DevelopmentData_OperatingSystemVersion (DcmDspDataInfo): DcmDspDataFixedLength=true  # Diagnostics Data Import
        Example_DevelopmentData_OperatingSystemVersion (DcmDspData): DcmDspDataSize=16, DcmDspDataType=UINT16, DcmDspDataInfoRef=DataInfo_Example_DevelopmentData_OperatingSystemVersion  # Diagnostics Data Import
        DataInfo_Fan_Current_Power_Current (DcmDspDataInfo): DcmDspDataFixedLength=true  # Diagnostics Data Import
        Fan_Current_Power_Current (DcmDspData): DcmDspDataSize=8, DcmDspDataType=UINT8, DcmDspDataInfoRef=DataInfo_Fan_Current_Power_Current  # Diagnostics Data Import
      DcmDsd  # Diagnostics Data Import
        DcmDsdServiceTable  # Diagnostics Data Import
          13 x DcmDsdService:
            ControlDtcSetting: DcmDsdSidTabServiceId=133, DcmDsdSidTabSubfuncAvail=true  # Diagnostics Data Import
              Disable (DcmDsdSubService): DcmDsdSubServiceId=2  # Diagnostics Data Import
              Enable (DcmDsdSubService): DcmDsdSubServiceId=1  # Diagnostics Data Import
            TesterPresent: DcmDsdSidTabServiceId=62, DcmDsdSidTabSubfuncAvail=true  # Diagnostics Data Import
              TesterPresent (DcmDsdSubService): DcmDsdSubServiceId=0  # Diagnostics Data Import
            WriteMemoryByAddress: DcmDsdSidTabServiceId=61, DcmDsdSidTabSubfuncAvail=false  # Diagnostics Data Import
            RoutineControl: DcmDsdSidTabServiceId=49, DcmDsdSidTabSubfuncAvail=true, DcmDsdSidTabSessionLevelRef=DcmDspSession/Programming, DcmDsdSidTabSessionLevelRef=DcmDspSession/Extended  # Diagnostics Data Import
            WriteDataById: DcmDsdSidTabServiceId=46, DcmDsdSidTabSubfuncAvail=false  # Diagnostics Data Import
            CommunicationControl: DcmDsdSidTabServiceId=40, DcmDsdSidTabSubfuncAvail=true, DcmDsdSidTabSessionLevelRef=DcmDspSession/Programming, DcmDsdSidTabSessionLevelRef=DcmDspSession/Extended  # Diagnostics Data Import
              4 x DcmDsdSubService, all with DcmDsdSubServiceSessionLevelRef=DcmDspSession/Programming, DcmDsdSubServiceSessionLevelRef=DcmDspSession/Extended:
                DisableRxAndTx: DcmDsdSubServiceId=3  # Diagnostics Data Import
                DisableRxAndEnableTx: DcmDsdSubServiceId=2  # Diagnostics Data Import
                EnableRxAndDisableTx: DcmDsdSubServiceId=1  # Diagnostics Data Import
                EnableRxAndTx: DcmDsdSubServiceId=0  # Diagnostics Data Import
            SecurityAccess: DcmDsdSidTabServiceId=39, DcmDsdSidTabSubfuncAvail=true, DcmDsdSidTabSessionLevelRef=DcmDspSession/Programming, DcmDsdSidTabSessionLevelRef=DcmDspSession/Extended  # Diagnostics Data Import
              KeyLevel1_Send (DcmDsdSubService): DcmDsdSubServiceId=2, DcmDsdSubServiceSessionLevelRef=DcmDspSession/Programming, DcmDsdSubServiceSessionLevelRef=DcmDspSession/Extended  # Diagnostics Data Import
              SeedLevel1_Request (DcmDsdSubService): DcmDsdSubServiceId=1, DcmDsdSubServiceSessionLevelRef=DcmDspSession/Programming, DcmDsdSubServiceSessionLevelRef=DcmDspSession/Extended  # Diagnostics Data Import
            ReadMemoryByAddress: DcmDsdSidTabServiceId=35, DcmDsdSidTabSubfuncAvail=false  # Diagnostics Data Import
            ReadDataById: DcmDsdSidTabServiceId=34, DcmDsdSidTabSubfuncAvail=false  # Diagnostics Data Import
            ReadDtcInfo: DcmDsdSidTabServiceId=25, DcmDsdSidTabSubfuncAvail=true  # Diagnostics Data Import
              14 x DcmDsdSubService:
                RDTCFDC: DcmDsdSubServiceId=20  # Diagnostics Data Import
                RMRCDTC: DcmDsdSubServiceId=14  # Diagnostics Data Import
                RMRTFDTC: DcmDsdSubServiceId=13  # Diagnostics Data Import
                RFCDTC: DcmDsdSubServiceId=12  # Diagnostics Data Import
                RFTFDTC: DcmDsdSubServiceId=11  # Diagnostics Data Import
                RSUPDTC: DcmDsdSubServiceId=10  # Diagnostics Data Import
                RSIODTC: DcmDsdSubServiceId=9  # Diagnostics Data Import
                RDTCBSMR: DcmDsdSubServiceId=8  # Diagnostics Data Import
                RNODTCBSMR: DcmDsdSubServiceId=7  # Diagnostics Data Import
                RDTCEDRBDN: DcmDsdSubServiceId=6  # Diagnostics Data Import
                RDTCSSBDTC: DcmDsdSubServiceId=4  # Diagnostics Data Import
                RDTCSSI: DcmDsdSubServiceId=3  # Diagnostics Data Import
                RDTCBSM: DcmDsdSubServiceId=2  # Diagnostics Data Import
                RNODTCBSM: DcmDsdSubServiceId=1  # Diagnostics Data Import
            ClearDiagInfo: DcmDsdSidTabServiceId=20, DcmDsdSidTabSubfuncAvail=false  # Diagnostics Data Import
            EcuReset: DcmDsdSidTabServiceId=17, DcmDsdSidTabSubfuncAvail=true  # Diagnostics Data Import
              Soft (DcmDsdSubService): DcmDsdSubServiceId=3  # Diagnostics Data Import
              Hard (DcmDsdSubService): DcmDsdSubServiceId=1  # Diagnostics Data Import
            DiagSessionControl: DcmDsdSidTabServiceId=16, DcmDsdSidTabSubfuncAvail=true  # Diagnostics Data Import
              3 x DcmDsdSubService:
                Extended: DcmDsdSubServiceId=3  # Diagnostics Data Import
                Programming: DcmDsdSubServiceId=2  # Diagnostics Data Import
                Default: DcmDsdSubServiceId=1  # Diagnostics Data Import
      DcmGeneral: DcmResetToFblAfterSessionFinalResponseEnabled=false  # Diagnostics Data Import
  module config Dem
    DemGeneral:  # Diagnostics Data Import
      DemAgingCycleCounterProcessing = DEM_PROCESS_AGINGCTR_INTERN
      DemDebounceCounterBasedSupport = true
      DemDebounceTimeBasedSupport = true
      DemPTOSupport = false
      DemDtcStatusAvailabilityMask = 255
      DemGeneralOBD  # Diagnostics Data Import
      3 x DemDataClass, all with DemDataElementDataSize=1:
        DTCAgingCounter_Driving_Cycles_Since_Last_Failed: DemDataElementInternalData=DEM_CYCLES_SINCE_LAST_FAILED, DemDataElementUsePort=USE_DATA_INTERNAL  # Diagnostics Data Import
        OccurrenceCounter_OccurrenceCounter: DemDataElementInternalData=DEM_OCCCTR, DemDataElementUsePort=USE_DATA_INTERNAL  # Diagnostics Data Import
        DID_0x2_Current: DemDataElementDataType=UINT8, DemDataElementUsePort=USE_DATA_CLIENT_SERVER_PORT, DemDataElementStoreNonVolatile=true  # Diagnostics Data Import
      OBD_driving_cycle (DemOperationCycle): DemOperationCycleAutostart=true, DemOperationCycleType=DEM_OPCYC_OBD_DCY  # Diagnostics Data Import
      FreezeFrameRecNumClass_f98c8aa7 (DemFreezeFrameRecNumClass): DemFreezeFrameRecordClassRef=First_Occurrence, DemFreezeFrameRecordClassRef=Last_Occurrence  # Diagnostics Data Import
      Last_Occurrence (DemFreezeFrameRecordClass): DemFreezeFrameRecordNumber=2, DemFreezeFrameRecordTrigger=DEM_TRIGGER_ON_TEST_FAILED, DemFreezeFrameRecordUpdate=DEM_UPDATE_RECORD_NO  # Diagnostics Data Import
      First_Occurrence (DemFreezeFrameRecordClass): DemFreezeFrameRecordNumber=1, DemFreezeFrameRecordTrigger=DEM_TRIGGER_ON_TEST_FAILED, DemFreezeFrameRecordUpdate=DEM_UPDATE_RECORD_NO  # Diagnostics Data Import
      FreezeFrameClass_e46843e0 (DemFreezeFrameClass): DemDidClassRef=DemGeneral/Fan_Current_Power  # Diagnostics Data Import
      DTCAgingCounter (DemExtendedDataRecordClass):  # Diagnostics Data Import
        DemExtendedDataRecordNumber = 2
        DemExtendedDataRecordUpdate = DEM_UPDATE_RECORD_NO
        DemDataClassRef = DTCAgingCounter_Driving_Cycles_Since_Last_Failed
      OccurrenceCounter (DemExtendedDataRecordClass): DemExtendedDataRecordNumber=1, DemExtendedDataRecordUpdate=DEM_UPDATE_RECORD_NO, DemDataClassRef=OccurrenceCounter_OccurrenceCounter  # Diagnostics Data Import
      ExtendedDataClass_4f5344cd (DemExtendedDataClass): DemExtendedDataRecordClassRef=OccurrenceCounter, DemExtendedDataRecordClassRef=DTCAgingCounter  # Diagnostics Data Import
      Fan_Current_Power (DemDidClass): DemDidIdentifier=2, DemDidDataClassRef=DID_0x2_Current  # Diagnostics Data Import
      DemEventMemorySet  # Diagnostics Data Import
        PrimaryMemory (DemPrimaryMemory): DemTypeOfFreezeFrameRecordNumeration=DEM_FF_RECNUM_CONFIGURED  # Diagnostics Data Import
    DemConfigSet  # Diagnostics Data Import
      Mechanical_Fault_Unexpected_High_Current (DemEventParameter):  # Diagnostics Data Import
        DemEventKind = DEM_EVENT_KIND_SWC
        DemEventLatchTestFailed = true
        DemDTCClassRef = DTCClass_DTC_0x000017
        DemExtendedDataClassRef = ExtendedDataClass_4f5344cd
        DemFreezeFrameClassRef = FreezeFrameClass_e46843e0
        DemFreezeFrameRecNumClassRef = FreezeFrameRecNumClass_f98c8aa7
        DemEventClass:  # Diagnostics Data Import
          DemAgingAllowed = true
          DemAgingCycleCounterThreshold = 3
          DemEventPriority = 2
          DemEventSignificance = DEM_EVENT_SIGNIFICANCE_FAULT
          DemEventFailureCycleCounterThreshold = 3
          DemFFPrestorageSupported = false
          DemAgingCycleRef = OBD_driving_cycle
          DemOperationCycleRef = OBD_driving_cycle
          DemDebounceAlgorithmClass  # Diagnostics Data Import
            DemDebounceMonitorInternal  # Diagnostics Data Import
              DemCallbackGetFDC  # Diagnostics Data Import
      DTCClass_DTC_0x000017 (DemDTCClass): DemDTCSeverity=DEM_DTC_SEV_NO_SEVERITY, DemUdsDTC=25, DemDTCAttributesRef=DtcAttributes_41914fb7  # Diagnostics Data Import
      Mechanical_Fault_Unexpected_Low_Current (DemEventParameter):  # Diagnostics Data Import
        DemEventKind = DEM_EVENT_KIND_SWC
        DemEventLatchTestFailed = true
        DemDTCClassRef = DTCClass_DTC_0x000016
        DemExtendedDataClassRef = ExtendedDataClass_4f5344cd
        DemFreezeFrameClassRef = FreezeFrameClass_e46843e0
        DemFreezeFrameRecNumClassRef = FreezeFrameRecNumClass_f98c8aa7
        DemEventClass:  # Diagnostics Data Import
          DemAgingAllowed = true
          DemAgingCycleCounterThreshold = 3
          DemEventPriority = 2
          DemEventSignificance = DEM_EVENT_SIGNIFICANCE_FAULT
          DemEventFailureCycleCounterThreshold = 3
          DemFFPrestorageSupported = false
          DemAgingCycleRef = OBD_driving_cycle
          DemOperationCycleRef = OBD_driving_cycle
          DemDebounceAlgorithmClass  # Diagnostics Data Import
            DemDebounceMonitorInternal  # Diagnostics Data Import
              DemCallbackGetFDC  # Diagnostics Data Import
      DTCClass_DTC_0x000016 (DemDTCClass): DemDTCSeverity=DEM_DTC_SEV_NO_SEVERITY, DemUdsDTC=24, DemDTCAttributesRef=DtcAttributes_41914fb7  # Diagnostics Data Import
      Electrical_Fault_Fan_Motor_Control_Circuit_Open (DemEventParameter):  # Diagnostics Data Import
        DemEventKind = DEM_EVENT_KIND_SWC
        DemEventLatchTestFailed = true
        DemDTCClassRef = DTCClass_DTC_0x000013
        DemExtendedDataClassRef = ExtendedDataClass_4f5344cd
        DemFreezeFrameClassRef = FreezeFrameClass_e46843e0
        DemFreezeFrameRecNumClassRef = FreezeFrameRecNumClass_f98c8aa7
        DemEventClass:  # Diagnostics Data Import
          DemAgingAllowed = true
          DemAgingCycleCounterThreshold = 0
          DemEventPriority = 2
          DemEventSignificance = DEM_EVENT_SIGNIFICANCE_FAULT
          DemEventFailureCycleCounterThreshold = 0
          DemFFPrestorageSupported = false
          DemAgingCycleRef = OBD_driving_cycle
          DemOperationCycleRef = OBD_driving_cycle
          DemDebounceAlgorithmClass  # Diagnostics Data Import
            DemDebounceTimeBase: DemDebounceTimeFailedThreshold=5, DemDebounceTimePassedThreshold=11, DemDebounceBehavior=DEM_DEBOUNCE_FREEZE  # Diagnostics Data Import
      DTCClass_DTC_0x000013 (DemDTCClass): DemDTCSeverity=DEM_DTC_SEV_NO_SEVERITY, DemUdsDTC=19, DemDTCAttributesRef=DtcAttributes_41914fb7  # Diagnostics Data Import
      Electrical_Fault_Fan_Motor_Control_Circuit_Short (DemEventParameter):  # Diagnostics Data Import
        DemEventKind = DEM_EVENT_KIND_SWC
        DemEventLatchTestFailed = true
        DemDTCClassRef = DTCClass_DTC_0x000012
        DemExtendedDataClassRef = ExtendedDataClass_4f5344cd
        DemFreezeFrameClassRef = FreezeFrameClass_e46843e0
        DemFreezeFrameRecNumClassRef = FreezeFrameRecNumClass_f98c8aa7
        DemEventClass:  # Diagnostics Data Import
          DemAgingAllowed = true
          DemAgingCycleCounterThreshold = 0
          DemEventPriority = 2
          DemEventSignificance = DEM_EVENT_SIGNIFICANCE_FAULT
          DemEventFailureCycleCounterThreshold = 0
          DemFFPrestorageSupported = false
          DemAgingCycleRef = OBD_driving_cycle
          DemOperationCycleRef = OBD_driving_cycle
          DemDebounceAlgorithmClass  # Diagnostics Data Import
            DemDebounceTimeBase: DemDebounceTimeFailedThreshold=5, DemDebounceTimePassedThreshold=11, DemDebounceBehavior=DEM_DEBOUNCE_FREEZE  # Diagnostics Data Import
      DTCClass_DTC_0x000012 (DemDTCClass): DemDTCSeverity=DEM_DTC_SEV_NO_SEVERITY, DemUdsDTC=17, DemDTCAttributesRef=DtcAttributes_41914fb7  # Diagnostics Data Import
      DtcAttributes_41914fb7 (DemDTCAttributes): DemMemoryDestinationRef=PrimaryMemory  # Diagnostics Data Import
  module config EcuC
    EcucPduCollection: PduIdTypeEnum=UINT8, PduLengthTypeEnum=UINT8
      14 x Pdu, all with PduLength=8:
        Comfort_DrivingCycle_Frame_PDU_b08df3c0_Rx: DynamicLength=false
        Comfort_DrivingCycle_Frame_PDU_e1cdd903_Rx: DynamicLength=false, SysTPduToFrameMappingRef=PduToFrameMapping_f092b7843c42ae66
        Comfort_Fan_Frame_PDU_68b7e774_Tx: DynamicLength=false
        Comfort_Fan_Frame_PDU_b6a0c8d2_Tx: DynamicLength=false, SysTPduToFrameMappingRef=PduToFrameMapping_da70f57f84e0c52f
        Comfort_Fan_NM_PDU_Rx_68476f29_Rx: DynamicLength=false, SysTPduToFrameMappingRef=PduToFrameMapping_f9a155ae7a02421d
        Comfort_Fan_NM_PDU_Tx_3bb98271_Tx: DynamicLength=false, SysTPduToFrameMappingRef=PduToFrameMapping_60c901503b06c4eb
        Comfort_HeadUnit_Frame_PDU_6df1e8d4_Rx: DynamicLength=false
        Comfort_HeadUnit_Frame_PDU_80f4a911_Rx: DynamicLength=false, SysTPduToFrameMappingRef=PduToFrameMapping_242c7490ec0b90cb
        Comfort_TP_Diag_Request_Fan_ECU_Frame_PDU_c4e708c3_Rx: DynamicLength=false, SysTPduToFrameMappingRef=PduToFrameMapping_c1fb90dd528ac694
        Comfort_TP_Diag_Response_Fan_ECU_Frame_PDU_44cf1fc1_Tx: DynamicLength=false, SysTPduToFrameMappingRef=PduToFrameMapping_216562903d228812
        Diag_Request_Fan_ECU_PDU_5809d877_Rx: DynamicLength=true
        Diag_Request_Fan_ECU_PDU_96ea3459_Rx: DynamicLength=true
        Diag_Response_Fan_ECU_PDU_15224d29_Tx: DynamicLength=true
        Diag_Response_Fan_ECU_PDU_a20a679e_Tx: DynamicLength=true
  module config EcuM
    EcuMConfiguration
      EcuMCommonConfiguration
        EcuMDriverInitListOne
        EcuMDriverRestartList
        Connector_Fan_ECU_fbc5880ce1a0cdea_90249745 (EcuMWakeupSource): EcuMWakeupSourceId=5, EcuMComMChannelRef=ComMConfigSet/Connector_Fan_ECU_fbc5880ce1a0cdea_90249745
      EcuMFlexConfiguration: EcuMFlexModuleConfigurationRef=CanConfigSet
  module config PduR
    PduRGeneral
    PduRRoutingTables
      PduRRoutingTable
        5 x PduRRoutingPath:
          Comfort_DrivingCycle_Frame_PDU_e1cdd903_Rx
            Comfort_DrivingCycle_Frame_PDU_e1cdd903_Rx_eaa9fb24_Rx (PduRDestPdu): PduRDestPduRef=EcucPduCollection/Comfort_DrivingCycle_Frame_PDU_b08df3c0_Rx
            PduRSrcPdu_eaa9fb24 (PduRSrcPdu): PduRSrcPduRef=EcucPduCollection/Comfort_DrivingCycle_Frame_PDU_e1cdd903_Rx
          Comfort_Fan_Frame_PDU_68b7e774_Tx
            Comfort_Fan_Frame_PDU_b6a0c8d2_Tx (PduRDestPdu): PduRDestPduRef=EcucPduCollection/Comfort_Fan_Frame_PDU_b6a0c8d2_Tx
            PduRSrcPdu_2f70a27c (PduRSrcPdu): PduRSrcPduRef=EcucPduCollection/Comfort_Fan_Frame_PDU_68b7e774_Tx
          Comfort_HeadUnit_Frame_PDU_80f4a911_Rx
            Comfort_HeadUnit_Frame_PDU_80f4a911_Rx_6fa907e0_Rx (PduRDestPdu): PduRDestPduRef=EcucPduCollection/Comfort_HeadUnit_Frame_PDU_6df1e8d4_Rx
            PduRSrcPdu_6fa907e0 (PduRSrcPdu): PduRSrcPduRef=EcucPduCollection/Comfort_HeadUnit_Frame_PDU_80f4a911_Rx
          Diag_Request_Fan_ECU_PDU_96ea3459_Rx
            Diag_Request_Fan_ECU_PDU_96ea3459_Rx_00a881bb_Rx (PduRDestPdu): PduRDestPduRef=Diag_Request_Fan_ECU_PDU_5809d877_Rx
            PduRSrcPdu_00a881bb (PduRSrcPdu): PduRSrcPduRef=EcucPduCollection/Diag_Request_Fan_ECU_PDU_96ea3459_Rx
          Diag_Response_Fan_ECU_PDU_15224d29_Tx
            Diag_Response_Fan_ECU_PDU_a20a679e_Tx (PduRDestPdu): PduRDestPduRef=EcucPduCollection/Diag_Response_Fan_ECU_PDU_a20a679e_Tx
            PduRSrcPdu_bca58b65 (PduRSrcPdu): PduRSrcPduRef=EcucPduCollection/Diag_Response_Fan_ECU_PDU_15224d29_Tx
