[part 1 of 2: package /ActiveEcuC]
AUTOSAR XML (schema 00050)
package /ActiveEcuC
  ecuc value collection ActiveEcuC: ecu-extract=SYSTEM
    ecuc-values:
      VTTCan
      Mcu
      BswM
      EcuM
      CanIf
      PduR
      Rte
      vSet
      Os
      Det
      Com
      ComM
      VTTEcuC
      VTTOs
      EcuC
      VTTMcu
      ComXf
      CanSM
      VTTCntrl
      VTTvSet
      MemMap
      VTTMemMap
      Pwm
      Adc
      VTTAdc
      Nm
      CanNm
      Dcm
      Dem
      NvM
      Fee
      Fls
      VTTFls
      CanTp
      MemIf
      Crc
      Can
      VTTPwm
  module config VTTCan: implementation-config-variant=VARIANT-PRE-COMPILE, module-description=VTTCan_Impl
    CanGeneral:
      CanChangeBaudrateApi = false
      CanDevErrorDetection = true
      CanHardwareCancellation = false
      CanIdenticalIdCancellation = false
      CanIndex = 0
      CanMainFunctionModePeriod = 0.01
      CanMultiplexedTransmission = false
      CanSetBaudrateApi = true
      CanTimeoutDuration = 0.01
      CanVersionInfoApi = false
      CanGenericPrecopy = false
      CanHardwareLoopCheck = false
      CanRxFullCANSupport = false
      CanTxFullCANSupport = false
      CanRxBasicCANSupport = true
      CanUseNestedCANInterrupts = false
      CanHardwareCancelByAppl = false
      CanIndividualProcessing = false
      CanGenericConfirmation = false
      CanGenericConfirmationAPI2 = false
      CanRxQueue = false
      CanSupportMixedID = false
      CanRxQueueSize = 10
      CanMultipleBasicCANObjects = false
      CanMultipleBasicCANTxObjects = false
      CanHardwareHandleType = UINT8
      CanOptimizeOneController = true
      CanInterruptCategory = CATEGORY2
      CanGetStatus = false
      CanInterruptLock = DRIVER
      CanWakeupSupport = true
      CanRamCheck = None
      CanOverrunNotification = DET
      CanReinitStart = false
      CanGenericPreTransmit = false
      CanFdSupport = NONE
      CanRuntimeMeasurementSupport = false
      CanMaxRxDataLen = 8
      CanMaxTxDataLen = 8
      CanUsePeripheralAccessApi = false
      CanMirrorModeSupport = false
      CanUseOsInterruptControl = false
      CanSafeBswChecks = false
      CanSilentModeSupport = false
      CanHwTxFifoSupport = false
      CanCheckWakeupCanRetType = false
      CanFdHardwareBufferOptimization = false
      CanEnableSecurityEventReporting = false
      CanMainFunctionWakeupPeriod = 0.01
      CanMainFunctionBusoffPeriod = 0.01
      CanMainFunctionRWPeriods
    CanConfigSet
      Connector_Fan_ECU_fbc5880ce1a0cdea_90249745_Tx (CanHardwareObject):
        CanHandleType = BASIC
        CanIdType = STANDARD
        CanIdValue = 0
        CanObjectId = 0
        CanObjectType = TRANSMIT
        CanHwProcessing = false
        CanObjectHwSize = 1
        CanObjectHwHandle = 0
        CanMaxDataLen = 8
        CanObjectMultiplexedTransmission = false
        CanObjectHwFifo = false
        CanFdPaddingValue = 0
        CanControllerRef = CanConfigSet/Controller_Fan_ECU_02f7c8db915351a9_92c03ed2
      Connector_Fan_ECU_fbc5880ce1a0cdea_6fd0fec7_Rx (CanHardwareObject):
        CanHandleType = BASIC
        CanIdType = STANDARD
        CanIdValue = 0
        CanObjectId = 1
        CanObjectType = RECEIVE
        CanHwProcessing = false
        CanObjectHwSize = 5
        CanObjectHwHandle = 1
        CanMaxDataLen = 8
        CanObjectMultiplexedTransmission = false
        CanObjectHwFifo = false
        CanFdPaddingValue = 0
        CanControllerRef = CanConfigSet/Controller_Fan_ECU_02f7c8db915351a9_92c03ed2
        CanFilterMaskRef = Controller_Fan_ECU_02f7c8db915351a9_92c03ed2/CanFilterMask
      Controller_Fan_ECU_02f7c8db915351a9_92c03ed2 (CanController):
        CanBusoffProcessing = INTERRUPT
        CanControllerActivation = true
        CanControllerBaseAddress = 0
        CanControllerId = 0
        CanRxProcessing = INTERRUPT
        CanTxProcessing = INTERRUPT
        CanWakeupProcessing = INTERRUPT
        CanWakeupSupport = true
        CanWakeupSourceId = 32
        CanBusName = Comfort
        CanControllerDefaultBaudrate = Controller_Fan_ECU_02f7c8db915351a9_92c03ed2/CanControllerBaudrateConfig
        CanWakeupSourceRef = ECUM_WKSOURCE_CAN
        CanControllerBaudrateConfig:
          CanControllerBaudRate = 500
          CanControllerBaudRateConfigID = 0
          CanControllerPropSeg = 7
          CanControllerSeg1 = 4
          CanControllerSeg2 = 4
          CanControllerSyncJumpWidth = 1
          CanBaudrateClock = 8000
          CanBaudratePrescaler = 1
          CanSamplingMode = OneSample
        CanFilterMask: CanFilterMaskValue=0, CanFilterCodeValue=0, IsLocked=false
  module config Mcu: implementation-config-variant=VARIANT-PRE-COMPILE, module-description=Mcu_Impl
    McuPublishedInformation
    McuGeneralConfiguration:
      McuDevErrorDetect = true
      McuGetRamStateApi = false
      McuInitClock = true
      McuNoPll = true
      McuPerformResetApi = true
      McuVersionInfoApi = false
      McuSafeBswChecks = false
    McuModuleConfiguration
      4 x McuModeSettingConf:
        SLEEP: McuMode=1, McuVttMode=VTTMCU_MODE_SLEEP
        POWER_OFF: McuMode=3, McuVttMode=VTTMCU_MODE_POWER_OFF
        RESET: McuMode=2, McuVttMode=VTTMCU_MODE_RESET
        NORMAL: McuMode=0, McuVttMode=VTTMCU_MODE_NORMAL
      McuClockSettingConfig
        McuClockReferencePoint: McuClockReferencePointFrequency=80000000
  module config BswM: implementation-config-variant=VARIANT-PRE-COMPILE, module-description=BswM_Impl
    BswMGeneral:
      BswMCanSMEnabled = true
      BswMComMEnabled = true
      BswMDcmEnabled = true
      BswMDevErrorDetect = true
      BswMEcuMEnabled = true
      BswMEthIfEnabled = false
      BswMEthSMEnabled = false
      BswMFrSMEnabled = false
      BswMGenericRequestEnabled = true
      BswMJ1939DcmEnabled = false
      BswMJ1939NmEnabled = false
      BswMLinSMEnabled = false
      BswMLinTPEnabled = false
      BswMNmEnabled = false
      BswMNvMEnabled = true
      BswMPduREnabled = false
      BswMRuleControlEnabled = false
      BswMSdEnabled = false
      BswMVersionInfoApi = false
      BswMWdgMEnabled = false
      BswMModeCheck = true
      BswMActionListQueueSearchAlgorithm = LINEAR_SEARCH
      BswMSafeBswChecks = true
      BswMMainFunctionPeriod = 0.01
      BswMCommonData
      BswMGeneration:
        BswMOutOfBoundsWriteSanitizer = false
        BswMOutOfBoundsReadSanitizer = false
        BswMReduceConstantData2Define = true
        BswMBoolDataInArrayOfStructStrategy = BITMASKING
        BswMInterfacesForDeactivatedData = false
    BswMConfig
      BswMArbitration
        ESH_RunToPostRun (BswMRule):
          BswMNestedExecutionOnly = false
          BswMRuleId = 9
          BswMRuleInitState = BSWM_FALSE
          BswMRuleExpressionRef = ESH_LE_RunToPostRunTransition
          BswMRuleTrueActionList = ESH_AL_ExitRun
        ESH_LE_RunToPostRunTransition (BswMLogicalExpression): BswMLogicalOperator=BSWM_AND, BswMArgumentRef=ESH_LE_RunReached, BswMArgumentRef=ESH_LE_NoRunAndNoKillAllRequest
        ESH_LE_RunReached (BswMLogicalExpression): BswMLogicalOperator=BSWM_AND, BswMArgumentRef=ESH_Cond_StateIsRun, BswMArgumentRef=ESH_Cond_ModeIsRun
        ESH_Cond_StateIsRun (BswMModeCondition): BswMConditionType=BSWM_EQUALS, BswMConditionMode=ESH_State
          BswMConditionValue
            BswMBswMode: BswMBswRequestedMode=ESH_RUN
        ESH_State (BswMModeRequestPort): BswMArbitrateOnInit=true, BswMRequestProcessing=BSWM_IMMEDIATE
          BswMModeRequestSource
            BswMGenericRequest: BswMModeRequesterId=230, BswMRequestedModeMax=7
              7 x BswMGenericRequestMode:
                ESH_INIT: BswMGenericRequestModeValue=0
                ESH_RUN: BswMGenericRequestModeValue=1
                ESH_POST_RUN: BswMGenericRequestModeValue=2
                ESH_PREP_SHUTDOWN: BswMGenericRequestModeValue=3
                ESH_WAIT_FOR_NVM: BswMGenericRequestModeValue=4
                ESH_SHUTDOWN: BswMGenericRequestModeValue=5
                ESH_WAKEUP: BswMGenericRequestModeValue=6
          BswMModeInitValue
            BswMBswModeInitValue: BswMBswModeInitValueMode=ESH_INIT
        3 x BswMLogicalExpression:
          ESH_LE_NoRunAndNoKillAllRequest: BswMLogicalOperator=BSWM_OR, BswMArgumentRef=ESH_LE_NoRunReasons
          ESH_LE_NoRunReasons: BswMLogicalOperator=BSWM_AND, BswMArgumentRef=ESH_LE_AllChannelsNoCom, BswMArgumentRef=ESH_LE_RunReleased, BswMArgumentRef=ESH_Cond_SelfRunReqTimerExpired
          ESH_LE_AllChannelsNoCom: BswMLogicalOperator=BSWM_AND, BswMArgumentRef=ESH_Cond_NoComOn_Connector_Fan_ECU_fbc5880ce1a0cdea_90249745
        ESH_Cond_SelfRunReqTimerExpired (BswMModeCondition): BswMConditionType=BSWM_EQUALS, BswMConditionMode=ESH_SelfRunRequestTimer
          BswMConditionValue
            BswMBswMode: BswMBswRequestedMode=BSWM_TIMER_EXPIRED
        ESH_SelfRunRequestTimer (BswMModeRequestPort): BswMArbitrateOnInit=false, BswMRequestProcessing=BSWM_DEFERRED
          BswMModeRequestSource
            BswMTimer
          BswMModeInitValue
            BswMBswModeInitValue: BswMBswModeInitValueMode=BSWM_TIMER_STOPPED
        ESH_RunToPostRunNested (BswMRule):
          BswMNestedExecutionOnly = true
          BswMRuleId = 10
          BswMRuleInitState = BSWM_FALSE
          BswMRuleExpressionRef = ESH_LE_ComMNoPendingRequests
          BswMRuleTrueActionList = ESH_AL_RunToPostRun
        ESH_LE_ComMNoPendingRequests (BswMLogicalExpression): BswMLogicalOperator=BSWM_OR, BswMArgumentRef=ESH_Cond_ComMNoPendingRequests
        ESH_Cond_ComMNoPendingRequests (BswMModeCondition): BswMConditionType=BSWM_EQUALS, BswMConditionMode=ESH_ComMPendingRequests
          BswMConditionValue
            BswMBswMode: BswMBswRequestedMode=ESH_COMM_NO_REQUEST
        ESH_ComMPendingRequests (BswMModeRequestPort): BswMArbitrateOnInit=false, BswMRequestProcessing=BSWM_DEFERRED
          BswMModeRequestSource
            BswMGenericRequest: BswMModeRequesterId=232, BswMRequestedModeMax=2
              ESH_COMM_NO_REQUEST (BswMGenericRequestMode): BswMGenericRequestModeValue=0
              ESH_COMM_PENDING_REQUEST (BswMGenericRequestMode): BswMGenericRequestModeValue=1
          BswMModeInitValue
            BswMBswModeInitValue: BswMBswModeInitValueMode=ESH_COMM_NO_REQUEST
        ESH_WaitToShutdown (BswMRule):
          BswMNestedExecutionOnly = false
          BswMRuleId = 11
          BswMRuleInitState = BSWM_FALSE
          BswMRuleExpressionRef = ESH_LE_WaitForNvMToShutdown
          BswMRuleTrueActionList = ESH_AL_WaitForNvMToShutdown
        ESH_LE_WaitForNvMToShutdown (BswMLogicalExpression):
          BswMLogicalOperator = BSWM_AND
          BswMArgumentRef = ESH_Cond_StateIsWaitForNvm
          BswMArgumentRef = ESH_LE_WriteNotPending
          BswMArgumentRef = ESH_LE_NoWakeupOrKillAll
        ESH_Cond_StateIsWaitForNvm (BswMModeCondition): BswMConditionType=BSWM_EQUALS, BswMConditionMode=ESH_State
          BswMConditionValue
            BswMBswMode: BswMBswRequestedMode=ESH_WAIT_FOR_NVM
        ESH_LE_NoWakeupOrKillAll (BswMLogicalExpression): BswMLogicalOperator=BSWM_OR, BswMArgumentRef=ESH_LE_NoWakeup
        ESH_LE_NoWakeup (BswMLogicalExpression): BswMLogicalOperator=BSWM_AND, BswMArgumentRef=ESH_Cond_NoValidatedWakeups, BswMArgumentRef=ESH_Cond_ComMNoPendingRequests
        ESH_Cond_NoValidatedWakeups (BswMModeCondition): BswMConditionType=BSWM_EQUALS, BswMConditionMode=ESH_EcuM_GetValidatedWakeupEvents
          BswMConditionValue
            BswMBswMode: BswMBswRequestedMode=0
        ESH_EcuM_GetValidatedWakeupEvents (BswMModeRequestPort): BswMArbitrateOnInit=false, BswMRequestProcessing=BSWM_DEFERRED
          BswMModeRequestSource
            BswMUserConditionRequest: BswMUserCondition=EcuM_GetValidatedWakeupEvents()
        ESH_WakeupToPrep (BswMRule):
          BswMNestedExecutionOnly = false
          BswMRuleId = 13
          BswMRuleInitState = BSWM_FALSE
          BswMRuleExpressionRef = ESH_LE_WakeupToPrepShutdown
          BswMRuleTrueActionList = ESH_AL_WakeupToPrep
        ESH_LE_WakeupToPrepShutdown (BswMLogicalExpression):
          BswMLogicalOperator = BSWM_AND
          BswMArgumentRef = ESH_Cond_StateIsWakeup
          BswMArgumentRef = ESH_LE_CancelNotPending
          BswMArgumentRef = ESH_Cond_NoPendingWakeups
          BswMArgumentRef = ESH_LE_NoWakeup
          BswMArgumentRef = ESH_Cond_ModeIsWakeup
        ESH_Cond_StateIsWakeup (BswMModeCondition): BswMConditionType=BSWM_EQUALS, BswMConditionMode=ESH_State
          BswMConditionValue
            BswMBswMode: BswMBswRequestedMode=ESH_WAKEUP
        ESH_Cond_NoPendingWakeups (BswMModeCondition): BswMConditionType=BSWM_EQUALS, BswMConditionMode=ESH_EcuM_GetPendingWakeupEvents
          BswMConditionValue
            BswMBswMode: BswMBswRequestedMode=0
        ESH_EcuM_GetPendingWakeupEvents (BswMModeRequestPort): BswMArbitrateOnInit=false, BswMRequestProcessing=BSWM_DEFERRED
          BswMModeRequestSource
            BswMUserConditionRequest: BswMUserCondition=EcuM_GetPendingWakeupEvents()
        ESH_WaitToWakeup (BswMRule):
          BswMNestedExecutionOnly = false
          BswMRuleId = 12
          BswMRuleInitState = BSWM_FALSE
          BswMRuleExpressionRef = ESH_LE_WaitForNvMToWakeup
          BswMRuleTrueActionList = ESH_AL_WaitForNvMWakeup
        ESH_LE_WaitForNvMToWakeup (BswMLogicalExpression): BswMLogicalOperator=BSWM_AND, BswMArgumentRef=ESH_Cond_StateIsWaitForNvm, BswMArgumentRef=ESH_LE_ValidWakeup
        ESH_LE_ValidWakeup (BswMLogicalExpression): BswMLogicalOperator=BSWM_OR, BswMArgumentRef=ESH_Cond_ValidatedWakeups, BswMArgumentRef=ESH_Cond_ComMPendingRequests
        ESH_Cond_ValidatedWakeups (BswMModeCondition): BswMConditionType=BSWM_EQUALS_NOT, BswMConditionMode=ESH_EcuM_GetValidatedWakeupEvents
          BswMConditionValue
            BswMBswMode: BswMBswRequestedMode=0
        ESH_Cond_ComMPendingRequests (BswMModeCondition): BswMConditionType=BSWM_EQUALS, BswMConditionMode=ESH_ComMPendingRequests
          BswMConditionValue
            BswMBswMode: BswMBswRequestedMode=ESH_COMM_PENDING_REQUEST
        ESH_WakeupToRun (BswMRule):
          BswMNestedExecutionOnly = false
          BswMRuleId = 14
          BswMRuleInitState = BSWM_FALSE
          BswMRuleExpressionRef = ESH_LE_WakeupToRun
          BswMRuleTrueActionList = ESH_AL_WakeupToRun
        ESH_LE_WakeupToRun (BswMLogicalExpression):
          BswMLogicalOperator = BSWM_AND
          BswMArgumentRef = ESH_Cond_StateIsWakeup
          BswMArgumentRef = ESH_LE_ValidWakeup
          BswMArgumentRef = ESH_LE_CancelNotPending
          BswMArgumentRef = ESH_Cond_ModeIsWakeup
        ESH_InitToWakeup (BswMRule):
          BswMNestedExecutionOnly = false
          BswMRuleId = 4
          BswMRuleInitState = BSWM_FALSE
          BswMRuleExpressionRef = ESH_LE_InitToWakeup
          BswMRuleTrueActionList = ESH_AL_InitToWakeup
        ESH_LE_InitToWakeup (BswMLogicalExpression): BswMLogicalOperator=BSWM_AND, BswMArgumentRef=ESH_Cond_StateIsInit
        ESH_Cond_StateIsInit (BswMModeCondition): BswMConditionType=BSWM_EQUALS, BswMConditionMode=ESH_State
          BswMConditionValue
            BswMBswMode: BswMBswRequestedMode=ESH_INIT
        ESH_PostRunNested (BswMRule):
          BswMNestedExecutionOnly = true
          BswMRuleId = 6
          BswMRuleInitState = BSWM_FALSE
          BswMRuleExpressionRef = ESH_LE_PostRunToRun
          BswMRuleFalseActionList = ESH_AL_ESH_PostRunToPrepCheck
          BswMRuleTrueActionList = ESH_AL_PostRunToRun
        ESH_LE_PostRunToRun (BswMLogicalExpression): BswMLogicalOperator=BSWM_AND, BswMArgumentRef=ESH_LE_RunRequestsOrWakeup
        ESH_LE_RunRequestsOrWakeup (BswMLogicalExpression): BswMLogicalOperator=BSWM_OR, BswMArgumentRef=ESH_LE_RunRequested, BswMArgumentRef=ESH_LE_ValidWakeup
        ESH_PostRun (BswMRule):
          BswMNestedExecutionOnly = false
          BswMRuleId = 5
          BswMRuleInitState = BSWM_FALSE
          BswMRuleExpressionRef = ESH_LE_PostRun
          BswMRuleTrueActionList = ESH_AL_ExitPostRun
        ESH_LE_PostRun (BswMLogicalExpression): BswMLogicalOperator=BSWM_AND, BswMArgumentRef=ESH_Cond_StateIsPostRun, BswMArgumentRef=ESH_Cond_ModeIsPostRun
        ESH_Cond_StateIsPostRun (BswMModeCondition): BswMConditionType=BSWM_EQUALS, BswMConditionMode=ESH_State
          BswMConditionValue
            BswMBswMode: BswMBswRequestedMode=ESH_POST_RUN
        ESH_PrepToWait (BswMRule):
          BswMNestedExecutionOnly = false
          BswMRuleId = 8
          BswMRuleInitState = BSWM_FALSE
          BswMRuleExpressionRef = ESH_LE_PrepShutdownToWaitForNvM
          BswMRuleTrueActionList = ESH_AL_PrepShutdownToWaitForNvM
        ESH_LE_PrepShutdownToWaitForNvM (BswMLogicalExpression): BswMLogicalOperator=BSWM_AND, BswMArgumentRef=ESH_Cond_StateIsPrepShutdown, BswMArgumentRef=ESH_Cond_ModeIsShutdown
        ESH_Cond_StateIsPrepShutdown (BswMModeCondition): BswMConditionType=BSWM_EQUALS, BswMConditionMode=ESH_State
          BswMConditionValue
            BswMBswMode: BswMBswRequestedMode=ESH_PREP_SHUTDOWN
        ESH_LE_RunReleased (BswMLogicalExpression): BswMLogicalOperator=BSWM_AND, BswMArgumentRef=ESH_Cond_RunRequest0IsReleased
        ESH_Cond_RunRequest0IsReleased (BswMModeCondition): BswMConditionType=BSWM_EQUALS, BswMConditionMode=ESH_RunRequest_0
          BswMConditionValue
            BswMModeDeclaration: BswMModeValueRef=RELEASED
        ESH_RunRequest_0 (BswMModeRequestPort): BswMArbitrateOnInit=false, BswMRequestProcessing=BSWM_DEFERRED
          BswMModeRequestSource
            BswMSwcModeRequest: BswMModeRequestDataElementPrototypeName=requestedMode, BswMSwcModeRequestModeDeclarationGroupPrototypeRef=BswM_MDGP_ESH_RunRequest
          BswMModeInitValue
            BswMSwcModeInitValue: BswMSwcModeInitValueRef=RELEASED
        ESH_PostRunToPrepNested (BswMRule):
          BswMNestedExecutionOnly = true
          BswMRuleId = 7
          BswMRuleInitState = BSWM_FALSE
          BswMRuleExpressionRef = ESH_LE_Dem_PostRunRequested
          BswMRuleTrueActionList = ESH_AL_PostRunToPrepShutdown
        3 x BswMLogicalExpression:
          ESH_LE_Dem_PostRunRequested: BswMLogicalOperator=BSWM_AND, BswMArgumentRef=ESH_LE_PostRunToPrep, BswMArgumentRef=ESH_Cond_DemPostRunRequested
          ESH_LE_PostRunToPrep: BswMLogicalOperator=BSWM_OR, BswMArgumentRef=ESH_LE_PostRunReleased
          ESH_LE_PostRunReleased: BswMLogicalOperator=BSWM_AND, BswMArgumentRef=ESH_Cond_PostRunRequest0IsReleased
        ESH_Cond_PostRunRequest0IsReleased (BswMModeCondition): BswMConditionType=BSWM_EQUALS, BswMConditionMode=ESH_PostRunRequest_0
          BswMConditionValue
            BswMModeDeclaration: BswMModeValueRef=RELEASED
        ESH_PostRunRequest_0 (BswMModeRequestPort): BswMArbitrateOnInit=false, BswMRequestProcessing=BSWM_DEFERRED
          BswMModeRequestSource
            BswMSwcModeRequest: BswMModeRequestDataElementPrototypeName=requestedMode, BswMSwcModeRequestModeDeclarationGroupPrototypeRef=BswM_MDGP_ESH_RunRequest
          BswMModeInitValue
            BswMSwcModeInitValue: BswMSwcModeInitValueRef=RELEASED
        ESH_LE_RunRequested (BswMLogicalExpression): BswMLogicalOperator=BSWM_OR, BswMArgumentRef=ESH_Cond_RunRequest0IsRequested
        ESH_Cond_RunRequest0IsRequested (BswMModeCondition): BswMConditionType=BSWM_EQUALS, BswMConditionMode=ESH_RunRequest_0
          BswMConditionValue
            BswMModeDeclaration: BswMModeValueRef=REQUESTED
        ESH_Cond_NoComOn_Connector_Fan_ECU_fbc5880ce1a0cdea_90249745 (BswMModeCondition): BswMConditionType=BSWM_EQUALS, BswMConditionMode=ESH_ComMIndication_Connector_Fan_ECU_fbc5880ce1a0cdea_90249745
          BswMConditionValue
            BswMBswMode: BswMBswRequestedMode=COMM_NO_COMMUNICATION
        ESH_ComMIndication_Connector_Fan_ECU_fbc5880ce1a0cdea_90249745 (BswMModeRequestPort): BswMArbitrateOnInit=false, BswMRequestProcessing=BSWM_DEFERRED
          BswMModeRequestSource
            BswMComMIndication: BswMComMChannelRef=Connector_Fan_ECU_fbc5880ce1a0cdea_90249745
          BswMModeInitValue
            BswMBswModeInitValue: BswMBswModeInitValueMode=COMM_NO_COMMUNICATION
        CC_Connector_Fan_ECU_fbc5880ce1a0cdea_90249745_RX_DM (BswMRule):
          BswMNestedExecutionOnly = false
          BswMRuleId = 1
          BswMRuleInitState = BSWM_FALSE
          BswMRuleExpressionRef = CC_LE_Connector_Fan_ECU_fbc5880ce1a0cdea_90249745_RX_DM
          BswMRuleFalseActionList = CC_AL_Connector_Fan_ECU_fbc5880ce1a0cdea_90249745_Disable_DM
          BswMRuleTrueActionList = CC_AL_Connector_Fan_ECU_fbc5880ce1a0cdea_90249745_Enable_DM
        CC_LE_Connector_Fan_ECU_fbc5880ce1a0cdea_90249745_RX_DM (BswMLogicalExpression):
          BswMLogicalOperator = BSWM_AND
          BswMArgumentRef = CC_Cond_CanSMIndication_Connector_Fan_ECU_fbc5880ce1a0cdea_90249745_EQ_CANSM_BSWM_FULL_COMMUNICATION
        CC_Cond_CanSMIndication_Connector_Fan_ECU_fbc5880ce1a0cdea_90249745_EQ_CANSM_BSWM_FULL_COMMUNICATION (BswMModeCondition): BswMConditionType=BSWM_EQUALS, BswMConditionMode=CC_CanSMIndication_Connector_Fan_ECU_fbc5880ce1a0cdea_90249745
          BswMConditionValue
            BswMBswMode: BswMBswRequestedMode=CANSM_BSWM_FULL_COMMUNICATION
        CC_CanSMIndication_Connector_Fan_ECU_fbc5880ce1a0cdea_90249745 (BswMModeRequestPort): BswMArbitrateOnInit=false, BswMRequestProcessing=BSWM_IMMEDIATE
          BswMModeRequestSource
            BswMCanSMIndication: BswMCanSMChannelRef=Connector_Fan_ECU_fbc5880ce1a0cdea_90249745
          BswMModeInitValue
            BswMBswModeInitValue: BswMBswModeInitValueMode=CANSM_BSWM_NO_COMMUNICATION
        CC_Connector_Fan_ECU_fbc5880ce1a0cdea_90249745_RX (BswMRule):
          BswMNestedExecutionOnly = false
          BswMRuleId = 0
          BswMRuleInitState = BSWM_FALSE
          BswMRuleExpressionRef = CC_LE_Connector_Fan_ECU_fbc5880ce1a0cdea_90249745_RX
          BswMRuleFalseActionList = CC_AL_Connector_Fan_ECU_fbc5880ce1a0cdea_90249745_RX_Disable
          BswMRuleTrueActionList = CC_AL_Connector_Fan_ECU_fbc5880ce1a0cdea_90249745_RX_EnableNoinit
        CC_LE_Connector_Fan_ECU_fbc5880ce1a0cdea_90249745_RX (BswMLogicalExpression):
          BswMLogicalOperator = BSWM_AND
          BswMArgumentRef = CC_Cond_CanSMIndication_Connector_Fan_ECU_fbc5880ce1a0cdea_90249745_NEQ_CANSM_BSWM_NO_COMMUNICATION
        CC_Cond_CanSMIndication_Connector_Fan_ECU_fbc5880ce1a0cdea_90249745_NEQ_CANSM_BSWM_NO_COMMUNICATION (BswMModeCondition): BswMConditionType=BSWM_EQUALS_NOT, BswMConditionMode=CC_CanSMIndication_Connector_Fan_ECU_fbc5880ce1a0cdea_90249745
          BswMConditionValue
            BswMBswMode: BswMBswRequestedMode=CANSM_BSWM_NO_COMMUNICATION
        CC_Connector_Fan_ECU_fbc5880ce1a0cdea_90249745_TX (BswMRule):
          BswMNestedExecutionOnly = false
          BswMRuleId = 2
          BswMRuleInitState = BSWM_FALSE
          BswMRuleExpressionRef = CC_LE_Connector_Fan_ECU_fbc5880ce1a0cdea_90249745_TX
          BswMRuleFalseActionList = CC_AL_Connector_Fan_ECU_fbc5880ce1a0cdea_90249745_TX_Disable
          BswMRuleTrueActionList = CC_AL_Connector_Fan_ECU_fbc5880ce1a0cdea_90249745_TX_EnableNoinit
        CC_LE_Connector_Fan_ECU_fbc5880ce1a0cdea_90249745_TX (BswMLogicalExpression):
          BswMLogicalOperator = BSWM_AND
          BswMArgumentRef = CC_Cond_CanSMIndication_Connector_Fan_ECU_fbc5880ce1a0cdea_90249745_EQ_CANSM_BSWM_FULL_COMMUNICATION
        ESH_Cond_ModeIsRun (BswMModeCondition): BswMConditionType=BSWM_EQUALS, BswMConditionMode=ESH_ModeNotification
          BswMConditionValue
            BswMModeDeclaration: BswMModeValueRef=RUN
        ESH_ModeNotification (BswMModeRequestPort): BswMArbitrateOnInit=false, BswMRequestProcessing=BSWM_DEFERRED
          BswMModeRequestSource
            BswMSwcModeNotification: BswMSwcModeNotificationModeDeclarationGroupPrototypeRef=BswM_MDGP_ESH_Mode
          BswMModeInitValue
            BswMSwcModeInitValue: BswMSwcModeInitValueRef=STARTUP
        ESH_LE_WriteNotPending (BswMLogicalExpression): BswMLogicalOperator=BSWM_OR, BswMArgumentRef=ESH_Cond_NvMWAIsNotPending, BswMArgumentRef=ESH_Cond_NvWWriteAllTimerNotRunning
        ESH_Cond_NvMWAIsNotPending (BswMModeCondition): BswMConditionType=BSWM_EQUALS_NOT, BswMConditionMode=ESH_NvMIndication
          BswMConditionValue
            BswMBswMode: BswMBswRequestedMode=NVM_REQ_PENDING
        ESH_NvMIndication (BswMModeRequestPort): BswMArbitrateOnInit=false, BswMRequestProcessing=BSWM_DEFERRED
          BswMModeRequestSource
            BswMNvMJobModeIndication: BswMNvmService=NvmWriteAll
          BswMModeInitValue
            BswMBswModeInitValue: BswMBswModeInitValueMode=NVM_REQ_OK
        ESH_Cond_NvWWriteAllTimerNotRunning (BswMModeCondition): BswMConditionType=BSWM_EQUALS_NOT, BswMConditionMode=ESH_NvM_WriteAllTimer
          BswMConditionValue
            BswMBswMode: BswMBswRequestedMode=BSWM_TIMER_STARTED
        ESH_NvM_WriteAllTimer (BswMModeRequestPort): BswMArbitrateOnInit=false, BswMRequestProcessing=BSWM_DEFERRED
          BswMModeRequestSource
            BswMTimer
          BswMModeInitValue
            BswMBswModeInitValue: BswMBswModeInitValueMode=BSWM_TIMER_STOPPED
        ESH_LE_CancelNotPending (BswMLogicalExpression): BswMLogicalOperator=BSWM_OR, BswMArgumentRef=ESH_Cond_NvMWAIsNotPending, BswMArgumentRef=ESH_Cond_NvWCancelTimerNotRunning
        ESH_Cond_NvWCancelTimerNotRunning (BswMModeCondition): BswMConditionType=BSWM_EQUALS_NOT, BswMConditionMode=ESH_NvM_CancelWriteAllTimer
          BswMConditionValue
            BswMBswMode: BswMBswRequestedMode=BSWM_TIMER_STARTED
        ESH_NvM_CancelWriteAllTimer (BswMModeRequestPort): BswMArbitrateOnInit=false, BswMRequestProcessing=BSWM_DEFERRED
          BswMModeRequestSource
            BswMTimer
          BswMModeInitValue
            BswMBswModeInitValue: BswMBswModeInitValueMode=BSWM_TIMER_STOPPED
        ESH_Cond_ModeIsWakeup (BswMModeCondition): BswMConditionType=BSWM_EQUALS, BswMConditionMode=ESH_ModeNotification
          BswMConditionValue
            BswMModeDeclaration: BswMModeValueRef=WAKEUP
        ESH_DemInit (BswMRule):
          BswMNestedExecutionOnly = true
          BswMRuleId = 3
          BswMRuleInitState = BSWM_FALSE
          BswMRuleExpressionRef = ESH_LE_DemNotInitialized
          BswMRuleTrueActionList = ESH_AL_DemInit
        ESH_LE_DemNotInitialized (BswMLogicalExpression): BswMLogicalOperator=BSWM_OR, BswMArgumentRef=ESH_Cond_DemNotInitialized
        ESH_Cond_DemNotInitialized (BswMModeCondition): BswMConditionType=BSWM_EQUALS, BswMConditionMode=ESH_DemInitStatus
          BswMConditionValue
            BswMBswMode: BswMBswRequestedMode=DEM_NOT_INITIALIZED
        ESH_DemInitStatus (BswMModeRequestPort): BswMArbitrateOnInit=false, BswMRequestProcessing=BSWM_IMMEDIATE
          BswMModeRequestSource
            BswMGenericRequest: BswMModeRequesterId=231, BswMRequestedModeMax=2
              DEM_INITIALIZED (BswMGenericRequestMode): BswMGenericRequestModeValue=0
              DEM_NOT_INITIALIZED (BswMGenericRequestMode): BswMGenericRequestModeValue=1
          BswMModeInitValue
            BswMBswModeInitValue: BswMBswModeInitValueMode=DEM_INITIALIZED
        ESH_Cond_DemPostRunRequested (BswMModeCondition): BswMConditionType=BSWM_EQUALS, BswMConditionMode=ESH_DemPostRunRequested
          BswMConditionValue
            BswMBswMode: BswMBswRequestedMode=FALSE
        ESH_DemPostRunRequested (BswMModeRequestPort): BswMArbitrateOnInit=false, BswMRequestProcessing=BSWM_DEFERRED
          BswMModeRequestSource
            BswMGenericRequest: BswMModeRequesterId=233, BswMRequestedModeMax=2
              TRUE (BswMGenericRequestMode): BswMGenericRequestModeValue=0
              FALSE (BswMGenericRequestMode): BswMGenericRequestModeValue=1
          BswMModeInitValue
            BswMBswModeInitValue: BswMBswModeInitValueMode=TRUE
        ESH_Cond_ModeIsPostRun (BswMModeCondition): BswMConditionType=BSWM_EQUALS, BswMConditionMode=ESH_ModeNotification
          BswMConditionValue
            BswMModeDeclaration: BswMModeValueRef=POSTRUN
        ESH_Cond_ModeIsShutdown (BswMModeCondition): BswMConditionType=BSWM_EQUALS, BswMConditionMode=ESH_ModeNotification
          BswMConditionValue
            BswMModeDeclaration: BswMModeValueRef=SHUTDOWN
      BswMModeControl: BswMInitActionListRef=INIT_AL_Initialize
        ESH_AL_ExitRun (BswMActionList): BswMActionListExecution=BSWM_CONDITION
          4 x BswMActionListItem, all with BswMAbortOnFail=false:
            ESH_Action_EnterExclusiveArea: BswMActionListItemIndex=0, BswMActionListItemRef=BswMModeControl/ESH_Action_EnterExclusiveArea
            ESH_Action_ComMCheckPendingRequests: BswMActionListItemIndex=1, BswMActionListItemRef=BswMModeControl/ESH_Action_ComMCheckPendingRequests
            ESH_RunToPostRunNested: BswMActionListItemIndex=2, BswMActionListItemRef=BswMArbitration/ESH_RunToPostRunNested
            ESH_Action_ExitExclusiveArea: BswMActionListItemIndex=3, BswMActionListItemRef=BswMModeControl/ESH_Action_ExitExclusiveArea
        ESH_Action_EnterExclusiveArea (BswMAction)
          BswMAvailableActions
            BswMUserCallout: BswMUserCalloutFunction=SchM_Enter_BswM_BSWM_EXCLUSIVE_AREA_0(), BswMCreateCallout=false, BswMUserIncludeFile=SchM_BswM.h
        ESH_Action_ComMCheckPendingRequests (BswMAction)
          BswMAvailableActions
            BswMUserCallout:
              BswMUserCalloutFunction = ESH_ComM_CheckPendingRequests()
              BswMCreateCallout = true
              BswMUserCode = ComM_StateType Connector_Fan_ECU_fbc5880ce1a0cdea_90249745 = COMM_NO_COM_NO_PENDING_REQUEST; (void)ComM_GetState(ComMConf_ComMChannel_Connector_Fan_ECU_fbc5880ce1a0cdea_90249745, &Connector_Fan_ECU_fbc5880ce1a0cdea_90249745); /* SBSW_BSWM_FCTCALL_LOCALVAR */ if(Connector_Fan_ECU_fbc5880ce1a0cdea_90249745 != COMM_NO_COM_NO_PENDING_REQUEST) { BswM_RequestMode(BSWM_GENERIC_ESH_ComMPendingRequests, BSWM_GENERICVALUE_ESH_ComMPendingRequests_ESH_COMM_PENDING_REQUEST); } else { BswM_RequestMode(BSWM_GENERIC_ESH_ComMPendingRequests, BSWM_GENERICVALUE_ESH_ComMPendingRequests_ESH_COMM_NO_REQUEST); }
        ESH_AL_RunToPostRun (BswMActionList): BswMActionListExecution=BSWM_CONDITION
          5 x BswMActionListItem, all with BswMAbortOnFail=false:
            ESH_Action_EcuMClearValidatedWakeupEvents: BswMActionListItemIndex=1, BswMActionListItemRef=BswMModeControl/ESH_Action_EcuMClearValidatedWakeupEvents
            ESH_Action_ESH_PostRun: BswMActionListItemIndex=4, BswMActionListItemRef=BswMModeControl/ESH_Action_ESH_PostRun
            ESH_Action_OnEnterPostRun: BswMActionListItemIndex=2, BswMActionListItemRef=BswMModeControl/ESH_Action_OnEnterPostRun
            ESH_Action_ComMDisallow_Connector_Fan_ECU_fbc5880ce1a0cdea_90249745: BswMActionListItemIndex=0, BswMActionListItemRef=BswMModeControl/ESH_Action_ComMDisallow_Connector_Fan_ECU_fbc5880ce1a0cdea_90249745
            ESH_Action_SwitchPostRun: BswMActionListItemIndex=3, BswMActionListItemRef=BswMModeControl/ESH_Action_SwitchPostRun
        3 x BswMAction:
          ESH_Action_EcuMClearValidatedWakeupEvents
            BswMAvailableActions
              BswMUserCallout: BswMUserCalloutFunction=EcuM_ClearValidatedWakeupEvent(ECUM_WKSOURCE_ALL_SOURCES), BswMCreateCallout=false, BswMUserIncludeFile=EcuM.h
          ESH_Action_ESH_PostRun
            BswMAvailableActions
              BswMGenericModeSwitch: BswMGenericRequestRef=ESH_State, BswMGenericRequestModeRef=ESH_POST_RUN
          ESH_Action_ExitExclusiveArea
            BswMAvailableActions
              BswMUserCallout: BswMUserCalloutFunction=SchM_Exit_BswM_BSWM_EXCLUSIVE_AREA_0(), BswMCreateCallout=false, BswMUserIncludeFile=SchM_BswM.h
        ESH_AL_WaitForNvMToShutdown (BswMActionList): BswMActionListExecution=BSWM_CONDITION
          3 x BswMActionListItem, all with BswMAbortOnFail=false:
            ESH_Action_EcuMGoToSelectedShutdownTarget: BswMActionListItemIndex=2, BswMActionListItemRef=BswMModeControl/ESH_Action_EcuMGoToSelectedShutdownTarget
            ESH_Action_OnEnterShutdown: BswMActionListItemIndex=1, BswMActionListItemRef=BswMModeControl/ESH_Action_OnEnterShutdown
            ESH_Action_WriteAllTimer_Stop: BswMActionListItemIndex=0, BswMActionListItemRef=BswMModeControl/ESH_Action_WriteAllTimer_Stop
        ESH_Action_EcuMGoToSelectedShutdownTarget (BswMAction)
          BswMAvailableActions
            BswMUserCallout: BswMUserCalloutFunction=(void)EcuM_GoToSelectedShutdownTarget(), BswMCreateCallout=false, BswMUserIncludeFile=EcuM.h
        ESH_AL_WakeupToPrep (BswMActionList): BswMActionListExecution=BSWM_CONDITION
          3 x BswMActionListItem, all with BswMAbortOnFail=false:
            ESH_Action_ESH_PrepShutdown: BswMActionListItemIndex=2, BswMActionListItemRef=BswMModeControl/ESH_Action_ESH_PrepShutdown
            ESH_Action_OnEnterPrepShutdown: BswMActionListItemIndex=0, BswMActionListItemRef=BswMModeControl/ESH_Action_OnEnterPrepShutdown
            ESH_Action_SwitchShutdown: BswMActionListItemIndex=1, BswMActionListItemRef=BswMModeControl/ESH_Action_SwitchShutdown
        ESH_Action_ESH_PrepShutdown (BswMAction)
          BswMAvailableActions
            BswMGenericModeSwitch: BswMGenericRequestRef=ESH_State, BswMGenericRequestModeRef=ESH_PREP_SHUTDOWN
        ESH_AL_WaitForNvMWakeup (BswMActionList): BswMActionListExecution=BSWM_CONDITION
          6 x BswMActionListItem, all with BswMAbortOnFail=false:
            ESH_Action_ESH_Wakeup: BswMActionListItemIndex=5, BswMActionListItemRef=BswMModeControl/ESH_Action_ESH_Wakeup
            ESH_Action_OnEnterWakeup: BswMActionListItemIndex=3, BswMActionListItemRef=BswMModeControl/ESH_Action_OnEnterWakeup
            ESH_Action_WriteAllTimer_Stop: BswMActionListItemIndex=0, BswMActionListItemRef=BswMModeControl/ESH_Action_WriteAllTimer_Stop
            ESH_Action_CancelWriteAllTimer_Start: BswMActionListItemIndex=1, BswMActionListItemRef=BswMModeControl/ESH_Action_CancelWriteAllTimer_Start
            ESH_Action_CancelNvMWriteAll: BswMActionListItemIndex=2, BswMActionListItemRef=BswMModeControl/ESH_Action_CancelNvMWriteAll
            ESH_Action_SwitchWakeup: BswMActionListItemIndex=4, BswMActionListItemRef=BswMModeControl/ESH_Action_SwitchWakeup
        ESH_Action_ESH_Wakeup (BswMAction)
          BswMAvailableActions
            BswMGenericModeSwitch: BswMGenericRequestRef=ESH_State, BswMGenericRequestModeRef=ESH_WAKEUP
        ESH_AL_WakeupToRun (BswMActionList): BswMActionListExecution=BSWM_CONDITION
          7 x BswMActionListItem, all with BswMAbortOnFail=false:
            ESH_Action_SelfRunRequestTimer_Start: BswMActionListItemIndex=3, BswMActionListItemRef=BswMModeControl/ESH_Action_SelfRunRequestTimer_Start
            ESH_Action_ESH_Run: BswMActionListItemIndex=6, BswMActionListItemRef=BswMModeControl/ESH_Action_ESH_Run
            ESH_Action_OnEnterRun: BswMActionListItemIndex=4, BswMActionListItemRef=BswMModeControl/ESH_Action_OnEnterRun
            ESH_Action_ComMAllow_Connector_Fan_ECU_fbc5880ce1a0cdea_90249745: BswMActionListItemIndex=2, BswMActionListItemRef=BswMModeControl/ESH_Action_ComMAllow_Connector_Fan_ECU_fbc5880ce1a0cdea_90249745
            ESH_Action_CancelWriteAllTimer_Stop: BswMActionListItemIndex=0, BswMActionListItemRef=BswMModeControl/ESH_Action_CancelWriteAllTimer_Stop
            ESH_DemInit: BswMActionListItemIndex=1, BswMActionListItemRef=BswMArbitration/ESH_DemInit
            ESH_Action_SwitchRun: BswMActionListItemIndex=5, BswMActionListItemRef=BswMModeControl/ESH_Action_SwitchRun
        ESH_Action_SelfRunRequestTimer_Start (BswMAction)
          BswMAvailableActions
            BswMTimerControl: BswMTimerAction=BSWM_TIMER_START, BswMTimerValue=0.1, BswMTimerRef=ESH_SelfRunRequestTimer
        ESH_Action_ESH_Run (BswMAction)
          BswMAvailableActions
            BswMGenericModeSwitch: BswMGenericRequestRef=ESH_State, BswMGenericRequestModeRef=ESH_RUN
        5 x BswMActionList, all with BswMActionListExecution=BSWM_CONDITION:
          ESH_AL_InitToWakeup
            3 x BswMActionListItem, all with BswMAbortOnFail=false:
              ESH_Action_ESH_Wakeup: BswMActionListItemIndex=2, BswMActionListItemRef=BswMModeControl/ESH_Action_ESH_Wakeup
              ESH_Action_OnEnterWakeup: BswMActionListItemIndex=0, BswMActionListItemRef=BswMModeControl/ESH_Action_OnEnterWakeup
              ESH_Action_SwitchWakeup: BswMActionListItemIndex=1, BswMActionListItemRef=BswMModeControl/ESH_Action_SwitchWakeup
          ESH_AL_PostRunToPrepShutdown
            5 x BswMActionListItem, all with BswMAbortOnFail=false:
              ESH_Action_ESH_PrepShutdown: BswMActionListItemIndex=4, BswMActionListItemRef=BswMModeControl/ESH_Action_ESH_PrepShutdown
              ESH_Action_OnEnterPrepShutdown: BswMActionListItemIndex=2, BswMActionListItemRef=BswMModeControl/ESH_Action_OnEnterPrepShutdown
              ESH_Action_DemShutdown: BswMActionListItemIndex=0, BswMActionListItemRef=BswMModeControl/ESH_Action_DemShutdown
              ESH_Action_DemNotInitialized: BswMActionListItemIndex=1, BswMActionListItemRef=BswMModeControl/ESH_Action_DemNotInitialized
              ESH_Action_SwitchShutdown: BswMActionListItemIndex=3, BswMActionListItemRef=BswMModeControl/ESH_Action_SwitchShutdown
          ESH_AL_PostRunToRun
            5 x BswMActionListItem, all with BswMAbortOnFail=false:
              ESH_Action_SelfRunRequestTimer_Start: BswMActionListItemIndex=1, BswMActionListItemRef=BswMModeControl/ESH_Action_SelfRunRequestTimer_Start
              ESH_Action_ESH_Run: BswMActionListItemIndex=4, BswMActionListItemRef=BswMModeControl/ESH_Action_ESH_Run
              ESH_Action_OnEnterRun: BswMActionListItemIndex=2, BswMActionListItemRef=BswMModeControl/ESH_Action_OnEnterRun
              ESH_Action_ComMAllow_Connector_Fan_ECU_fbc5880ce1a0cdea_90249745: BswMActionListItemIndex=0, BswMActionListItemRef=BswMModeControl/ESH_Action_ComMAllow_Connector_Fan_ECU_fbc5880ce1a0cdea_90249745
              ESH_Action_SwitchRun: BswMActionListItemIndex=3, BswMActionListItemRef=BswMModeControl/ESH_Action_SwitchRun
          ESH_AL_ExitPostRun
            5 x BswMActionListItem, all with BswMAbortOnFail=false:
              ESH_Action_EnterExclusiveArea: BswMActionListItemIndex=0, BswMActionListItemRef=BswMModeControl/ESH_Action_EnterExclusiveArea
              ESH_Action_ComMCheckPendingRequests: BswMActionListItemIndex=1, BswMActionListItemRef=BswMModeControl/ESH_Action_ComMCheckPendingRequests
              ESH_PostRunNested: BswMActionListItemIndex=3, BswMActionListItemRef=BswMArbitration/ESH_PostRunNested
              ESH_Action_ExitExclusiveArea: BswMActionListItemIndex=4, BswMActionListItemRef=BswMModeControl/ESH_Action_ExitExclusiveArea
              ESH_Action_DemPostRunRequested: BswMActionListItemIndex=2, BswMActionListItemRef=BswMModeControl/ESH_Action_DemPostRunRequested
          ESH_AL_PrepShutdownToWaitForNvM
            5 x BswMActionListItem, all with BswMAbortOnFail=false:
              ESH_Action_ComMCheckPendingRequests: BswMActionListItemIndex=2, BswMActionListItemRef=BswMModeControl/ESH_Action_ComMCheckPendingRequests
              ESH_Action_ESH_WaitForNvm: BswMActionListItemIndex=4, BswMActionListItemRef=BswMModeControl/ESH_Action_ESH_WaitForNvm
              ESH_Action_OnEnterWaitForNvm: BswMActionListItemIndex=3, BswMActionListItemRef=BswMModeControl/ESH_Action_OnEnterWaitForNvm
              ESH_Action_WriteAllTimer_Start: BswMActionListItemIndex=0, BswMActionListItemRef=BswMModeControl/ESH_Action_WriteAllTimer_Start
              ESH_Action_NvMWriteAll: BswMActionListItemIndex=1, BswMActionListItemRef=BswMModeControl/ESH_Action_NvMWriteAll
        ESH_Action_ESH_WaitForNvm (BswMAction)
          BswMAvailableActions
            BswMGenericModeSwitch: BswMGenericRequestRef=ESH_State, BswMGenericRequestModeRef=ESH_WAIT_FOR_NVM
        INIT_AL_Initialize (BswMActionList): BswMActionListExecution=BSWM_CONDITION
          25 x BswMActionListItem, all with BswMAbortOnFail=false:
            INIT_Action_ComM_PreInit: BswMActionListItemIndex=1, BswMActionListItemRef=BswMModeControl/INIT_Action_ComM_PreInit
            INIT_Action_Nm_PreInit: BswMActionListItemIndex=2, BswMActionListItemRef=BswMModeControl/INIT_Action_Nm_PreInit
            INIT_Action_PduR_PreInit: BswMActionListItemIndex=3, BswMActionListItemRef=BswMModeControl/INIT_Action_PduR_PreInit
            INIT_Action_Mcu_Init: BswMActionListItemIndex=5, BswMActionListItemRef=BswMModeControl/INIT_Action_Mcu_Init
            INIT_Action_Can_Init: BswMActionListItemIndex=7, BswMActionListItemRef=BswMModeControl/INIT_Action_Can_Init
            INIT_Action_CanIf_Init: BswMActionListItemIndex=8, BswMActionListItemRef=BswMModeControl/INIT_Action_CanIf_Init
            INIT_Action_Com_Init: BswMActionListItemIndex=10, BswMActionListItemRef=BswMModeControl/INIT_Action_Com_Init
            INIT_Action_PduR_Init: BswMActionListItemIndex=11, BswMActionListItemRef=BswMModeControl/INIT_Action_PduR_Init
            INIT_Action_CanSM_Init: BswMActionListItemIndex=12, BswMActionListItemRef=BswMModeControl/INIT_Action_CanSM_Init
            INIT_Action_CanNm_Init: BswMActionListItemIndex=13, BswMActionListItemRef=BswMModeControl/INIT_Action_CanNm_Init
            INIT_Action_Nm_Init: BswMActionListItemIndex=14, BswMActionListItemRef=BswMModeControl/INIT_Action_Nm_Init
            INIT_Action_EnableInterrupts: BswMActionListItemIndex=18, BswMActionListItemRef=BswMModeControl/INIT_Action_EnableInterrupts
            INIT_Action_ComM_Init: BswMActionListItemIndex=19, BswMActionListItemRef=BswMModeControl/INIT_Action_ComM_Init
            INIT_Action_ComM_PostInit: BswMActionListItemIndex=22, BswMActionListItemRef=BswMModeControl/INIT_Action_ComM_PostInit
            INIT_Action_Nm_PostInit: BswMActionListItemIndex=23, BswMActionListItemRef=BswMModeControl/INIT_Action_Nm_PostInit
            INIT_Action_Rte_Start: BswMActionListItemIndex=24, BswMActionListItemRef=BswMModeControl/INIT_Action_Rte_Start
            INIT_Action_Dem_PreInit: BswMActionListItemIndex=0, BswMActionListItemRef=BswMModeControl/INIT_Action_Dem_PreInit
            INIT_Action_Fls_Init: BswMActionListItemIndex=4, BswMActionListItemRef=BswMModeControl/INIT_Action_Fls_Init
            INIT_Action_Fee_Init: BswMActionListItemIndex=9, BswMActionListItemRef=BswMModeControl/INIT_Action_Fee_Init
            INIT_Action_CanTp_Init: BswMActionListItemIndex=15, BswMActionListItemRef=BswMModeControl/INIT_Action_CanTp_Init
            INIT_Action_NvM_Init: BswMActionListItemIndex=16, BswMActionListItemRef=BswMModeControl/INIT_Action_NvM_Init
            INIT_Action_NvMReadAll: BswMActionListItemIndex=17, BswMActionListItemRef=BswMModeControl/INIT_Action_NvMReadAll
            INIT_Action_Dcm_Init: BswMActionListItemIndex=20, BswMActionListItemRef=BswMModeControl/INIT_Action_Dcm_Init
            INIT_Action_Dem_Init: BswMActionListItemIndex=21, BswMActionListItemRef=BswMModeControl/INIT_Action_Dem_Init
            INIT_Action_Pwm_Init: BswMActionListItemIndex=6, BswMActionListItemRef=BswMModeControl/INIT_Action_Pwm_Init
        22 x BswMAction:
          INIT_Action_ComM_PreInit
            BswMAvailableActions
              BswMUserCallout: BswMUserCalloutFunction=ComM_PreInit(ComM_Config_Ptr), BswMCreateCallout=false, BswMUserIncludeFile=ComM.h
          INIT_Action_Nm_PreInit
            BswMAvailableActions
              BswMUserCallout: BswMUserCalloutFunction=Nm_PreInit(Nm_Config_Ptr), BswMCreateCallout=false, BswMUserIncludeFile=Nm.h
          INIT_Action_PduR_PreInit
            BswMAvailableActions
              BswMUserCallout: BswMUserCalloutFunction=PduR_PreInit(PduR_Config_Ptr), BswMCreateCallout=false, BswMUserIncludeFile=PduR.h
          INIT_Action_Mcu_Init
            BswMAvailableActions
              BswMUserCallout: BswMUserCalloutFunction=Mcu_Init(McuModuleConfiguration), BswMCreateCallout=false, BswMUserIncludeFile=Mcu.h
          INIT_Action_Can_Init
            BswMAvailableActions
              BswMUserCallout: BswMUserCalloutFunction=Can_Init(Can_Config_Ptr), BswMCreateCallout=false, BswMUserIncludeFile=Can.h
          INIT_Action_CanIf_Init
            BswMAvailableActions
              BswMUserCallout: BswMUserCalloutFunction=CanIf_Init(CanIf_Config_Ptr), BswMCreateCallout=false, BswMUserIncludeFile=CanIf.h
          INIT_Action_Com_Init
            BswMAvailableActions
              BswMUserCallout: BswMUserCalloutFunction=Com_Init(Com_Config_Ptr), BswMCreateCallout=false, BswMUserIncludeFile=Com.h
          INIT_Action_PduR_Init
            BswMAvailableActions
              BswMUserCallout: BswMUserCalloutFunction=PduR_Init(PduR_Config_Ptr), BswMCreateCallout=false, BswMUserIncludeFile=PduR.h
          INIT_Action_CanSM_Init
            BswMAvailableActions
              BswMUserCallout: BswMUserCalloutFunction=CanSM_Init(CanSM_Config_Ptr), BswMCreateCallout=false, BswMUserIncludeFile=CanSM_EcuM.h
          INIT_Action_CanNm_Init
            BswMAvailableActions
              BswMUserCallout: BswMUserCalloutFunction=CanNm_Init(CanNm_Config_Ptr), BswMCreateCallout=false, BswMUserIncludeFile=CanNm.h
          INIT_Action_Nm_Init
            BswMAvailableActions
              BswMUserCallout: BswMUserCalloutFunction=Nm_Init(Nm_Config_Ptr), BswMCreateCallout=false, BswMUserIncludeFile=Nm.h
          INIT_Action_EnableInterrupts
            BswMAvailableActions
              BswMUserCallout: BswMUserCalloutFunction=BswM_AL_SetProgrammableInterrupts(), BswMCreateCallout=true
          INIT_Action_ComM_Init
            BswMAvailableActions
              BswMUserCallout: BswMUserCalloutFunction=ComM_Init(ComM_Config_Ptr), BswMCreateCallout=false, BswMUserIncludeFile=ComM.h
          INIT_Action_ComM_PostInit
            BswMAvailableActions
              BswMUserCallout: BswMUserCalloutFunction=ComM_PostInit(), BswMCreateCallout=false, BswMUserIncludeFile=ComM.h
          INIT_Action_Nm_PostInit
            BswMAvailableActions
              BswMUserCallout: BswMUserCalloutFunction=Nm_PostInit(), BswMCreateCallout=false, BswMUserIncludeFile=Nm.h
          INIT_Action_Rte_Start
            BswMAvailableActions
              BswMUserCallout: BswMUserCalloutFunction=Rte_Start(), BswMCreateCallout=false, BswMUserIncludeFile=Rte_Main.h
          ESH_Action_OnEnterPostRun
            BswMAvailableActions
              BswMUserCallout: BswMUserCalloutFunction=BswM_ESH_OnEnterPostRun(), BswMCreateCallout=true
          ESH_Action_OnEnterShutdown
            BswMAvailableActions
              BswMUserCallout: BswMUserCalloutFunction=BswM_ESH_OnEnterShutdown(), BswMCreateCallout=true
          ESH_Action_OnEnterPrepShutdown
            BswMAvailableActions
              BswMUserCallout: BswMUserCalloutFunction=BswM_ESH_OnEnterPrepShutdown(), BswMCreateCallout=true
          ESH_Action_OnEnterWakeup
            BswMAvailableActions
              BswMUserCallout: BswMUserCalloutFunction=BswM_ESH_OnEnterWakeup(), BswMCreateCallout=true
          ESH_Action_OnEnterRun
            BswMAvailableActions
              BswMUserCallout: BswMUserCalloutFunction=BswM_ESH_OnEnterRun(), BswMCreateCallout=true
          ESH_Action_OnEnterWaitForNvm
            BswMAvailableActions
              BswMUserCallout: BswMUserCalloutFunction=BswM_ESH_OnEnterWaitForNvm(), BswMCreateCallout=true
        ESH_AL_ESH_PostRunToPrepCheck (BswMActionList): BswMActionListExecution=BSWM_CONDITION
          ESH_PostRunToPrepNested (BswMActionListItem): BswMAbortOnFail=false, BswMActionListItemIndex=0, BswMActionListItemRef=BswMArbitration/ESH_PostRunToPrepNested
        ESH_Action_ComMDisallow_Connector_Fan_ECU_fbc5880ce1a0cdea_90249745 (BswMAction)
          BswMAvailableActions
            BswMComMAllowCom: BswMComAllowed=false, BswMComMAllowChannelRef=Connector_Fan_ECU_fbc5880ce1a0cdea_90249745
        ESH_Action_ComMAllow_Connector_Fan_ECU_fbc5880ce1a0cdea_90249745 (BswMAction)
          BswMAvailableActions
            BswMComMAllowCom: BswMComAllowed=true, BswMComMAllowChannelRef=Connector_Fan_ECU_fbc5880ce1a0cdea_90249745
        CC_AL_Connector_Fan_ECU_fbc5880ce1a0cdea_90249745_Disable_DM (BswMActionList): BswMActionListExecution=BSWM_TRIGGER
          CC_DisableDM_ComIPduGroupRx (BswMActionListItem): BswMAbortOnFail=false, BswMActionListItemIndex=0, BswMActionListItemRef=BswMModeControl/CC_DisableDM_ComIPduGroupRx
        CC_DisableDM_ComIPduGroupRx (BswMAction)
          BswMAvailableActions
            BswMDeadlineMonitoringControl: BswMDisabledDMPduGroupRef=ComIPduGroupRx
        CC_AL_Connector_Fan_ECU_fbc5880ce1a0cdea_90249745_Enable_DM (BswMActionList): BswMActionListExecution=BSWM_TRIGGER
          CC_EnableDM_ComIPduGroupRx (BswMActionListItem): BswMAbortOnFail=false, BswMActionListItemIndex=0, BswMActionListItemRef=BswMModeControl/CC_EnableDM_ComIPduGroupRx
        CC_EnableDM_ComIPduGroupRx (BswMAction)
          BswMAvailableActions
            BswMDeadlineMonitoringControl: BswMEnabledDMPduGroupRef=ComIPduGroupRx
        CC_AL_Connector_Fan_ECU_fbc5880ce1a0cdea_90249745_RX_Disable (BswMActionList): BswMActionListExecution=BSWM_TRIGGER
          CC_DisablePDUGroup_ComIPduGroupRx (BswMActionListItem): BswMAbortOnFail=false, BswMActionListItemIndex=0, BswMActionListItemRef=BswMModeControl/CC_DisablePDUGroup_ComIPduGroupRx
        CC_DisablePDUGroup_ComIPduGroupRx (BswMAction)
          BswMAvailableActions
            BswMPduGroupSwitch: BswMPduGroupSwitchReinit=false, BswMDisabledPduGroupRef=ComIPduGroupRx
        CC_AL_Connector_Fan_ECU_fbc5880ce1a0cdea_90249745_RX_EnableNoinit (BswMActionList): BswMActionListExecution=BSWM_TRIGGER
          CC_EnablePDUGroup_ComIPduGroupRx (BswMActionListItem): BswMAbortOnFail=false, BswMActionListItemIndex=0, BswMActionListItemRef=BswMModeControl/CC_EnablePDUGroup_ComIPduGroupRx
        CC_EnablePDUGroup_ComIPduGroupRx (BswMAction)
          BswMAvailableActions
            BswMPduGroupSwitch: BswMPduGroupSwitchReinit=false, BswMEnabledPduGroupRef=ComIPduGroupRx
        CC_AL_Connector_Fan_ECU_fbc5880ce1a0cdea_90249745_TX_Disable (BswMActionList): BswMActionListExecution=BSWM_TRIGGER
          CC_DisablePDUGroup_ComIPduGroupTx (BswMActionListItem): BswMAbortOnFail=false, BswMActionListItemIndex=0, BswMActionListItemRef=BswMModeControl/CC_DisablePDUGroup_ComIPduGroupTx
        CC_DisablePDUGroup_ComIPduGroupTx (BswMAction)
          BswMAvailableActions
            BswMPduGroupSwitch: BswMPduGroupSwitchReinit=false, BswMDisabledPduGroupRef=ComIPduGroupTx
        CC_AL_Connector_Fan_ECU_fbc5880ce1a0cdea_90249745_TX_EnableNoinit (BswMActionList): BswMActionListExecution=BSWM_TRIGGER
          CC_EnablePDUGroup_ComIPduGroupTx (BswMActionListItem): BswMAbortOnFail=false, BswMActionListItemIndex=0, BswMActionListItemRef=BswMModeControl/CC_EnablePDUGroup_ComIPduGroupTx
        10 x BswMAction:
          CC_EnablePDUGroup_ComIPduGroupTx
            BswMAvailableActions
              BswMPduGroupSwitch: BswMPduGroupSwitchReinit=false, BswMEnabledPduGroupRef=ComIPduGroupTx
          INIT_Action_Dem_PreInit
            BswMAvailableActions
              BswMUserCallout: BswMUserCalloutFunction=Dem_PreInit(Dem_Config_Ptr), BswMCreateCallout=false, BswMUserIncludeFile=Dem.h
          INIT_Action_Fls_Init
            BswMAvailableActions
              BswMUserCallout: BswMUserCalloutFunction=Fls_Init(FlsConfigSet), BswMCreateCallout=false, BswMUserIncludeFile=Fls.h
          INIT_Action_Fee_Init
            BswMAvailableActions
              BswMUserCallout: BswMUserCalloutFunction=Fee_Init(), BswMCreateCallout=false, BswMUserIncludeFile=Fee.h
          INIT_Action_CanTp_Init
            BswMAvailableActions
              BswMUserCallout: BswMUserCalloutFunction=CanTp_Init(CanTp_Config_Ptr), BswMCreateCallout=false, BswMUserIncludeFile=CanTp.h
          INIT_Action_NvM_Init
            BswMAvailableActions
              BswMUserCallout: BswMUserCalloutFunction=NvM_Init(), BswMCreateCallout=false, BswMUserIncludeFile=NvM.h
          INIT_Action_NvMReadAll
            BswMAvailableActions
              BswMUserCallout: BswMUserCalloutFunction=BswM_INIT_NvMReadAll(), BswMCreateCallout=true
          INIT_Action_Dcm_Init
            BswMAvailableActions
              BswMUserCallout: BswMUserCalloutFunction=Dcm_Init(NULL_PTR), BswMUserIncludeFile=Dcm.h, BswMCreateCallout=false
          INIT_Action_Dem_Init
            BswMAvailableActions
              BswMUserCallout: BswMUserCalloutFunction=Dem_Init(Dem_Config_Ptr), BswMCreateCallout=false, BswMUserIncludeFile=Dem.h
          ESH_Action_SwitchPostRun
            BswMAvailableActions
              BswMRteSwitch: BswMSwitchedMode=POSTRUN, BswMRteSwitchPortRef=ESH_ModeSwitch
        ESH_ModeSwitch (BswMSwitchPort): BswMModeSwitchInterfaceRef=BswM_MSI_ESH_Mode
        6 x BswMAction:
          ESH_Action_WriteAllTimer_Stop
            BswMAvailableActions
              BswMTimerControl: BswMTimerAction=BSWM_TIMER_STOP, BswMTimerValue=0, BswMTimerRef=ESH_NvM_WriteAllTimer
          ESH_Action_SwitchShutdown
            BswMAvailableActions
              BswMRteSwitch: BswMSwitchedMode=SHUTDOWN, BswMRteSwitchPortRef=ESH_ModeSwitch
          ESH_Action_CancelWriteAllTimer_Start
            BswMAvailableActions
              BswMTimerControl: BswMTimerAction=BSWM_TIMER_START, BswMTimerValue=60, BswMTimerRef=ESH_NvM_CancelWriteAllTimer
          ESH_Action_CancelNvMWriteAll
            BswMAvailableActions
              BswMUserCallout: BswMUserCalloutFunction=NvM_CancelWriteAll(), BswMCreateCallout=false, BswMUserIncludeFile=NvM.h
          ESH_Action_SwitchWakeup
            BswMAvailableActions
              BswMRteSwitch: BswMSwitchedMode=WAKEUP, BswMRteSwitchPortRef=ESH_ModeSwitch
          ESH_Action_CancelWriteAllTimer_Stop
            BswMAvailableActions
              BswMTimerControl: BswMTimerAction=BSWM_TIMER_STOP, BswMTimerValue=0, BswMTimerRef=ESH_NvM_CancelWriteAllTimer
        ESH_AL_DemInit (BswMActionList): BswMActionListExecution=BSWM_CONDITION
          ESH_Action_DemInit (BswMActionListItem): BswMAbortOnFail=false, BswMActionListItemIndex=0, BswMActionListItemRef=BswMModeControl/ESH_Action_DemInit
          ESH_Action_DemInitialized (BswMActionListItem): BswMAbortOnFail=false, BswMActionListItemIndex=1, BswMActionListItemRef=BswMModeControl/ESH_Action_DemInitialized
        9 x BswMAction:
          ESH_Action_DemInit
            BswMAvailableActions
              BswMUserCallout: BswMUserCalloutFunction=Dem_Init(Dem_Config_Ptr), BswMCreateCallout=false, BswMUserIncludeFile=Dem.h
          ESH_Action_DemInitialized
            BswMAvailableActions
              BswMGenericModeSwitch: BswMGenericRequestRef=ESH_DemInitStatus, BswMGenericRequestModeRef=DEM_INITIALIZED
          ESH_Action_SwitchRun
            BswMAvailableActions
              BswMRteSwitch: BswMSwitchedMode=RUN, BswMRteSwitchPortRef=ESH_ModeSwitch
          ESH_Action_DemShutdown
            BswMAvailableActions
              BswMUserCallout: BswMUserCalloutFunction=Dem_Shutdown(), BswMCreateCallout=false, BswMUserIncludeFile=Dem.h
          ESH_Action_DemNotInitialized
            BswMAvailableActions
              BswMGenericModeSwitch: BswMGenericRequestRef=ESH_DemInitStatus, BswMGenericRequestModeRef=DEM_NOT_INITIALIZED
          ESH_Action_DemPostRunRequested
            BswMAvailableActions
              BswMUserCallout:
                BswMUserCalloutFunction = ESH_Dem_PostRunRequested()
                BswMCreateCallout = true
                BswMUserIncludeFile = Dem.h
                BswMUserCode = boolean isRequested = FALSE; (void)Dem_PostRunRequested(&isRequested); /* SBSW_BSWM_FCTCALL_LOCALVAR */ if (isRequested == TRUE) { BswM_RequestMode(BSWM_GENERIC_ESH_DemPostRunRequested, BSWM_GENERICVALUE_ESH_DemPostRunRequested_TRUE); } else { BswM_RequestMode(BSWM_GENERIC_ESH_DemPostRunRequested, BSWM_GENERICVALUE_ESH_DemPostRunRequested_FALSE); }
          ESH_Action_WriteAllTimer_Start
            BswMAvailableActions
              BswMTimerControl: BswMTimerAction=BSWM_TIMER_START, BswMTimerValue=60, BswMTimerRef=ESH_NvM_WriteAllTimer
          ESH_Action_NvMWriteAll
            BswMAvailableActions
              BswMUserCallout: BswMUserCalloutFunction=NvM_WriteAll(), BswMCreateCallout=false, BswMUserIncludeFile=NvM.h
          INIT_Action_Pwm_Init
            BswMAvailableActions
              BswMUserCallout: BswMUserCalloutFunction=Pwm_Init(PwmChannelConfigSet), BswMCreateCallout=false, BswMUserIncludeFile=Pwm.h
      BswMDataTypeMappingSets: BswMDataTypeMappingSetRef=BswMMappingSet
      ESH_RunRequest (BswMRteModeDclGroup): BswMInitMode=RELEASED
        RELEASED (BswMRteMode): BswMModePhysicalValue=0
        REQUESTED (BswMRteMode): BswMModePhysicalValue=1
      ESH_Mode (BswMRteModeDclGroup): BswMInitMode=STARTUP
        5 x BswMRteMode:
          STARTUP: BswMModePhysicalValue=0
          RUN: BswMModePhysicalValue=1
          POSTRUN: BswMModePhysicalValue=2
          WAKEUP: BswMModePhysicalValue=3
          SHUTDOWN: BswMModePhysicalValue=4
  module config EcuM: implementation-config-variant=VARIANT-PRE-COMPILE, module-description=EcuM_Impl
    EcuMConfiguration
      EcuMFlexConfiguration: EcuMFlexModuleConfigurationRef=Can/CanConfigSet, EcuMNormalMcuModeRef=McuModuleConfiguration/NORMAL
        ECUM_CAUSE_UNKNOWN (EcuMShutdownCause): EcuMShutdownCauseId=0
        ECUM_RESET_IO (EcuMResetMode): EcuMResetModeId=2
        ECUM_RESET_MCU (EcuMResetMode): EcuMResetModeId=0
        ECUM_CAUSE_DCM (EcuMShutdownCause): EcuMShutdownCauseId=3
        ECUM_RESET_WAKEUP (EcuMResetMode): EcuMResetModeId=3
        ECUM_CAUSE_ECU_STATE (EcuMShutdownCause): EcuMShutdownCauseId=1
        ECUM_RESET_WDG (EcuMResetMode): EcuMResetModeId=1
        ECUM_CAUSE_WDGM (EcuMShutdownCause): EcuMShutdownCauseId=2
      EcuMCommonConfiguration: EcuMConfigConsistencyHash=1950889621082521077, EcuMDefaultAppMode=Os/OSDEFAULTAPPMODE, EcuMOSResource=Os/RES_SCHEDULER_OsCore0
        ECUM_WKSOURCE_POWER (EcuMWakeupSource): EcuMWakeupSourceId=0, EcuMValidationTimeout=0, EcuMCheckWakeupTimeout=0, EcuMWakeupSourcePolling=false
        EcuMDriverInitListOne
          BswM_PreInit (EcuMDriverInitItem): index=3, EcuMModuleID=BswM, EcuMModuleService=BswM_PreInit, EcuMModuleHeader=BswM.h
        3 x EcuMWakeupSource, all with EcuMValidationTimeout=0, EcuMCheckWakeupTimeout=0, EcuMWakeupSourcePolling=false:
          ECUM_WKSOURCE_INTERNAL_WDG: EcuMWakeupSourceId=3
          ECUM_WKSOURCE_INTERNAL_RESET: EcuMWakeupSourceId=2
          ECUM_WKSOURCE_RESET: EcuMWakeupSourceId=1
        EcuMDefaultShutdownTarget: EcuMDefaultState=EcuMStateOff
        EcuMDriverRestartList
        ECUM_WKSOURCE_EXTERNAL_WDG (EcuMWakeupSource): EcuMWakeupSourceId=4, EcuMValidationTimeout=0, EcuMCheckWakeupTimeout=0, EcuMWakeupSourcePolling=false
        EcuMDriverInitListZero
          14 x EcuMDriverInitItem:
            BswM_InitMemory: index=2, EcuMModuleID=BswM, EcuMModuleService=BswM_InitMemory, EcuMModuleHeader=BswM.h
            Can_InitMemory: index=12, EcuMModuleID=Can, EcuMModuleService=Can_InitMemory, EcuMModuleHeader=Can.h
            CanIf_InitMemory: index=11, EcuMModuleID=CanIf, EcuMModuleService=CanIf_InitMemory, EcuMModuleHeader=CanIf.h
            CanNm_InitMemory: index=5, EcuMModuleID=CanNm, EcuMModuleService=CanNm_InitMemory, EcuMModuleHeader=CanNm.h
            CanSM_InitMemory: index=3, EcuMModuleID=CanSM, EcuMModuleService=CanSM_InitMemory, EcuMModuleHeader=CanSM_EcuM.h
            Com_InitMemory: index=7, EcuMModuleID=Com, EcuMModuleService=Com_InitMemory, EcuMModuleHeader=Com.h
            ComM_InitMemory: index=10, EcuMModuleID=ComM, EcuMModuleService=ComM_InitMemory, EcuMModuleHeader=ComM.h
            PduR_InitMemory: index=6, EcuMModuleID=PduR, EcuMModuleService=PduR_InitMemory, EcuMModuleHeader=PduR.h
            Rte_InitMemory: index=4, EcuMModuleID=Rte, EcuMModuleService=Rte_InitMemory, EcuMModuleHeader=Rte_Main.h
            Nm_InitMemory: index=9, EcuMModuleID=Nm, EcuMModuleService=Nm_InitMemory, EcuMModuleHeader=Nm.h
            Det_InitMemory: index=8, EcuMModuleID=Det, EcuMModuleService=Det_InitMemory, EcuMModuleHeader=Det.h
            Det_Init: index=1, EcuMModuleID=Det, EcuMModuleService=Det_Init, EcuMModuleHeader=Det.h
            Adc_Init: index=13, EcuMModuleID=Adc, EcuMModuleService=Adc_Init, EcuMModuleHeader=Adc.h
            Dem_InitMemory: index=15, EcuMModuleID=Dem, EcuMModuleService=Dem_InitMemory, EcuMModuleHeader=Dem.h
        ECUM_WKSOURCE_CAN (EcuMWakeupSource): EcuMWakeupSourceId=5, EcuMWakeupSourcePolling=false, EcuMComMChannelRef=Connector_Fan_ECU_fbc5880ce1a0cdea_90249745  # Connector_Fan_ECU_fbc5880ce1a0cdea
    EcuMGeneral:
      EcuMDevErrorDetect = true
      EcuMIncludeDem = true
      EcuMIncludeDet = true
      EcuMMainFunctionPeriod = 0.01
      EcuMVersionInfoApi = false
      EcuMDeferredBswMNotification = false
      EcuMSlaveCoreHandling = true
      EcuMEnableFixBehavior = false
      EcuMNonChannelWakeupInRun = false
      EcuMSchMStartInitialization = true
      EcuMSafeBswChecks = false
      EcuMGeneration: EcuMOutOfBoundsWriteSanitizer=false, EcuMOutOfBoundsReadSanitizer=false, EcuMInterfacesForDeactivatedData=false
    EcuMFlexGeneral: EcuMAlarmClockPresent=false
  module config CanIf: implementation-config-variant=VARIANT-PRE-COMPILE, module-description=CanIf_Impl
    CanIfCtrlDrvCfg_7d254554 (CanIfCtrlDrvCfg): CanIfCtrlDrvTxCancellation=false, CanIfCtrlDrvInitHohConfigRef=CanIfInitHohCfg, CanIfCtrlDrvNameRef=Can/CanGeneral
      Controller_Fan_ECU_02f7c8db915351a9_92c03ed2 (CanIfCtrlCfg):
        CanIfCtrlId = 0
        CanIfCtrlWakeupSupport = true
        CanIfCtrlJ1939DynAddrSupport = DISABLED
        CanIfCtrlCanCtrlRef = CanConfigSet/Controller_Fan_ECU_02f7c8db915351a9_92c03ed2
    CanIfDispatchCfg:
      CanIfDispatchUserCtrlBusOffName = CanSM_ControllerBusOff
      CanIfDispatchUserCtrlBusOffUL = CAN_SM
      CanIfDispatchUserCtrlModeIndicationName = CanSM_ControllerModeIndication
      CanIfDispatchUserCtrlModeIndicationUL = CAN_SM
      CanIfDispatchUserValidateWakeupEventUL = ECUM
      CanIfDispatchUserValidateWakeupEventName = EcuM_ValidateWakeupEvent
    CanIfInitCfg
      CanIfInitHohCfg: CanIfInitRefCfgSet=Can/CanConfigSet
        Connector_Fan_ECU_fbc5880ce1a0cdea_90249745_Tx (CanIfHthCfg):
          CanIfHthCanCtrlIdRef = CanIfCtrlDrvCfg_7d254554/Controller_Fan_ECU_02f7c8db915351a9_92c03ed2
          CanIfHthIdSymRef = CanConfigSet/Connector_Fan_ECU_fbc5880ce1a0cdea_90249745_Tx
        Connector_Fan_ECU_fbc5880ce1a0cdea_6fd0fec7_Rx (CanIfHrhCfg):
          CanIfHrhSoftwareFilter = true
          CanIfHrhCanCtrlIdRef = CanIfCtrlDrvCfg_7d254554/Controller_Fan_ECU_02f7c8db915351a9_92c03ed2
          CanIfHrhIdSymRef = CanConfigSet/Connector_Fan_ECU_fbc5880ce1a0cdea_6fd0fec7_Rx
      Comfort_Fan_Frame_PDU_ced33595_Tx (CanIfTxPduCfg):
        CanIfTxPduCanId = 2
        CanIfTxPduCanIdType = STANDARD_CAN
        CanIfTxPduDlc = 8
        CanIfTxPduUserTxConfirmationName = NULL_PTR
        CanIfTxPduUserTxConfirmationUL = NONE
        CanIfTxPduId = 2
        CanIfTxPduReadNotifyStatus = false
        CanIfTxPduType = STATIC
        CanIfTxPduTruncation = true
        CanIfTxPduBufferRef = CanIfInitCfg/CANChannel_213aa5c2
        CanIfTxPduRef = EcucPduCollection/Comfort_Fan_Frame_PDU_b6a0c8d2_Tx
      Comfort_HeadUnit_Frame_PDU_1743229a_Rx (CanIfRxPduCfg):
        CanIfRxPduCanId = 10
        CanIfRxPduCanIdType = STANDARD_CAN
        CanIfRxPduDlc = 8
        CanIfRxPduUserRxIndicationName = PduR_CanIfRxIndication
        CanIfRxPduUserRxIndicationUL = PDUR
        CanIfRxPduId = 0
        CanIfRxPduReadData = false
        CanIfRxPduReadNotifyStatus = false
        CanIfRxPduDlcCheck = true
        CanIfRxPduHrhIdRef = CanIfInitHohCfg/Connector_Fan_ECU_fbc5880ce1a0cdea_6fd0fec7_Rx
        CanIfRxPduRef = EcucPduCollection/Comfort_HeadUnit_Frame_PDU_80f4a911_Rx
      CANChannel_213aa5c2 (CanIfBufferCfg):
        CanIfBufferSize = 3
        CanIfTxBufferHandlingType = PRIO_BY_CANID
        CanIfTxBufferMappedTxPdus = 3
        CanIfTxBufferMaxPduLength = 8
        CanIfBufferHthRef = CanIfInitHohCfg/Connector_Fan_ECU_fbc5880ce1a0cdea_90249745_Tx
      Comfort_Fan_NM_PDU_Rx_dd66e2e4_Rx (CanIfRxPduCfg):
        CanIfRxPduCanId = 7
        CanIfRxPduCanIdType = STANDARD_CAN
        CanIfRxPduDlc = 8
        CanIfRxPduUserRxIndicationName = CanNm_RxIndication
        CanIfRxPduUserRxIndicationUL = CAN_NM
        CanIfRxPduId = 2
        CanIfRxPduReadData = false
        CanIfRxPduReadNotifyStatus = false
        CanIfRxPduDlcCheck = true
        CanIfRxPduHrhIdRef = CanIfInitHohCfg/Connector_Fan_ECU_fbc5880ce1a0cdea_6fd0fec7_Rx
        CanIfRxPduRef = Comfort_Fan_NM_PDU_Rx_68476f29_Rx
      Comfort_Fan_NM_PDU_Tx_3ac30fc9_Tx (CanIfTxPduCfg):
        CanIfTxPduCanId = 6
        CanIfTxPduCanIdType = STANDARD_CAN
        CanIfTxPduDlc = 8
        CanIfTxPduUserTxConfirmationName = CanNm_TxConfirmation
        CanIfTxPduUserTxConfirmationUL = CAN_NM
        CanIfTxPduId = 1
        CanIfTxPduReadNotifyStatus = false
        CanIfTxPduType = STATIC
        CanIfTxPduTruncation = true
        CanIfTxPduBufferRef = CanIfInitCfg/CANChannel_213aa5c2
        CanIfTxPduRef = Comfort_Fan_NM_PDU_Tx_3bb98271_Tx
      Comfort_TP_Diag_Response_Fan_ECU_Frame_PDU_550d529c_Tx (CanIfTxPduCfg):
        CanIfTxPduCanId = 8
        CanIfTxPduCanIdType = STANDARD_CAN
        CanIfTxPduDlc = 8
        CanIfTxPduUserTxConfirmationUL = CAN_TP
        CanIfTxPduId = 0
        CanIfTxPduReadNotifyStatus = false
        CanIfTxPduType = STATIC
        CanIfTxPduTruncation = true
        CanIfTxPduUserTxConfirmationName = CanTp_TxConfirmation
        CanIfTxPduBufferRef = CanIfInitCfg/CANChannel_213aa5c2
        CanIfTxPduRef = Comfort_TP_Diag_Response_Fan_ECU_Frame_PDU_44cf1fc1_Tx
      Comfort_TP_Diag_Request_Fan_ECU_Frame_PDU_91c512e3_Rx (CanIfRxPduCfg):
        CanIfRxPduCanId = 1
        CanIfRxPduCanIdType = STANDARD_CAN
        CanIfRxPduDlc = 8
        CanIfRxPduUserRxIndicationUL = CAN_TP
        CanIfRxPduId = 3
        CanIfRxPduReadData = false
        CanIfRxPduReadNotifyStatus = false
        CanIfRxPduUserRxIndicationName = CanTp_RxIndication
        CanIfRxPduDlcCheck = true
        CanIfRxPduUserRxIndicationType = PDUID_PDUINFOPTR
        CanIfRxPduHrhIdRef = CanIfInitHohCfg/Connector_Fan_ECU_fbc5880ce1a0cdea_6fd0fec7_Rx
        CanIfRxPduRef = Comfort_TP_Diag_Request_Fan_ECU_Frame_PDU_c4e708c3_Rx
      Comfort_DrivingCycle_Frame_PDU_1e43a3a1_Rx (CanIfRxPduCfg):
        CanIfRxPduCanId = 9
        CanIfRxPduCanIdType = STANDARD_CAN
        CanIfRxPduDlc = 8
        CanIfRxPduUserRxIndicationName = PduR_CanIfRxIndication
        CanIfRxPduUserRxIndicationUL = PDUR
        CanIfRxPduId = 1
        CanIfRxPduReadData = false
        CanIfRxPduReadNotifyStatus = false
        CanIfRxPduDlcCheck = true
        CanIfRxPduHrhIdRef = CanIfInitHohCfg/Connector_Fan_ECU_fbc5880ce1a0cdea_6fd0fec7_Rx
        CanIfRxPduRef = EcucPduCollection/Comfort_DrivingCycle_Frame_PDU_e1cdd903_Rx
    CanIfPrivateCfg:
      CanIfPrivateSoftwareFilterType = LINEAR
      CanIfPrivateDlcCheck = true
      CanIfSupportTTCAN = false
      CanIfTransceiverMapping = false
      CanIfTransceiverHandling = false
      CanIfSupportExtendedIds = false
      CanIfSupportNmOsek = false
      CanIfTxBufferType = BYTE_QUEUE
      CanIfWakeupSupport = true
      CanIfStaticFdTxBufferSupport = false
      CanIfRxSearchConsiderMsgType = false
      CanIfTxBufferFifoSupport = false
      CanIfSetPduReceptionModeSupport = false
      CanIfCheckWakeupCanRetType = false
      CanIfDataChecksumRxSupport = false
      CanIfDataChecksumTxSupport = false
    CanIfPublicCfg:
      CanIfPublicPnSupport = false
      CanIfPublicCancelTransmitSupport = false
      CanIfPublicDevErrorDetect = true
      CanIfPublicHandleTypeEnum = UINT8
      CanIfPublicMultipleDrvSupport = false
      CanIfPublicNumberOfCanHwUnits = 1
      CanIfPublicReadRxPduDataApi = false
      CanIfPublicReadRxPduNotifyStatusApi = false
      CanIfPublicReadTxPduNotifyStatusApi = false
      CanIfPublicSetDynamicTxIdApi = false
      CanIfPublicTxBuffering = true
      CanIfPublicTxConfirmPollingSupport = false
      CanIfPublicVersionInfoApi = false
      CanIfPublicWakeupCheckValidSupport = true
      CanIfPnWakeupTxPduFilterSupport = false
      CanIfPnTrcvHandlingSupport = false
      CanIfJ1939DynAddrSupport = DISABLED
      CanIfSafeBswChecks = true
      CanIfBusMirroringSupport = false
      CanIfEnableSecurityEventReporting = false
      CanIfSupportCanDrvAsr440 = false
      CanIfSupportMultipartition = false
      CanIfSetBaudrateApi = true
  module config PduR: implementation-config-variant=VARIANT-PRE-COMPILE, module-description=PduR_Impl
    PduRGeneral:
      PduRDevErrorDetect = true
      PduRVersionInfoApi = false
      PduRMetaDataSupport = false
      PduRPduCallback = false
      PduRSwitching = false
      PduRSafeBswChecks = true
      PduREnableDeferredTransmission = false
      PduREnableDeferredReception = false
      PduRSupportMulticore = false
      PduRRoutingTypeGateway = false
      PduRSpinlockRetryCounter = 4294967295
      PduRExtendedErrorChecks = false
      PduRGeneration:
        PduROutOfBoundsWriteProtectionStrategy = NONE
        PduROutOfBoundsWriteSanitizer = false
        PduROutOfBoundsReadSanitizer = false
        PduRNumericalDataTypeMinimizationStrategy = WITH_CAST
        PduRReduceConstantData2Define = false
        PduRBoolDataInArrayOfStructStrategy = BITMASKING
        PduRDeduplicateIndirectedData = true
        PduRDataDeduplicationStrategy = WITH_CAST
        PduRReduceBoolDataByNegationThreshold = 2
        PduRReduceBoolDataByNumericalComparisonThreshold = 2
        PduRReduceBoolDataByNumericalRelationThreshold = 2
        PduRReduceBoolDataByNumericalOperandStrategy = WITH_ANY_VALUE
        PduRReduceNumericalDataByOffsetThreshold = 2
        PduRReduceNumericalDataByArraySubtractionThreshold = 2
        PduRReduceDataByStreaming = false
        PduRShortSymbols = false
        PduRInterfacesForDeactivatedData = false
        PduRReferringKeysInComments = false
    PduRRoutingTables: PduRConfigurationId=0
      PduRRoutingTable
        5 x PduRRoutingPath, all with PduRMulticoreRoutingPath=false, PduRLockRef=PduRLock_PduRExclusiveArea:
          Comfort_Fan_Frame_PDU_68b7e774_Tx: PduRRoutingPathCommunicationType=COMMUNICATION_INTERFACE
            Comfort_Fan_Frame_PDU_b6a0c8d2_Tx (PduRDestPdu):
              PduRDestPduHandleId = 0
              PduRDestPduDirection = TRANSMIT
              PduRDestPduRoutingType = API_FORWARDING
              PduRDestPduDataProcessing = IMMEDIATE
              PduRPduLengthHandlingStrategy = IGNORE
              PduRDestPduCrossPartitionDestination = false
              PduRDestPduDataProvision = PDUR_DIRECT
              PduRTransmissionConfirmation = false
              PduRDestPduRef = EcucPduCollection/Comfort_Fan_Frame_PDU_b6a0c8d2_Tx
              PduRDestPduPduRBswModulesRef = PduR/CanIf
            PduRSrcPdu_2f70a27c (PduRSrcPdu):
              PduRSourcePduHandleId = 0
              PduRSrcPduDirection = TRANSMIT
              PduRSrcPduRef = EcucPduCollection/Comfort_Fan_Frame_PDU_68b7e774_Tx
              PduRSrcPduPduRBswModulesRef = PduR/Com
          Comfort_HeadUnit_Frame_PDU_80f4a911_Rx: PduRRoutingPathCommunicationType=COMMUNICATION_INTERFACE
            PduRSrcPdu_6fa907e0 (PduRSrcPdu):
              PduRSourcePduHandleId = 1
              PduRSrcPduDirection = RECEIVE
              PduRSrcPduRef = EcucPduCollection/Comfort_HeadUnit_Frame_PDU_80f4a911_Rx
              PduRSrcPduPduRBswModulesRef = PduR/CanIf
            Comfort_HeadUnit_Frame_PDU_80f4a911_Rx_6fa907e0_Rx (PduRDestPdu):
              PduRDestPduHandleId = 1
              PduRDestPduDirection = RECEIVE
              PduRDestPduRoutingType = API_FORWARDING
              PduRDestPduDataProcessing = IMMEDIATE
              PduRPduLengthHandlingStrategy = IGNORE
              PduRDestPduCrossPartitionDestination = false
              PduRTransmissionConfirmation = false
              PduRDestPduRef = EcucPduCollection/Comfort_HeadUnit_Frame_PDU_6df1e8d4_Rx
              PduRDestPduPduRBswModulesRef = PduR/Com
          Diag_Response_Fan_ECU_PDU_15224d29_Tx: PduRRoutingPathCommunicationType=TRANSPORT_PROTOCOL
            PduRSrcPdu_bca58b65 (PduRSrcPdu):
              PduRSourcePduHandleId = 1
              PduRSrcPduDirection = TRANSMIT
              PduRSrcPduRef = EcucPduCollection/Diag_Response_Fan_ECU_PDU_15224d29_Tx
              PduRSrcPduPduRBswModulesRef = PduR/Dcm
            Diag_Response_Fan_ECU_PDU_a20a679e_Tx (PduRDestPdu):
              PduRDestPduHandleId = 0
              PduRDestPduDirection = TRANSMIT
              PduRDestPduRoutingType = API_FORWARDING
              PduRDestPduDataProcessing = IMMEDIATE
              PduRPduLengthHandlingStrategy = UNUSED
              PduRDestPduCrossPartitionDestination = false
              PduRDestPduRef = EcucPduCollection/Diag_Response_Fan_ECU_PDU_a20a679e_Tx
              PduRDestPduPduRBswModulesRef = PduR/CanTp
          Diag_Request_Fan_ECU_PDU_96ea3459_Rx: PduRRoutingPathCommunicationType=TRANSPORT_PROTOCOL
            Diag_Request_Fan_ECU_PDU_96ea3459_Rx_00a881bb_Rx (PduRDestPdu):
              PduRDestPduHandleId = 0
              PduRDestPduDirection = RECEIVE
              PduRDestPduRoutingType = API_FORWARDING
              PduRDestPduDataProcessing = IMMEDIATE
              PduRPduLengthHandlingStrategy = UNUSED
              PduRDestPduCrossPartitionDestination = false
              PduRDestPduRef = Diag_Request_Fan_ECU_PDU_5809d877_Rx
              PduRDestPduPduRBswModulesRef = PduR/Dcm
            PduRSrcPdu_00a881bb (PduRSrcPdu):
              PduRSourcePduHandleId = 0
              PduRSrcPduDirection = RECEIVE
              PduRSrcPduRef = EcucPduCollection/Diag_Request_Fan_ECU_PDU_96ea3459_Rx
              PduRSrcPduPduRBswModulesRef = PduR/CanTp
          Comfort_DrivingCycle_Frame_PDU_e1cdd903_Rx: PduRRoutingPathCommunicationType=COMMUNICATION_INTERFACE
            Comfort_DrivingCycle_Frame_PDU_e1cdd903_Rx_eaa9fb24_Rx (PduRDestPdu):
              PduRDestPduHandleId = 0
              PduRDestPduDirection = RECEIVE
              PduRDestPduRoutingType = API_FORWARDING
              PduRDestPduDataProcessing = IMMEDIATE
              PduRPduLengthHandlingStrategy = IGNORE
              PduRDestPduCrossPartitionDestination = false
              PduRTransmissionConfirmation = false
              PduRDestPduRef = EcucPduCollection/Comfort_DrivingCycle_Frame_PDU_b08df3c0_Rx
              PduRDestPduPduRBswModulesRef = PduR/Com
            PduRSrcPdu_eaa9fb24 (PduRSrcPdu):
              PduRSourcePduHandleId = 0
              PduRSrcPduDirection = RECEIVE
              PduRSrcPduRef = EcucPduCollection/Comfort_DrivingCycle_Frame_PDU_e1cdd903_Rx
              PduRSrcPduPduRBswModulesRef = PduR/CanIf
      PduRLock_PduRExclusiveArea (PduRLock)
        PduRExclusiveArea: PduRExclusiveAreaId=0
    4 x PduRBswModules, all with PduRCancelReceive=false, PduRChangeParameterRequestApi=false, PduRTriggertransmit=false, PduRTxConfirmation=false:
      CanIf: PduRCancelTransmit=false, PduRCommunicationInterface=true, PduRLowerModule=true, PduRTransportProtocol=false, PduRUpperModule=false, PduRUseTag=false, PduRBswModuleRef=CanIf
      Com: PduRCancelTransmit=false, PduRCommunicationInterface=true, PduRLowerModule=false, PduRTransportProtocol=false, PduRUpperModule=true, PduRUseTag=false, PduRBswModuleRef=Com
      Dcm: PduRCancelTransmit=true, PduRCommunicationInterface=false, PduRLowerModule=false, PduRTransportProtocol=true, PduRUpperModule=true, PduRUseTag=true, PduRBswModuleRef=Dcm
      CanTp: PduRCancelTransmit=true, PduRCommunicationInterface=false, PduRLowerModule=true, PduRTransportProtocol=true, PduRUpperModule=false, PduRUseTag=false, PduRBswModuleRef=CanTp
  module config Rte: implementation-config-variant=VARIANT-PRE-COMPILE, module-description=Rte_Impl
    RteInitializationBehavior: RteInitializationStrategy=RTE_INITIALIZATION_STRATEGY_AT_DATA_DECLARATION, RteSectionInitializationPolicy=INIT
    RteGeneration:
      RteGenerationMode = COMPATIBILITY_MODE
      RteIocInteractionReturnValue = RTE_IOC
      RteValueRangeCheckEnabled = false
      RteCalibrationSupport = NONE
      RteCodeVendorId = 30
      RteDevErrorDetect = false
      RteDevErrorDetectUninit = false
      RteMeasurementSupport = false
      RteOptimizationMode = RUNTIME
      RteVfbTraceEnabled = false
      RteVttVfbTraceFunction = Rte_Vtt_Task_WaitEventRet
      RteVttVfbTraceFunction = Rte_Vtt_Task_Dispatch
    RteBswGeneral: RteSchMVersionInfoApi=false, RteUseComShadowSignalApi=false
    13 x RteBswModuleInstance:
      BswM: RteBswImplementationRef=BswM_Impl, RteBswModuleConfigurationRef=BswM
        BSWM_EXCLUSIVE_AREA_0 (RteBswExclusiveAreaImpl): RteExclusiveAreaImplMechanism=ALL_INTERRUPT_BLOCKING, RteBswExclusiveAreaRef=BSWM_EXCLUSIVE_AREA_0
        BswM_MainFunctionTimingEvent0 (RteBswEventToTaskMapping):
          RteBswImmediateRestart = false
          RteBswPositionInTask = 8
          RteBswEventRef = BswM_MainFunctionTimingEvent0
          RteBswMappedToTaskRef = Os/Main_Task
          RteBswUsedOsEventRef = Os/Rte_Ev_Cyclic2_Main_Task_0_10ms
          RteBswUsedOsAlarmRef = Os/Rte_Al_TE2_Main_Task_0_10ms
      Can: RteBswImplementationRef=Can_Impl, RteBswModuleConfigurationRef=Can
        3 x RteBswEventToTaskMapping, all with RteBswImmediateRestart=false, RteBswMappedToTaskRef=Os/Main_Task, RteBswUsedOsEventRef=Os/Rte_Ev_Cyclic2_Main_Task_0_10ms, RteBswUsedOsAlarmRef=Os/Rte_Al_TE2_Main_Task_0_10ms:
          Can_MainFunction_BusOffTimingEvent0: RteBswPositionInTask=15, RteBswEventRef=Can_MainFunction_BusOffTimingEvent0
          Can_MainFunction_WakeupTimingEvent0: RteBswPositionInTask=17, RteBswEventRef=Can_MainFunction_WakeupTimingEvent0
          Can_MainFunction_ModeTimingEvent0: RteBswPositionInTask=16, RteBswEventRef=Can_MainFunction_ModeTimingEvent0
        8 x RteBswExclusiveAreaImpl, all with RteExclusiveAreaImplMechanism=ALL_INTERRUPT_BLOCKING:
          CAN_EXCLUSIVE_AREA_{0..7}: RteBswExclusiveAreaRef=CAN_EXCLUSIVE_AREA_{0..7}
      CanIf: RteBswImplementationRef=CanIf_Impl, RteBswModuleConfigurationRef=CanIf
        8 x RteBswExclusiveAreaImpl, all with RteExclusiveAreaImplMechanism=ALL_INTERRUPT_BLOCKING:
          CANIF_EXCLUSIVE_AREA_{0..7}: RteBswExclusiveAreaRef=CANIF_EXCLUSIVE_AREA_{0..7}
      CanNm: RteBswImplementationRef=CanNm_Impl, RteBswModuleConfigurationRef=CanNm
        CanNm_MainFunctionTimingEvent0 (RteBswEventToTaskMapping):
          RteBswImmediateRestart = false
          RteBswPositionInTask = 7
          RteBswEventRef = CanNm_MainFunctionTimingEvent0
          RteBswMappedToTaskRef = Os/Main_Task
          RteBswUsedOsEventRef = Os/Rte_Ev_Cyclic2_Main_Task_0_10ms
          RteBswUsedOsAlarmRef = Os/Rte_Al_TE2_Main_Task_0_10ms
        8 x RteBswExclusiveAreaImpl, all with RteExclusiveAreaImplMechanism=ALL_INTERRUPT_BLOCKING:
          CANNM_EXCLUSIVE_AREA_{0..7}: RteBswExclusiveAreaRef=CANNM_EXCLUSIVE_AREA_{0..7}
      CanSM: RteBswImplementationRef=CanSM_Impl, RteBswModuleConfigurationRef=CanSM
        CanSM_MainFunctionTimingEvent0 (RteBswEventToTaskMapping):
          RteBswImmediateRestart = false
          RteBswPositionInTask = 6
          RteBswEventRef = CanSM_MainFunctionTimingEvent0
          RteBswMappedToTaskRef = Os/Main_Task
          RteBswUsedOsEventRef = Os/Rte_Ev_Cyclic2_Main_Task_0_10ms
          RteBswUsedOsAlarmRef = Os/Rte_Al_TE2_Main_Task_0_10ms
        6 x RteBswExclusiveAreaImpl, all with RteExclusiveAreaImplMechanism=ALL_INTERRUPT_BLOCKING:
          CANSM_EXCLUSIVE_AREA_{1..6}: RteBswExclusiveAreaRef=CANSM_EXCLUSIVE_AREA_{1..6}
      Com: RteBswImplementationRef=Com_Impl, RteBswModuleConfigurationRef=Com
        3 x RteBswExclusiveAreaImpl, all with RteExclusiveAreaImplMechanism=ALL_INTERRUPT_BLOCKING:
          COM_EXCLUSIVE_AREA_TX: RteBswExclusiveAreaRef=COM_EXCLUSIVE_AREA_TX
          COM_EXCLUSIVE_AREA_RX: RteBswExclusiveAreaRef=COM_EXCLUSIVE_AREA_RX
          COM_EXCLUSIVE_AREA_BOTH: RteBswExclusiveAreaRef=COM_EXCLUSIVE_AREA_BOTH
        Com_MainFunctionTx_ComMainFunctionTxTimingEvent0 (RteBswEventToTaskMapping):
          RteBswImmediateRestart = false
          RteBswPositionInTask = 1
          RteBswEventRef = Com_MainFunctionTx_ComMainFunctionTxTimingEvent0
          RteBswMappedToTaskRef = Os/Main_Task
          RteBswUsedOsEventRef = Os/Rte_Ev_Cyclic2_Main_Task_0_10ms
          RteBswUsedOsAlarmRef = Os/Rte_Al_TE2_Main_Task_0_10ms
        Com_MainFunctionRx_ComMainFunctionRxTimingEvent0 (RteBswEventToTaskMapping):
          RteBswImmediateRestart = false
          RteBswPositionInTask = 0
          RteBswEventRef = Com_MainFunctionRx_ComMainFunctionRxTimingEvent0
          RteBswMappedToTaskRef = Os/Main_Task
          RteBswUsedOsEventRef = Os/Rte_Ev_Cyclic2_Main_Task_0_10ms
          RteBswUsedOsAlarmRef = Os/Rte_Al_TE2_Main_Task_0_10ms
      ComM: RteBswImplementationRef=ComM_Impl, RteBswModuleConfigurationRef=ComM
        ComM_MainFunction_0TimingEvent0 (RteBswEventToTaskMapping):
          RteBswImmediateRestart = false
          RteBswPositionInTask = 4
          RteBswEventRef = ComM_MainFunction_0TimingEvent0
          RteBswMappedToTaskRef = Os/Main_Task
          RteBswUsedOsEventRef = Os/Rte_Ev_Cyclic2_Main_Task_0_20ms
          RteBswUsedOsAlarmRef = Os/Rte_Al_TE2_Main_Task_0_20ms
        8 x RteBswExclusiveAreaImpl:
          COMM_EXCLUSIVE_AREA_0: RteExclusiveAreaImplMechanism=ALL_INTERRUPT_BLOCKING, RteBswExclusiveAreaRef=COMM_EXCLUSIVE_AREA_0
          COMM_EXCLUSIVE_AREA_1: RteExclusiveAreaImplMechanism=ALL_INTERRUPT_BLOCKING, RteBswExclusiveAreaRef=COMM_EXCLUSIVE_AREA_1
          COMM_EXCLUSIVE_AREA_{2..7}: RteExclusiveAreaImplMechanism=NONE, RteBswExclusiveAreaRef=COMM_EXCLUSIVE_AREA_{2..7}
      ComXf: RteBswImplementationRef=ComXf_Impl, RteBswModuleConfigurationRef=ComXf
      Det: RteBswImplementationRef=Det_Impl, RteBswModuleConfigurationRef=Det
        DET_EXCLUSIVE_AREA_0 (RteBswExclusiveAreaImpl): RteExclusiveAreaImplMechanism=ALL_INTERRUPT_BLOCKING, RteBswExclusiveAreaRef=DET_EXCLUSIVE_AREA_0
      EcuM: RteBswImplementationRef=EcuM_Impl, RteBswModuleConfigurationRef=EcuM
        EcuM_MainFunctionTimingEvent0 (RteBswEventToTaskMapping):
          RteBswImmediateRestart = false
          RteBswPositionInTask = 3
          RteBswEventRef = EcuM_MainFunctionTimingEvent0
          RteBswMappedToTaskRef = Os/Main_Task
          RteBswUsedOsEventRef = Os/Rte_Ev_Cyclic2_Main_Task_0_10ms
          RteBswUsedOsAlarmRef = Os/Rte_Al_TE2_Main_Task_0_10ms
        4 x RteBswExclusiveAreaImpl, all with RteExclusiveAreaImplMechanism=ALL_INTERRUPT_BLOCKING:
          ECUM_EXCLUSIVE_AREA_{0..3}: RteBswExclusiveAreaRef=ECUM_EXCLUSIVE_AREA_{0..3}
      Nm: RteBswImplementationRef=Nm_Impl, RteBswModuleConfigurationRef=Nm
        4 x RteBswExclusiveAreaImpl, all with RteExclusiveAreaImplMechanism=ALL_INTERRUPT_BLOCKING:
          NM_EXCLUSIVE_AREA_{0..3}: RteBswExclusiveAreaRef=NM_EXCLUSIVE_AREA_{0..3}
      PduR: RteBswImplementationRef=PduR_Impl, RteBswModuleConfigurationRef=PduR
        PDUR_EXCLUSIVE_AREA_0 (RteBswExclusiveAreaImpl): RteExclusiveAreaImplMechanism=ALL_INTERRUPT_BLOCKING, RteBswExclusiveAreaRef=PDUR_EXCLUSIVE_AREA_0
      Rte: RteBswImplementationRef=Rte_Impl, RteBswModuleConfigurationRef=Rte
    3 x RteSwComponentInstance:
      Det_EcuSwComposition: RteSoftwareComponentInstanceRef=Det
      ComM_EcuSwComposition: RteSoftwareComponentInstanceRef=ComM
        13 x RteEventToTaskMapping, all with RteImmediateRestart=false:
          Timer_ComM_MainFunction_0: RtePositionInTask=4, RteEventRef=Timer_ComM_MainFunction_0, RteMappedToTaskRef=Os/Main_Task, RteUsedOsEventRef=Os/Rte_Ev_Cyclic2_Main_Task_0_20ms, RteUsedOsAlarmRef=Os/Rte_Al_TE2_Main_Task_0_20ms
          OpEventLimitECUToNoComMode_LimitECUToNoComMode_modeLimitation: RteEventRef=OpEventLimitECUToNoComMode_LimitECUToNoComMode_modeLimitation
          OpEventReadInhibitCounter_ReadInhibitCounter_modeLimitation: RteEventRef=OpEventReadInhibitCounter_ReadInhibitCounter_modeLimitation
          OpEventResetInhibitCounter_ResetInhibitCounter_modeLimitation: RteEventRef=OpEventResetInhibitCounter_ResetInhibitCounter_modeLimitation
          OpEventSetECUGroupClassification_SetECUGroupClassification_modeLimitation: RteEventRef=OpEventSetECUGroupClassification_SetECUGroupClassification_modeLimitation
          OpEventGetInhibitionStatus_GetInhibitionStatus_CL_Connector_Fan_ECU_fbc5880ce1a0cdea_90249745: RteEventRef=OpEventGetInhibitionStatus_GetInhibitionStatus_CL_Connector_Fan_ECU_fbc5880ce1a0cdea_90249745
          OpEventGetInhibitionStatus_GetInhibitionStatus_CW_Connector_Fan_ECU_fbc5880ce1a0cdea_90249745: RteEventRef=OpEventGetInhibitionStatus_GetInhibitionStatus_CW_Connector_Fan_ECU_fbc5880ce1a0cdea_90249745
          OpEventLimitChannelToNoComMode_LimitChannelToNoComMode_CL_Connector_Fan_ECU_fbc5880ce1a0cdea_90249745: RteEventRef=OpEventLimitChannelToNoComMode_LimitChannelToNoComMode_CL_Connector_Fan_ECU_fbc5880ce1a0cdea_90249745
          OpEventPreventWakeUp_PreventWakeUp_CW_Connector_Fan_ECU_fbc5880ce1a0cdea_90249745: RteEventRef=OpEventPreventWakeUp_PreventWakeUp_CW_Connector_Fan_ECU_fbc5880ce1a0cdea_90249745
          OpEventRequestComMode_RequestComMode_UR_Connector_Fan_ECU_fbc5880ce1a0cdea_1e36b570: RteEventRef=OpEventRequestComMode_RequestComMode_UR_Connector_Fan_ECU_fbc5880ce1a0cdea_1e36b570
          OpEventGetCurrentComMode_GetCurrentComMode_UR_Connector_Fan_ECU_fbc5880ce1a0cdea_1e36b570: RteEventRef=OpEventGetCurrentComMode_GetCurrentComMode_UR_Connector_Fan_ECU_fbc5880ce1a0cdea_1e36b570
          OpEventGetMaxComMode_GetMaxComMode_UR_Connector_Fan_ECU_fbc5880ce1a0cdea_1e36b570: RteEventRef=OpEventGetMaxComMode_GetMaxComMode_UR_Connector_Fan_ECU_fbc5880ce1a0cdea_1e36b570
          OpEventGetRequestedComMode_GetRequestedComMode_UR_Connector_Fan_ECU_fbc5880ce1a0cdea_1e36b570: RteEventRef=OpEventGetRequestedComMode_GetRequestedComMode_UR_Connector_Fan_ECU_fbc5880ce1a0cdea_1e36b570
      EcuM_EcuSwComposition: RteSoftwareComponentInstanceRef=EcuM
        8 x RteEventToTaskMapping, all with RteImmediateRestart=false:
          Timer_EcuM_MainFunction: RtePositionInTask=3, RteEventRef=Timer_EcuM_MainFunction, RteMappedToTaskRef=Os/Main_Task, RteUsedOsEventRef=Os/Rte_Ev_Cyclic2_Main_Task_0_10ms, RteUsedOsAlarmRef=Os/Rte_Al_TE2_Main_Task_0_10ms
          OpEventSelectShutdownTarget_SelectShutdownTarget_EcuM_ShutdownTarget: RteEventRef=OpEventSelectShutdownTarget_SelectShutdownTarget_EcuM_ShutdownTarget
          OpEventGetShutdownTarget_GetShutdownTarget_EcuM_ShutdownTarget: RteEventRef=OpEventGetShutdownTarget_GetShutdownTarget_EcuM_ShutdownTarget
          OpEventGetLastShutdownTarget_GetLastShutdownTarget_EcuM_ShutdownTarget: RteEventRef=OpEventGetLastShutdownTarget_GetLastShutdownTarget_EcuM_ShutdownTarget
          OpEventSelectShutdownCause_SelectShutdownCause_EcuM_ShutdownTarget: RteEventRef=OpEventSelectShutdownCause_SelectShutdownCause_EcuM_ShutdownTarget
          OpEventGetShutdownCause_GetShutdownCause_EcuM_ShutdownTarget: RteEventRef=OpEventGetShutdownCause_GetShutdownCause_EcuM_ShutdownTarget
          OpEventSelectBootTarget_SelectBootTarget_EcuM_BootTarget: RteEventRef=OpEventSelectBootTarget_SelectBootTarget_EcuM_BootTarget
          OpEventGetBootTarget_GetBootTarget_EcuM_BootTarget: RteEventRef=OpEventGetBootTarget_GetBootTarget_EcuM_BootTarget
    RteOsInteraction
      6 x RteUsedOsActivation, all with RteExpectedActivationOffset=0, RteExpectedTickDuration=0:
        Rte_Al_TE2_Main_Task_0_10ms: RteActivationOsAlarmRef=Os/Rte_Al_TE2_Main_Task_0_10ms, RteActivationOsTaskRef=Os/Main_Task
        Rte_Al_TE2_Main_Task_0_20ms: RteActivationOsAlarmRef=Os/Rte_Al_TE2_Main_Task_0_20ms, RteActivationOsTaskRef=Os/Main_Task
        Rte_Al_TE_Fee_Fee_MainFunction: RteActivationOsAlarmRef=Os/Rte_Al_TE_Fee_Fee_MainFunction, RteActivationOsTaskRef=Os/Main_Task
        Rte_Al_TE_CpApController_RCtApController_ReadSpeed: RteActivationOsAlarmRef=Os/Rte_Al_TE_CpApController_RCtApController_ReadSpeed, RteActivationOsTaskRef=Os/SpeedTask
        Rte_Al_TE_CpApController_RCtApController_ActuationControl: RteActivationOsAlarmRef=Os/Rte_Al_TE_CpApController_RCtApController_ActuationControl, RteActivationOsTaskRef=Os/Rte_Task
        Rte_Al_TE_CpApController_RCtApController_ErrorDetection: RteActivationOsAlarmRef=Os/Rte_Al_TE_CpApController_RCtApController_ErrorDetection, RteActivationOsTaskRef=Os/Rte_Task
    3 x RteSwComponentInstance:
      BswM_EcuSwComposition: RteSoftwareComponentInstanceRef=BswM
        Timer_BswM_MainFunction (RteEventToTaskMapping):
          RteImmediateRestart = false
          RtePositionInTask = 8
          RteEventRef = Timer_BswM_MainFunction
          RteMappedToTaskRef = Os/Main_Task
          RteUsedOsEventRef = Os/Rte_Ev_Cyclic2_Main_Task_0_10ms
          RteUsedOsAlarmRef = Os/Rte_Al_TE2_Main_Task_0_10ms
      CpCddIoHwAb_EcuSwComposition: RteSoftwareComponentInstanceRef=CpCddIoHwAb
        5 x RteEventToTaskMapping, all with RteImmediateRestart=false:
          OIT_RCtCddIoHwAb_PpPwmDcIoHwAb_SetDutyCycle_PpPwmDcIoHwAb_SetDutyCycle: RteEventRef=OIT_RCtCddIoHwAb_PpPwmDcIoHwAb_SetDutyCycle_PpPwmDcIoHwAb_SetDutyCycle
          OIT_RCtCddIoHwAb_PpPwmDeInitIoHwAb_Pwm_DeInit_PpPwmDeInitIoHwAb_Pwm_DeInit: RteEventRef=OIT_RCtCddIoHwAb_PpPwmDeInitIoHwAb_Pwm_DeInit_PpPwmDeInitIoHwAb_Pwm_DeInit
          OIT_RCtCddIoHwAb_PpPwmInitIoHwAb_Pwm_Init_PpPwmInitIoHwAb_Pwm_Init: RteEventRef=OIT_RCtCddIoHwAb_PpPwmInitIoHwAb_Pwm_Init_PpPwmInitIoHwAb_Pwm_Init
          CtCddIoHwAb_InitEvent: RtePositionInTask=0, RteEventRef=CtCddIoHwAb_InitEvent, RteMappedToTaskRef=Os/Io_Task
          OIT_RCtCddIoHwAb_PpAdcReadGroup_ReadGroup_PpAdcReadGroup_ReadGroup: RteEventRef=OIT_RCtCddIoHwAb_PpAdcReadGroup_ReadGroup_PpAdcReadGroup_ReadGroup
      CpApController_EcuSwComposition: RteSoftwareComponentInstanceRef=CpApController
        5 x RteEventToTaskMapping, all with RteImmediateRestart=false:
          TMT_Runnable: RtePositionInTask=1, RteEventRef=TMT_ActuationControl, RteMappedToTaskRef=Os/Rte_Task, RteUsedOsEventRef=Os/Rte_Ev_Run_CpApController_RCtApController_ActuationControl, RteUsedOsAlarmRef=Os/Rte_Al_TE_CpApController_RCtApController_ActuationControl
          CtApController_InitEvent: RtePositionInTask=0, RteEventRef=CtApController_InitEvent, RteMappedToTaskRef=Os/Rte_Task
          OIT_DataServices_Fan_Current_Power_Current_ConditionCheckRead_DataServices_Fan_Current_Power_Current_ConditionCheckRead: RteEventRef=OIT_DataServices_Fan_Current_Power_Current_ConditionCheckRead_DataServices_Fan_Current_Power_Current_ConditionCheckRead
          OIT_DataServices_Fan_Current_Power_Current_ReadData_DataServices_Fan_Current_Power_Current_ReadData: RteEventRef=OIT_DataServices_Fan_Current_Power_Current_ReadData_DataServices_Fan_Current_Power_Current_ReadData
          OIT_CBReadData_DID_0x2_Current_ReadData_CBReadData_DID_0x2_Current_ReadData: RteEventRef=OIT_CBReadData_DID_0x2_Current_ReadData_CBReadData_DID_0x2_Current_ReadData
        ExArFanCurrent (RteExclusiveAreaImplementation): RteExclusiveAreaImplMechanism=ALL_INTERRUPT_BLOCKING, RteExclusiveAreaRef=ExArFanCurrent
        NvmBlock_CpApController_SnNvMPimFanCurrentDid (RteNvRamAllocation):
          RteNvmRamBlockLocationSymbol = Rte_CpApController_PimFanCurrentDid
          RteNvmBlockRef = CpApControllerSnNvMPimFanCurrentDid
          RteSwNvRamMappingRef = SnNvMPimFanCurrentDid
        TMT_RCtApController_ReadSpeed (RteEventToTaskMapping):
          RteImmediateRestart = false
          RtePositionInTask = 0
          RteEventRef = TMT_RCtApController_ReadSpeed
          RteMappedToTaskRef = Os/SpeedTask
          RteUsedOsAlarmRef = Os/Rte_Al_TE_CpApController_RCtApController_ReadSpeed
        TMT_CtApController_ErrorDetection (RteEventToTaskMapping):
          RteImmediateRestart = false
          RteActivationOffset = 0.46
          RtePositionInTask = 2
          RteEventRef = TMT_CtApController_ErrorDetection
          RteMappedToTaskRef = Os/Rte_Task
          RteUsedOsEventRef = Os/Rte_Ev_Run_CpApController_RCtApController_ErrorDetection
          RteUsedOsAlarmRef = Os/Rte_Al_TE_CpApController_RCtApController_ErrorDetection
    CtCddIoHwAb (RteSwComponentType): RteComponentTypeRef=CtCddIoHwAb, RteImplementationRef=CtCddIoHwAb_Implementation
      ComponentTypeCalibration (RteComponentTypeCalibration): RteCalibrationSupportEnabled=false
    CtApController (RteSwComponentType): RteComponentTypeRef=CtApController, RteImplementationRef=CtApController_Implementation
      ComponentTypeCalibration (RteComponentTypeCalibration): RteCalibrationSupportEnabled=false
    3 x RteSwComponentInstance:
      DemMaster_0_EcuSwComposition: RteSoftwareComponentInstanceRef=DemMaster_0
        20 x RteEventToTaskMapping, all with RteImmediateRestart=false:
          Timer_Dem_MasterMainFunction: RtePositionInTask=9, RteEventRef=Timer_Dem_MasterMainFunction, RteMappedToTaskRef=Os/Main_Task, RteUsedOsEventRef=Os/Rte_Ev_Cyclic2_Main_Task_0_10ms, RteUsedOsAlarmRef=Os/Rte_Al_TE2_Main_Task_0_10ms
          OpEventPostRunRequested_GetPostRunRequested_DemServices: RteEventRef=OpEventPostRunRequested_GetPostRunRequested_DemServices
          OpEventGetDTCStatusAvailabilityMask_GetDTCStatusAvailabilityMask_DemServices: RteEventRef=OpEventGetDTCStatusAvailabilityMask_GetDTCStatusAvailabilityMask_DemServices
          OpEventClearDTC_ClearDTC_ClearDTC_DemClient: RteEventRef=OpEventClearDTC_ClearDTC_ClearDTC_DemClient
          OpEventSelectDTC_SelectDTC_ClearDTC_DemClient: RteEventRef=OpEventSelectDTC_SelectDTC_ClearDTC_DemClient
          OpEventGetEventMemoryOverflow_GetEventMemoryOverflow_OverflowIndPrimaryMemory_DemClient: RteEventRef=OpEventGetEventMemoryOverflow_GetEventMemoryOverflow_OverflowIndPrimaryMemory_DemClient
          OpEventGetNumberOfEventMemoryEntries_GetNumberOfEventMemoryEntries_OverflowIndPrimaryMemory_DemClient: RteEventRef=OpEventGetNumberOfEventMemoryEntries_GetNumberOfEventMemoryEntries_OverflowIndPrimaryMemory_DemClient
          OpEventGetEventUdsStatus_GetEventUdsStatus_GeneralEvtInfo: RteEventRef=OpEventGetEventUdsStatus_GetEventUdsStatus_GeneralEvtInfo
          OpEventGetEventStatus_GetEventStatus_GeneralEvtInfo: RteEventRef=OpEventGetEventStatus_GetEventStatus_GeneralEvtInfo
          OpEventGetEventFailed_GetEventFailed_GeneralEvtInfo: RteEventRef=OpEventGetEventFailed_GetEventFailed_GeneralEvtInfo
          OpEventGetEventTested_GetEventTested_GeneralEvtInfo: RteEventRef=OpEventGetEventTested_GetEventTested_GeneralEvtInfo
          OpEventGetDTCOfEvent_GetDTCOfEvent_GeneralEvtInfo: RteEventRef=OpEventGetDTCOfEvent_GetDTCOfEvent_GeneralEvtInfo
          OpEventGetFaultDetectionCounter_GetFaultDetectionCounter_GeneralEvtInfo: RteEventRef=OpEventGetFaultDetectionCounter_GetFaultDetectionCounter_GeneralEvtInfo
          OpEventGetEventFreezeFrameDataEx_GetEventFreezeFrameDataEx_GeneralEvtInfo: RteEventRef=OpEventGetEventFreezeFrameDataEx_GetEventFreezeFrameDataEx_GeneralEvtInfo
          OpEventGetEventExtendedDataRecordEx_GetEventExtendedDataRecordEx_GeneralEvtInfo: RteEventRef=OpEventGetEventExtendedDataRecordEx_GetEventExtendedDataRecordEx_GeneralEvtInfo
          OpEventGetEventEnableCondition_GetEventEnableCondition_GeneralEvtInfo: RteEventRef=OpEventGetEventEnableCondition_GetEventEnableCondition_GeneralEvtInfo
          OpEventGetDebouncingOfEvent_GetDebouncingOfEvent_GeneralEvtInfo: RteEventRef=OpEventGetDebouncingOfEvent_GetDebouncingOfEvent_GeneralEvtInfo
          OpEventGetMonitorStatus_GetMonitorStatus_GeneralEvtInfo: RteEventRef=OpEventGetMonitorStatus_GetMonitorStatus_GeneralEvtInfo
          OpEventGetOperationCycleState_GetOperationCycleState_OpCycle_OBD_driving_cycle: RteEventRef=OpEventGetOperationCycleState_GetOperationCycleState_OpCycle_OBD_driving_cycle
          OpEventSetOperationCycleState_SetOperationCycleState_OpCycle_OBD_driving_cycle: RteEventRef=OpEventSetOperationCycleState_SetOperationCycleState_OpCycle_OBD_driving_cycle
      DemSatellite_0_EcuSwComposition: RteSoftwareComponentInstanceRef=DemSatellite_0
        100 x RteEventToTaskMapping, all with RteImmediateRestart=false:
          Timer_Dem_SatelliteMainFunction: RtePositionInTask=10, RteEventRef=Timer_Dem_SatelliteMainFunction, RteMappedToTaskRef=Os/Main_Task, RteUsedOsEventRef=Os/Rte_Ev_Cyclic2_Main_Task_0_10ms, RteUsedOsAlarmRef=Os/Rte_Al_TE2_Main_Task_0_10ms
          OpEventGetEventUdsStatus_GetEventUdsStatus_EvtInfo_Mechanical_Fault_Unexpected_High_Current: RteEventRef=OpEventGetEventUdsStatus_GetEventUdsStatus_EvtInfo_Mechanical_Fault_Unexpected_High_Current
          OpEventGetEventUdsStatus_GetEventUdsStatus_Event_Mechanical_Fault_Unexpected_High_Current: RteEventRef=OpEventGetEventUdsStatus_GetEventUdsStatus_Event_Mechanical_Fault_Unexpected_High_Current
          OpEventGetEventUdsStatus_GetEventUdsStatus_EvtInfo_Electrical_Fault_Fan_Motor_Control_Circuit_Short: RteEventRef=OpEventGetEventUdsStatus_GetEventUdsStatus_EvtInfo_Electrical_Fault_Fan_Motor_Control_Circuit_Short
          OpEventGetEventUdsStatus_GetEventUdsStatus_Event_Electrical_Fault_Fan_Motor_Control_Circuit_Short: RteEventRef=OpEventGetEventUdsStatus_GetEventUdsStatus_Event_Electrical_Fault_Fan_Motor_Control_Circuit_Short
          OpEventGetEventUdsStatus_GetEventUdsStatus_EvtInfo_Mechanical_Fault_Unexpected_Low_Current: RteEventRef=OpEventGetEventUdsStatus_GetEventUdsStatus_EvtInfo_Mechanical_Fault_Unexpected_Low_Current
          OpEventGetEventUdsStatus_GetEventUdsStatus_Event_Mechanical_Fault_Unexpected_Low_Current: RteEventRef=OpEventGetEventUdsStatus_GetEventUdsStatus_Event_Mechanical_Fault_Unexpected_Low_Current
          OpEventGetEventUdsStatus_GetEventUdsStatus_EvtInfo_Electrical_Fault_Fan_Motor_Control_Circuit_Open: RteEventRef=OpEventGetEventUdsStatus_GetEventUdsStatus_EvtInfo_Electrical_Fault_Fan_Motor_Control_Circuit_Open
          OpEventGetEventUdsStatus_GetEventUdsStatus_Event_Electrical_Fault_Fan_Motor_Control_Circuit_Open: RteEventRef=OpEventGetEventUdsStatus_GetEventUdsStatus_Event_Electrical_Fault_Fan_Motor_Control_Circuit_Open
          OpEventGetEventUdsStatus_GetEventUdsStatus_GeneralEvtInfo: RteEventRef=OpEventGetEventUdsStatus_GetEventUdsStatus_GeneralEvtInfo
          OpEventGetEventStatus_GetEventStatus_EvtInfo_Mechanical_Fault_Unexpected_High_Current: RteEventRef=OpEventGetEventStatus_GetEventStatus_EvtInfo_Mechanical_Fault_Unexpected_High_Current
          OpEventGetEventStatus_GetEventStatus_Event_Mechanical_Fault_Unexpected_High_Current: RteEventRef=OpEventGetEventStatus_GetEventStatus_Event_Mechanical_Fault_Unexpected_High_Current
          OpEventGetEventStatus_GetEventStatus_EvtInfo_Electrical_Fault_Fan_Motor_Control_Circuit_Short: RteEventRef=OpEventGetEventStatus_GetEventStatus_EvtInfo_Electrical_Fault_Fan_Motor_Control_Circuit_Short
          OpEventGetEventStatus_GetEventStatus_Event_Electrical_Fault_Fan_Motor_Control_Circuit_Short: RteEventRef=OpEventGetEventStatus_GetEventStatus_Event_Electrical_Fault_Fan_Motor_Control_Circuit_Short
          OpEventGetEventStatus_GetEventStatus_EvtInfo_Mechanical_Fault_Unexpected_Low_Current: RteEventRef=OpEventGetEventStatus_GetEventStatus_EvtInfo_Mechanical_Fault_Unexpected_Low_Current
          OpEventGetEventStatus_GetEventStatus_Event_Mechanical_Fault_Unexpected_Low_Current: RteEventRef=OpEventGetEventStatus_GetEventStatus_Event_Mechanical_Fault_Unexpected_Low_Current
          OpEventGetEventStatus_GetEventStatus_EvtInfo_Electrical_Fault_Fan_Motor_Control_Circuit_Open: RteEventRef=OpEventGetEventStatus_GetEventStatus_EvtInfo_Electrical_Fault_Fan_Motor_Control_Circuit_Open
          OpEventGetEventStatus_GetEventStatus_Event_Electrical_Fault_Fan_Motor_Control_Circuit_Open: RteEventRef=OpEventGetEventStatus_GetEventStatus_Event_Electrical_Fault_Fan_Motor_Control_Circuit_Open
          OpEventGetEventStatus_GetEventStatus_GeneralEvtInfo: RteEventRef=OpEventGetEventStatus_GetEventStatus_GeneralEvtInfo
          OpEventGetEventFailed_GetEventFailed_EvtInfo_Mechanical_Fault_Unexpected_High_Current: RteEventRef=OpEventGetEventFailed_GetEventFailed_EvtInfo_Mechanical_Fault_Unexpected_High_Current
          OpEventGetEventFailed_GetEventFailed_Event_Mechanical_Fault_Unexpected_High_Current: RteEventRef=OpEventGetEventFailed_GetEventFailed_Event_Mechanical_Fault_Unexpected_High_Current
          OpEventGetEventFailed_GetEventFailed_EvtInfo_Electrical_Fault_Fan_Motor_Control_Circuit_Short: RteEventRef=OpEventGetEventFailed_GetEventFailed_EvtInfo_Electrical_Fault_Fan_Motor_Control_Circuit_Short
          OpEventGetEventFailed_GetEventFailed_Event_Electrical_Fault_Fan_Motor_Control_Circuit_Short: RteEventRef=OpEventGetEventFailed_GetEventFailed_Event_Electrical_Fault_Fan_Motor_Control_Circuit_Short
          OpEventGetEventFailed_GetEventFailed_EvtInfo_Mechanical_Fault_Unexpected_Low_Current: RteEventRef=OpEventGetEventFailed_GetEventFailed_EvtInfo_Mechanical_Fault_Unexpected_Low_Current
          OpEventGetEventFailed_GetEventFailed_Event_Mechanical_Fault_Unexpected_Low_Current: RteEventRef=OpEventGetEventFailed_GetEventFailed_Event_Mechanical_Fault_Unexpected_Low_Current
          OpEventGetEventFailed_GetEventFailed_EvtInfo_Electrical_Fault_Fan_Motor_Control_Circuit_Open: RteEventRef=OpEventGetEventFailed_GetEventFailed_EvtInfo_Electrical_Fault_Fan_Motor_Control_Circuit_Open
          OpEventGetEventFailed_GetEventFailed_Event_Electrical_Fault_Fan_Motor_Control_Circuit_Open: RteEventRef=OpEventGetEventFailed_GetEventFailed_Event_Electrical_Fault_Fan_Motor_Control_Circuit_Open
          OpEventGetEventFailed_GetEventFailed_GeneralEvtInfo: RteEventRef=OpEventGetEventFailed_GetEventFailed_GeneralEvtInfo
          OpEventGetEventTested_GetEventTested_EvtInfo_Mechanical_Fault_Unexpected_High_Current: RteEventRef=OpEventGetEventTested_GetEventTested_EvtInfo_Mechanical_Fault_Unexpected_High_Current
          OpEventGetEventTested_GetEventTested_Event_Mechanical_Fault_Unexpected_High_Current: RteEventRef=OpEventGetEventTested_GetEventTested_Event_Mechanical_Fault_Unexpected_High_Current
          OpEventGetEventTested_GetEventTested_EvtInfo_Electrical_Fault_Fan_Motor_Control_Circuit_Short: RteEventRef=OpEventGetEventTested_GetEventTested_EvtInfo_Electrical_Fault_Fan_Motor_Control_Circuit_Short
          OpEventGetEventTested_GetEventTested_Event_Electrical_Fault_Fan_Motor_Control_Circuit_Short: RteEventRef=OpEventGetEventTested_GetEventTested_Event_Electrical_Fault_Fan_Motor_Control_Circuit_Short
          OpEventGetEventTested_GetEventTested_EvtInfo_Mechanical_Fault_Unexpected_Low_Current: RteEventRef=OpEventGetEventTested_GetEventTested_EvtInfo_Mechanical_Fault_Unexpected_Low_Current
          OpEventGetEventTested_GetEventTested_Event_Mechanical_Fault_Unexpected_Low_Current: RteEventRef=OpEventGetEventTested_GetEventTested_Event_Mechanical_Fault_Unexpected_Low_Current
          OpEventGetEventTested_GetEventTested_EvtInfo_Electrical_Fault_Fan_Motor_Control_Circuit_Open: RteEventRef=OpEventGetEventTested_GetEventTested_EvtInfo_Electrical_Fault_Fan_Motor_Control_Circuit_Open
          OpEventGetEventTested_GetEventTested_Event_Electrical_Fault_Fan_Motor_Control_Circuit_Open: RteEventRef=OpEventGetEventTested_GetEventTested_Event_Electrical_Fault_Fan_Motor_Control_Circuit_Open
          OpEventGetEventTested_GetEventTested_GeneralEvtInfo: RteEventRef=OpEventGetEventTested_GetEventTested_GeneralEvtInfo
          OpEventGetDTCOfEvent_GetDTCOfEvent_EvtInfo_Mechanical_Fault_Unexpected_High_Current: RteEventRef=OpEventGetDTCOfEvent_GetDTCOfEvent_EvtInfo_Mechanical_Fault_Unexpected_High_Current
          OpEventGetDTCOfEvent_GetDTCOfEvent_Event_Mechanical_Fault_Unexpected_High_Current: RteEventRef=OpEventGetDTCOfEvent_GetDTCOfEvent_Event_Mechanical_Fault_Unexpected_High_Current
          OpEventGetDTCOfEvent_GetDTCOfEvent_EvtInfo_Electrical_Fault_Fan_Motor_Control_Circuit_Short: RteEventRef=OpEventGetDTCOfEvent_GetDTCOfEvent_EvtInfo_Electrical_Fault_Fan_Motor_Control_Circuit_Short
          OpEventGetDTCOfEvent_GetDTCOfEvent_Event_Electrical_Fault_Fan_Motor_Control_Circuit_Short: RteEventRef=OpEventGetDTCOfEvent_GetDTCOfEvent_Event_Electrical_Fault_Fan_Motor_Control_Circuit_Short
          OpEventGetDTCOfEvent_GetDTCOfEvent_EvtInfo_Mechanical_Fault_Unexpected_Low_Current: RteEventRef=OpEventGetDTCOfEvent_GetDTCOfEvent_EvtInfo_Mechanical_Fault_Unexpected_Low_Current
          OpEventGetDTCOfEvent_GetDTCOfEvent_Event_Mechanical_Fault_Unexpected_Low_Current: RteEventRef=OpEventGetDTCOfEvent_GetDTCOfEvent_Event_Mechanical_Fault_Unexpected_Low_Current
          OpEventGetDTCOfEvent_GetDTCOfEvent_EvtInfo_Electrical_Fault_Fan_Motor_Control_Circuit_Open: RteEventRef=OpEventGetDTCOfEvent_GetDTCOfEvent_EvtInfo_Electrical_Fault_Fan_Motor_Control_Circuit_Open
          OpEventGetDTCOfEvent_GetDTCOfEvent_Event_Electrical_Fault_Fan_Motor_Control_Circuit_Open: RteEventRef=OpEventGetDTCOfEvent_GetDTCOfEvent_Event_Electrical_Fault_Fan_Motor_Control_Circuit_Open
          OpEventGetDTCOfEvent_GetDTCOfEvent_GeneralEvtInfo: RteEventRef=OpEventGetDTCOfEvent_GetDTCOfEvent_GeneralEvtInfo
          OpEventGetFaultDetectionCounter_GetFaultDetectionCounter_EvtInfo_Mechanical_Fault_Unexpected_High_Current: RteEventRef=OpEventGetFaultDetectionCounter_GetFaultDetectionCounter_EvtInfo_Mechanical_Fault_Unexpected_High_Current
          OpEventGetFaultDetectionCounter_GetFaultDetectionCounter_Event_Mechanical_Fault_Unexpected_High_Current: RteEventRef=OpEventGetFaultDetectionCounter_GetFaultDetectionCounter_Event_Mechanical_Fault_Unexpected_High_Current
          OpEventGetFaultDetectionCounter_GetFaultDetectionCounter_EvtInfo_Electrical_Fault_Fan_Motor_Control_Circuit_Short: RteEventRef=OpEventGetFaultDetectionCounter_GetFaultDetectionCounter_EvtInfo_Electrical_Fault_Fan_Motor_Control_Circuit_Short
          OpEventGetFaultDetectionCounter_GetFaultDetectionCounter_Event_Electrical_Fault_Fan_Motor_Control_Circuit_Short: RteEventRef=OpEventGetFaultDetectionCounter_GetFaultDetectionCounter_Event_Electrical_Fault_Fan_Motor_Control_Circuit_Short
          OpEventGetFaultDetectionCounter_GetFaultDetectionCounter_EvtInfo_Mechanical_Fault_Unexpected_Low_Current: RteEventRef=OpEventGetFaultDetectionCounter_GetFaultDetectionCounter_EvtInfo_Mechanical_Fault_Unexpected_Low_Current
          OpEventGetFaultDetectionCounter_GetFaultDetectionCounter_Event_Mechanical_Fault_Unexpected_Low_Current: RteEventRef=OpEventGetFaultDetectionCounter_GetFaultDetectionCounter_Event_Mechanical_Fault_Unexpected_Low_Current
          OpEventGetFaultDetectionCounter_GetFaultDetectionCounter_EvtInfo_Electrical_Fault_Fan_Motor_Control_Circuit_Open: RteEventRef=OpEventGetFaultDetectionCounter_GetFaultDetectionCounter_EvtInfo_Electrical_Fault_Fan_Motor_Control_Circuit_Open
          OpEventGetFaultDetectionCounter_GetFaultDetectionCounter_Event_Electrical_Fault_Fan_Motor_Control_Circuit_Open: RteEventRef=OpEventGetFaultDetectionCounter_GetFaultDetectionCounter_Event_Electrical_Fault_Fan_Motor_Control_Circuit_Open
          OpEventGetFaultDetectionCounter_GetFaultDetectionCounter_GeneralEvtInfo: RteEventRef=OpEventGetFaultDetectionCounter_GetFaultDetectionCounter_GeneralEvtInfo
          OpEventGetEventFreezeFrameDataEx_GetEventFreezeFrameDataEx_EvtInfo_Mechanical_Fault_Unexpected_High_Current: RteEventRef=OpEventGetEventFreezeFrameDataEx_GetEventFreezeFrameDataEx_EvtInfo_Mechanical_Fault_Unexpected_High_Current
          OpEventGetEventFreezeFrameDataEx_GetEventFreezeFrameDataEx_Event_Mechanical_Fault_Unexpected_High_Current: RteEventRef=OpEventGetEventFreezeFrameDataEx_GetEventFreezeFrameDataEx_Event_Mechanical_Fault_Unexpected_High_Current
          OpEventGetEventFreezeFrameDataEx_GetEventFreezeFrameDataEx_EvtInfo_Electrical_Fault_Fan_Motor_Control_Circuit_Short: RteEventRef=OpEventGetEventFreezeFrameDataEx_GetEventFreezeFrameDataEx_EvtInfo_Electrical_Fault_Fan_Motor_Control_Circuit_Short
          OpEventGetEventFreezeFrameDataEx_GetEventFreezeFrameDataEx_Event_Electrical_Fault_Fan_Motor_Control_Circuit_Short: RteEventRef=OpEventGetEventFreezeFrameDataEx_GetEventFreezeFrameDataEx_Event_Electrical_Fault_Fan_Motor_Control_Circuit_Short
          OpEventGetEventFreezeFrameDataEx_GetEventFreezeFrameDataEx_EvtInfo_Mechanical_Fault_Unexpected_Low_Current: RteEventRef=OpEventGetEventFreezeFrameDataEx_GetEventFreezeFrameDataEx_EvtInfo_Mechanical_Fault_Unexpected_Low_Current
          OpEventGetEventFreezeFrameDataEx_GetEventFreezeFrameDataEx_Event_Mechanical_Fault_Unexpected_Low_Current: RteEventRef=OpEventGetEventFreezeFrameDataEx_GetEventFreezeFrameDataEx_Event_Mechanical_Fault_Unexpected_Low_Current
          OpEventGetEventFreezeFrameDataEx_GetEventFreezeFrameDataEx_EvtInfo_Electrical_Fault_Fan_Motor_Control_Circuit_Open: RteEventRef=OpEventGetEventFreezeFrameDataEx_GetEventFreezeFrameDataEx_EvtInfo_Electrical_Fault_Fan_Motor_Control_Circuit_Open
          OpEventGetEventFreezeFrameDataEx_GetEventFreezeFrameDataEx_Event_Electrical_Fault_Fan_Motor_Control_Circuit_Open: RteEventRef=OpEventGetEventFreezeFrameDataEx_GetEventFreezeFrameDataEx_Event_Electrical_Fault_Fan_Motor_Control_Circuit_Open
          OpEventGetEventFreezeFrameDataEx_GetEventFreezeFrameDataEx_GeneralEvtInfo: RteEventRef=OpEventGetEventFreezeFrameDataEx_GetEventFreezeFrameDataEx_GeneralEvtInfo
          OpEventGetEventExtendedDataRecordEx_GetEventExtendedDataRecordEx_EvtInfo_Mechanical_Fault_Unexpected_High_Current: RteEventRef=OpEventGetEventExtendedDataRecordEx_GetEventExtendedDataRecordEx_EvtInfo_Mechanical_Fault_Unexpected_High_Current
          OpEventGetEventExtendedDataRecordEx_GetEventExtendedDataRecordEx_Event_Mechanical_Fault_Unexpected_High_Current: RteEventRef=OpEventGetEventExtendedDataRecordEx_GetEventExtendedDataRecordEx_Event_Mechanical_Fault_Unexpected_High_Current
          OpEventGetEventExtendedDataRecordEx_GetEventExtendedDataRecordEx_EvtInfo_Electrical_Fault_Fan_Motor_Control_Circuit_Short: RteEventRef=OpEventGetEventExtendedDataRecordEx_GetEventExtendedDataRecordEx_EvtInfo_Electrical_Fault_Fan_Motor_Control_Circuit_Short
          OpEventGetEventExtendedDataRecordEx_GetEventExtendedDataRecordEx_Event_Electrical_Fault_Fan_Motor_Control_Circuit_Short: RteEventRef=OpEventGetEventExtendedDataRecordEx_GetEventExtendedDataRecordEx_Event_Electrical_Fault_Fan_Motor_Control_Circuit_Short
          OpEventGetEventExtendedDataRecordEx_GetEventExtendedDataRecordEx_EvtInfo_Mechanical_Fault_Unexpected_Low_Current: RteEventRef=OpEventGetEventExtendedDataRecordEx_GetEventExtendedDataRecordEx_EvtInfo_Mechanical_Fault_Unexpected_Low_Current
          OpEventGetEventExtendedDataRecordEx_GetEventExtendedDataRecordEx_Event_Mechanical_Fault_Unexpected_Low_Current: RteEventRef=OpEventGetEventExtendedDataRecordEx_GetEventExtendedDataRecordEx_Event_Mechanical_Fault_Unexpected_Low_Current
          OpEventGetEventExtendedDataRecordEx_GetEventExtendedDataRecordEx_EvtInfo_Electrical_Fault_Fan_Motor_Control_Circuit_Open: RteEventRef=OpEventGetEventExtendedDataRecordEx_GetEventExtendedDataRecordEx_EvtInfo_Electrical_Fault_Fan_Motor_Control_Circuit_Open
          OpEventGetEventExtendedDataRecordEx_GetEventExtendedDataRecordEx_Event_Electrical_Fault_Fan_Motor_Control_Circuit_Open: RteEventRef=OpEventGetEventExtendedDataRecordEx_GetEventExtendedDataRecordEx_Event_Electrical_Fault_Fan_Motor_Control_Circuit_Open
          OpEventGetEventExtendedDataRecordEx_GetEventExtendedDataRecordEx_GeneralEvtInfo: RteEventRef=OpEventGetEventExtendedDataRecordEx_GetEventExtendedDataRecordEx_GeneralEvtInfo
          OpEventGetEventEnableCondition_GetEventEnableCondition_EvtInfo_Mechanical_Fault_Unexpected_High_Current: RteEventRef=OpEventGetEventEnableCondition_GetEventEnableCondition_EvtInfo_Mechanical_Fault_Unexpected_High_Current
          OpEventGetEventEnableCondition_GetEventEnableCondition_EvtInfo_Electrical_Fault_Fan_Motor_Control_Circuit_Short: RteEventRef=OpEventGetEventEnableCondition_GetEventEnableCondition_EvtInfo_Electrical_Fault_Fan_Motor_Control_Circuit_Short
          OpEventGetEventEnableCondition_GetEventEnableCondition_EvtInfo_Mechanical_Fault_Unexpected_Low_Current: RteEventRef=OpEventGetEventEnableCondition_GetEventEnableCondition_EvtInfo_Mechanical_Fault_Unexpected_Low_Current
          OpEventGetEventEnableCondition_GetEventEnableCondition_EvtInfo_Electrical_Fault_Fan_Motor_Control_Circuit_Open: RteEventRef=OpEventGetEventEnableCondition_GetEventEnableCondition_EvtInfo_Electrical_Fault_Fan_Motor_Control_Circuit_Open
          OpEventGetEventEnableCondition_GetEventEnableCondition_GeneralEvtInfo: RteEventRef=OpEventGetEventEnableCondition_GetEventEnableCondition_GeneralEvtInfo
          OpEventGetDebouncingOfEvent_GetDebouncingOfEvent_EvtInfo_Mechanical_Fault_Unexpected_High_Current: RteEventRef=OpEventGetDebouncingOfEvent_GetDebouncingOfEvent_EvtInfo_Mechanical_Fault_Unexpected_High_Current
          OpEventGetDebouncingOfEvent_GetDebouncingOfEvent_EvtInfo_Electrical_Fault_Fan_Motor_Control_Circuit_Short: RteEventRef=OpEventGetDebouncingOfEvent_GetDebouncingOfEvent_EvtInfo_Electrical_Fault_Fan_Motor_Control_Circuit_Short
          OpEventGetDebouncingOfEvent_GetDebouncingOfEvent_EvtInfo_Mechanical_Fault_Unexpected_Low_Current: RteEventRef=OpEventGetDebouncingOfEvent_GetDebouncingOfEvent_EvtInfo_Mechanical_Fault_Unexpected_Low_Current
          OpEventGetDebouncingOfEvent_GetDebouncingOfEvent_EvtInfo_Electrical_Fault_Fan_Motor_Control_Circuit_Open: RteEventRef=OpEventGetDebouncingOfEvent_GetDebouncingOfEvent_EvtInfo_Electrical_Fault_Fan_Motor_Control_Circuit_Open
          OpEventGetDebouncingOfEvent_GetDebouncingOfEvent_GeneralEvtInfo: RteEventRef=OpEventGetDebouncingOfEvent_GetDebouncingOfEvent_GeneralEvtInfo
          OpEventGetMonitorStatus_GetMonitorStatus_EvtInfo_Mechanical_Fault_Unexpected_High_Current: RteEventRef=OpEventGetMonitorStatus_GetMonitorStatus_EvtInfo_Mechanical_Fault_Unexpected_High_Current
          OpEventGetMonitorStatus_GetMonitorStatus_EvtInfo_Electrical_Fault_Fan_Motor_Control_Circuit_Short: RteEventRef=OpEventGetMonitorStatus_GetMonitorStatus_EvtInfo_Electrical_Fault_Fan_Motor_Control_Circuit_Short
          OpEventGetMonitorStatus_GetMonitorStatus_EvtInfo_Mechanical_Fault_Unexpected_Low_Current: RteEventRef=OpEventGetMonitorStatus_GetMonitorStatus_EvtInfo_Mechanical_Fault_Unexpected_Low_Current
          OpEventGetMonitorStatus_GetMonitorStatus_EvtInfo_Electrical_Fault_Fan_Motor_Control_Circuit_Open: RteEventRef=OpEventGetMonitorStatus_GetMonitorStatus_EvtInfo_Electrical_Fault_Fan_Motor_Control_Circuit_Open
          OpEventGetMonitorStatus_GetMonitorStatus_GeneralEvtInfo: RteEventRef=OpEventGetMonitorStatus_GetMonitorStatus_GeneralEvtInfo
          OpEventSetEventStatus_SetEventStatus_Event_Mechanical_Fault_Unexpected_High_Current: RteEventRef=OpEventSetEventStatus_SetEventStatus_Event_Mechanical_Fault_Unexpected_High_Current
          OpEventSetEventStatus_SetEventStatus_Event_Electrical_Fault_Fan_Motor_Control_Circuit_Short: RteEventRef=OpEventSetEventStatus_SetEventStatus_Event_Electrical_Fault_Fan_Motor_Control_Circuit_Short
          OpEventSetEventStatus_SetEventStatus_Event_Mechanical_Fault_Unexpected_Low_Current: RteEventRef=OpEventSetEventStatus_SetEventStatus_Event_Mechanical_Fault_Unexpected_Low_Current
          OpEventSetEventStatus_SetEventStatus_Event_Electrical_Fault_Fan_Motor_Control_Circuit_Open: RteEventRef=OpEventSetEventStatus_SetEventStatus_Event_Electrical_Fault_Fan_Motor_Control_Circuit_Open
          OpEventResetEventStatus_ResetEventStatus_Event_Mechanical_Fault_Unexpected_High_Current: RteEventRef=OpEventResetEventStatus_ResetEventStatus_Event_Mechanical_Fault_Unexpected_High_Current
          OpEventResetEventStatus_ResetEventStatus_Event_Electrical_Fault_Fan_Motor_Control_Circuit_Short: RteEventRef=OpEventResetEventStatus_ResetEventStatus_Event_Electrical_Fault_Fan_Motor_Control_Circuit_Short
          OpEventResetEventStatus_ResetEventStatus_Event_Mechanical_Fault_Unexpected_Low_Current: RteEventRef=OpEventResetEventStatus_ResetEventStatus_Event_Mechanical_Fault_Unexpected_Low_Current
          OpEventResetEventStatus_ResetEventStatus_Event_Electrical_Fault_Fan_Motor_Control_Circuit_Open: RteEventRef=OpEventResetEventStatus_ResetEventStatus_Event_Electrical_Fault_Fan_Motor_Control_Circuit_Open
          OpEventResetEventDebounceStatus_ResetEventDebounceStatus_Event_Mechanical_Fault_Unexpected_High_Current: RteEventRef=OpEventResetEventDebounceStatus_ResetEventDebounceStatus_Event_Mechanical_Fault_Unexpected_High_Current
          OpEventResetEventDebounceStatus_ResetEventDebounceStatus_Event_Electrical_Fault_Fan_Motor_Control_Circuit_Short: RteEventRef=OpEventResetEventDebounceStatus_ResetEventDebounceStatus_Event_Electrical_Fault_Fan_Motor_Control_Circuit_Short
          OpEventResetEventDebounceStatus_ResetEventDebounceStatus_Event_Mechanical_Fault_Unexpected_Low_Current: RteEventRef=OpEventResetEventDebounceStatus_ResetEventDebounceStatus_Event_Mechanical_Fault_Unexpected_Low_Current
          OpEventResetEventDebounceStatus_ResetEventDebounceStatus_Event_Electrical_Fault_Fan_Motor_Control_Circuit_Open: RteEventRef=OpEventResetEventDebounceStatus_ResetEventDebounceStatus_Event_Electrical_Fault_Fan_Motor_Control_Circuit_Open
      NvM_EcuSwComposition: RteSoftwareComponentInstanceRef=NvM
        Timer_NvM_MainFunction (RteEventToTaskMapping):
          RteImmediateRestart = false
          RtePositionInTask = 13
          RteEventRef = Timer_NvM_MainFunction
          RteMappedToTaskRef = Os/Main_Task
          RteUsedOsEventRef = Os/Rte_Ev_Cyclic2_Main_Task_0_10ms
          RteUsedOsAlarmRef = Os/Rte_Al_TE2_Main_Task_0_10ms
    6 x RteBswModuleInstance:
      Fee: RteBswImplementationRef=Fee_Impl, RteBswModuleConfigurationRef=Fee
        Fee_MainFunctionTimingEvent0 (RteBswEventToTaskMapping):
          RteBswImmediateRestart = false
          RteBswPositionInTask = 11
          RteBswEventRef = Fee_MainFunctionTimingEvent0
          RteBswMappedToTaskRef = Os/Main_Task
          RteBswUsedOsEventRef = Os/Rte_Ev_Run_Fee_Fee_MainFunction
          RteBswUsedOsAlarmRef = Os/Rte_Al_TE_Fee_Fee_MainFunction
        FEE_EXCLUSIVE_AREA_0 (RteBswExclusiveAreaImpl): RteExclusiveAreaImplMechanism=ALL_INTERRUPT_BLOCKING, RteBswExclusiveAreaRef=FEE_EXCLUSIVE_AREA_0
      Fls: RteBswImplementationRef=Fls_Impl, RteBswModuleConfigurationRef=Fls
        Fls_MainFunctionTimingEvent0 (RteBswEventToTaskMapping):
          RteBswImmediateRestart = false
          RteBswPositionInTask = 12
          RteBswEventRef = Fls_MainFunctionTimingEvent0
          RteBswMappedToTaskRef = Os/Main_Task
          RteBswUsedOsEventRef = Os/Rte_Ev_Cyclic2_Main_Task_0_10ms
          RteBswUsedOsAlarmRef = Os/Rte_Al_TE2_Main_Task_0_10ms
      CanTp: RteBswImplementationRef=CanTp_Impl, RteBswModuleConfigurationRef=CanTp
        CanTp_MainFunctionTimingEvent0 (RteBswEventToTaskMapping):
          RteBswImmediateRestart = false
          RteBswPositionInTask = 18
          RteBswEventRef = CanTp_MainFunctionTimingEvent0
          RteBswMappedToTaskRef = Os/Main_Task
          RteBswUsedOsEventRef = Os/Rte_Ev_Cyclic2_Main_Task_0_10ms
          RteBswUsedOsAlarmRef = Os/Rte_Al_TE2_Main_Task_0_10ms
        CANTP_EXCLUSIVE_AREA_0 (RteBswExclusiveAreaImpl): RteExclusiveAreaImplMechanism=ALL_INTERRUPT_BLOCKING, RteBswExclusiveAreaRef=CANTP_EXCLUSIVE_AREA_0
      Dcm: RteBswImplementationRef=Dcm_Impl, RteBswModuleConfigurationRef=Dcm
        Dcm_MainFunctionTimingEvent0 (RteBswEventToTaskMapping):
          RteBswImmediateRestart = false
          RteBswPositionInTask = 19
          RteBswEventRef = Dcm_MainFunctionTimingEvent0
          RteBswMappedToTaskRef = Os/Main_Task
          RteBswUsedOsEventRef = Os/Rte_Ev_Cyclic2_Main_Task_0_10ms
          RteBswUsedOsAlarmRef = Os/Rte_Al_TE2_Main_Task_0_10ms
        DCM_EXCLUSIVE_AREA_0 (RteBswExclusiveAreaImpl): RteExclusiveAreaImplMechanism=ALL_INTERRUPT_BLOCKING, RteBswExclusiveAreaRef=DCM_EXCLUSIVE_AREA_0
      Dem: RteBswImplementationRef=Dem_Impl, RteBswModuleConfigurationRef=Dem
        Dem_MasterMainFunctionTimingEvent0 (RteBswEventToTaskMapping):
          RteBswImmediateRestart = false
          RteBswPositionInTask = 9
          RteBswEventRef = Dem_MasterMainFunctionTimingEvent0
          RteBswMappedToTaskRef = Os/Main_Task
          RteBswUsedOsEventRef = Os/Rte_Ev_Cyclic2_Main_Task_0_10ms
          RteBswUsedOsAlarmRef = Os/Rte_Al_TE2_Main_Task_0_10ms
        Dem_SatelliteMainFunctionTimingEvent0 (RteBswEventToTaskMapping):
          RteBswImmediateRestart = false
          RteBswPositionInTask = 10
          RteBswEventRef = Dem_SatelliteMainFunctionTimingEvent0
          RteBswMappedToTaskRef = Os/Main_Task
          RteBswUsedOsEventRef = Os/Rte_Ev_Cyclic2_Main_Task_0_10ms
          RteBswUsedOsAlarmRef = Os/Rte_Al_TE2_Main_Task_0_10ms
        5 x RteBswExclusiveAreaImpl, all with RteExclusiveAreaImplMechanism=ALL_INTERRUPT_BLOCKING:
          DEM_EXCLUSIVE_AREA_{0..4}: RteBswExclusiveAreaRef=DEM_EXCLUSIVE_AREA_{0..4}
      NvM: RteBswImplementationRef=NvM_Impl, RteBswModuleConfigurationRef=NvM
        NvM_MainFunctionTimingEvent0 (RteBswEventToTaskMapping):
          RteBswImmediateRestart = false
          RteBswPositionInTask = 13
          RteBswEventRef = NvM_MainFunctionTimingEvent0
          RteBswMappedToTaskRef = Os/Main_Task
          RteBswUsedOsEventRef = Os/Rte_Ev_Cyclic2_Main_Task_0_10ms
          RteBswUsedOsAlarmRef = Os/Rte_Al_TE2_Main_Task_0_10ms
        NVM_EXCLUSIVE_AREA_0 (RteBswExclusiveAreaImpl): RteExclusiveAreaImplMechanism=ALL_INTERRUPT_BLOCKING, RteBswExclusiveAreaRef=NVM_EXCLUSIVE_AREA_0
    Dcm_EcuSwComposition (RteSwComponentInstance): RteSoftwareComponentInstanceRef=Dcm
      7 x RteEventToTaskMapping, all with RteImmediateRestart=false:
        Timer_Dcm_MainFunction: RtePositionInTask=19, RteEventRef=Timer_Dcm_MainFunction, RteMappedToTaskRef=Os/Main_Task, RteUsedOsEventRef=Os/Rte_Ev_Cyclic2_Main_Task_0_10ms, RteUsedOsAlarmRef=Os/Rte_Al_TE2_Main_Task_0_10ms
        OpEventGetActiveProtocol_GetActiveProtocol_DCMServices: RteEventRef=OpEventGetActiveProtocol_GetActiveProtocol_DCMServices
        OpEventGetSesCtrlType_GetSesCtrlType_DCMServices: RteEventRef=OpEventGetSesCtrlType_GetSesCtrlType_DCMServices
        OpEventResetToDefaultSession_ResetToDefaultSession_DCMServices: RteEventRef=OpEventResetToDefaultSession_ResetToDefaultSession_DCMServices
        OpEventGetSecurityLevel_GetSecurityLevel_DCMServices: RteEventRef=OpEventGetSecurityLevel_GetSecurityLevel_DCMServices
        OpEventSetActiveDiagnostic_SetActiveDiagnostic_DCMServices: RteEventRef=OpEventSetActiveDiagnostic_SetActiveDiagnostic_DCMServices
        OpEventGetRequestKind_GetRequestKind_DCMServices: RteEventRef=OpEventGetRequestKind_GetRequestKind_DCMServices
  module config vSet: implementation-config-variant=VARIANT-PRE-COMPILE, module-description=vSet_Impl
    vSetCalibration
    vSetGeneral: vSetDummyStatementKind=SelfAssignment
    vSetPlatform:
      vSetByteOrder = LITTLE_ENDIAN
      vSetSizeOfROMPointer = Size32Bit
      vSetSizeOfRAMPointer = Size32Bit
      vSetSizeOfEnum = Size32Bit
      vSetCPUType = CPU32Bit
      vSetBitOrder = MSB_to_LSB
      vSetSizeOfInt = Size32Bit
    vSetBswInitialization
      47 x vSetInitFunction:
        BswM_PreInit: vSetHeader=BswM.h, vSetConfigType=BswM_ConfigType, vSetConfigPtrClass=BSWM_INIT_DATA, vSetModuleRef=BswM  # /ActiveEcuC/BswM PLAIN_TEXT PreInit function description of BswM in UnfilteredViewInInvariantProject (UnfilteredInvariantProjectModelView) .
          vSetInitFunctionInstance: vSetInitPhase=INIT_ONE, vSetConfigPtrName=BswM_Config_Ptr
        BswM_Init: vSetHeader=BswM.h, vSetConfigType=BswM_ConfigType, vSetConfigPtrClass=BSWM_INIT_DATA, vSetModuleRef=BswM  # /ActiveEcuC/BswM PLAIN_TEXT Init function description of BswM in UnfilteredViewInInvariantProject (UnfilteredInvariantProjectModelView) .
          vSetInitFunctionInstance: vSetInitPhase=NO_INIT, vSetConfigPtrName=BswM_Config_Ptr
        BswM_InitMemory: vSetHeader=BswM.h, vSetModuleRef=BswM  # /ActiveEcuC/BswM PLAIN_TEXT InitMemory function description of BswM in UnfilteredViewInInvariantProject (UnfilteredInvariantProjectModelView) .
          vSetInitFunctionInstance: vSetInitPhase=INIT_MEMORY
        CanIf_InitMemory: vSetHeader=CanIf.h, vSetModuleRef=CanIf  # /ActiveEcuC/CanIf PLAIN_TEXT InitMemory function description of CanIf in UnfilteredViewInInvariantProject (UnfilteredInvariantProjectModelView) .
          vSetInitFunctionInstance: vSetInitPhase=INIT_MEMORY
        CanIf_Init: vSetHeader=CanIf.h, vSetConfigType=CanIf_ConfigType, vSetConfigPtrClass=CANIF_INIT_DATA, vSetModuleRef=CanIf  # /ActiveEcuC/CanIf PLAIN_TEXT Init function description of CanIf in UnfilteredViewInInvariantProject (UnfilteredInvariantProjectModelView) .
          vSetInitFunctionInstance: vSetInitPhase=INIT_TWO_IF, vSetConfigPtrName=CanIf_Config_Ptr
        CanNm_InitMemory: vSetHeader=CanNm.h, vSetModuleRef=CanNm  # /ActiveEcuC/CanNm PLAIN_TEXT InitMemory function description of CanNm in UnfilteredViewInInvariantProject (UnfilteredInvariantProjectModelView) .
          vSetInitFunctionInstance: vSetInitPhase=INIT_MEMORY
        CanNm_Init: vSetHeader=CanNm.h, vSetConfigType=CanNm_ConfigType, vSetConfigPtrClass=CANNM_INIT_DATA, vSetModuleRef=CanNm  # /ActiveEcuC/CanNm PLAIN_TEXT Init function description of CanNm in UnfilteredViewInInvariantProject (UnfilteredInvariantProjectModelView) .
          vSetInitFunctionInstance: vSetInitPhase=INIT_TWO_NM, vSetConfigPtrName=CanNm_Config_Ptr
        CanSM_Init: vSetHeader=CanSM_EcuM.h, vSetConfigType=CanSM_ConfigType, vSetConfigPtrClass=CANSM_INIT_DATA, vSetModuleRef=CanSM  # /ActiveEcuC/CanSM PLAIN_TEXT Init function description of CanSM in UnfilteredViewInInvariantProject (UnfilteredInvariantProjectModelView) .
          vSetInitFunctionInstance: vSetInitPhase=INIT_TWO_SM, vSetConfigPtrName=CanSM_Config_Ptr
        CanSM_InitMemory: vSetHeader=CanSM_EcuM.h, vSetModuleRef=CanSM  # /ActiveEcuC/CanSM PLAIN_TEXT InitMemory function description of CanSM in UnfilteredViewInInvariantProject (UnfilteredInvariantProjectModelView) .
          vSetInitFunctionInstance: vSetInitPhase=INIT_MEMORY
        Can_InitMemory: vSetHeader=Can.h, vSetModuleRef=Can  # /ActiveEcuC/Can PLAIN_TEXT InitMemory function description of Can in UnfilteredViewInInvariantProject (UnfilteredInvariantProjectModelView) .
          vSetInitFunctionInstance: vSetInitPhase=INIT_MEMORY
        Can_Init: vSetHeader=Can.h, vSetConfigType=Can_ConfigType, vSetConfigPtrClass=CAN_INIT_DATA, vSetModuleRef=Can  # /ActiveEcuC/Can PLAIN_TEXT Init function description of Can in UnfilteredViewInInvariantProject (UnfilteredInvariantProjectModelView) .
          vSetInitFunctionInstance: vSetInitPhase=INIT_TWO_DRV, vSetConfigPtrName=Can_Config_Ptr
        ComM_PreInit: vSetHeader=ComM.h, vSetConfigType=ComM_ConfigType, vSetConfigPtrClass=COMM_INIT_DATA, vSetModuleRef=ComM  # /ActiveEcuC/ComM PLAIN_TEXT PreInit function description of ComM in UnfilteredViewInInvariantProject (UnfilteredInvariantProjectModelView) .
          vSetInitFunctionInstance: vSetInitPhase=INIT_ONE, vSetConfigPtrName=ComM_Config_Ptr
        ComM_InitMemory: vSetHeader=ComM.h, vSetModuleRef=ComM  # /ActiveEcuC/ComM PLAIN_TEXT InitMemory function description of ComM in UnfilteredViewInInvariantProject (UnfilteredInvariantProjectModelView) .
          vSetInitFunctionInstance: vSetInitPhase=INIT_MEMORY
        ComM_Init: vSetHeader=ComM.h, vSetConfigType=ComM_ConfigType, vSetConfigPtrClass=COMM_INIT_DATA, vSetModuleRef=ComM  # /ActiveEcuC/ComM PLAIN_TEXT Init function description of ComM in UnfilteredViewInInvariantProject (UnfilteredInvariantProjectModelView) .
          vSetInitFunctionInstance: vSetInitPhase=INIT_TWO_POST_NVMREADALL, vSetConfigPtrName=ComM_Config_Ptr
        ComM_PostInit: vSetHeader=ComM.h, vSetModuleRef=ComM  # /ActiveEcuC/ComM PLAIN_TEXT Post-Initialization of the ComM and its internal state machine
          vSetInitFunctionInstance: vSetInitPhase=INIT_THREE
        ComXf_Init: vSetHeader=ComXf.h, vSetModuleRef=ComXf  # /ActiveEcuC/ComXf PLAIN_TEXT Automatically generated by BswInitFctConfigurationService.
          vSetInitFunctionInstance: vSetInitPhase=NO_INIT
        Com_Init: vSetHeader=Com.h, vSetConfigType=Com_ConfigType, vSetConfigPtrClass=COM_INIT_DATA, vSetModuleRef=Com  # /ActiveEcuC/Com PLAIN_TEXT Init function description of Com in UnfilteredViewInInvariantProject (UnfilteredInvariantProjectModelView) .
          vSetInitFunctionInstance: vSetInitPhase=INIT_TWO_COM, vSetConfigPtrName=Com_Config_Ptr
        Com_InitMemory: vSetHeader=Com.h, vSetModuleRef=Com  # /ActiveEcuC/Com PLAIN_TEXT InitMemory function description of Com in UnfilteredViewInInvariantProject (UnfilteredInvariantProjectModelView) .
          vSetInitFunctionInstance: vSetInitPhase=INIT_MEMORY
        Det_InitMemory: vSetHeader=Det.h, vSetModuleRef=Det  # /ActiveEcuC/Det PLAIN_TEXT InitMemory function description of Det in UnfilteredViewInInvariantProject (UnfilteredInvariantProjectModelView) .
          vSetInitFunctionInstance: vSetInitPhase=INIT_MEMORY
        Det_Init: vSetHeader=Det.h, vSetConfigType=Det_ConfigType, vSetConfigPtrClass=DET_INIT_DATA, vSetModuleRef=Det  # /ActiveEcuC/Det PLAIN_TEXT Init function description of Det in UnfilteredViewInInvariantProject (UnfilteredInvariantProjectModelView) .
          vSetInitFunctionInstance: vSetInitPhase=INIT_ZERO, vSetConfigPtrName=Det_Config_Ptr
        EcuM_Init: vSetHeader=EcuM.h, vSetConfigType=EcuM_PbConfigType, vSetConfigPtrClass=ECUM_INIT_DATA, vSetModuleRef=EcuM  # /ActiveEcuC/EcuM PLAIN_TEXT Init function description of EcuM in UnfilteredViewInInvariantProject (UnfilteredInvariantProjectModelView) .
          vSetInitFunctionInstance: vSetInitPhase=NO_INIT, vSetConfigPtrName=EcuM_Config_Ptr
        Mcu_Init: vSetHeader=Mcu.h, vSetConfigType=Mcu_ConfigType, vSetConfigPtrClass=MCU_APPL_CONST, vSetModuleRef=Mcu  # /ActiveEcuC/Mcu PLAIN_TEXT Initialization of VttMcu Module
          vSetInitFunctionInstance: vSetInitPhase=INIT_TWO_MCAL, vSetConfigPtrName=McuModuleConfiguration
        Nm_Init: vSetHeader=Nm.h, vSetConfigType=Nm_ConfigType, vSetConfigPtrClass=NM_INIT_DATA, vSetModuleRef=Nm  # /ActiveEcuC/Nm PLAIN_TEXT Init function description of Nm in UnfilteredViewInInvariantProject (UnfilteredInvariantProjectModelView) .
          vSetInitFunctionInstance: vSetInitPhase=INIT_TWO_NM, vSetConfigPtrName=Nm_Config_Ptr
        Nm_PostInit: vSetHeader=Nm.h, vSetModuleRef=Nm  # /ActiveEcuC/Nm PLAIN_TEXT Post-Initialization of the Network Management and its internal state machine
          vSetInitFunctionInstance: vSetInitPhase=INIT_THREE
        Nm_PreInit: vSetHeader=Nm.h, vSetConfigType=Nm_ConfigType, vSetConfigPtrClass=NM_INIT_DATA, vSetModuleRef=Nm  # /ActiveEcuC/Nm PLAIN_TEXT PreInit function description of Nm in UnfilteredViewInInvariantProject (UnfilteredInvariantProjectModelView) .
          vSetInitFunctionInstance: vSetInitPhase=INIT_ONE, vSetConfigPtrName=Nm_Config_Ptr
        Nm_InitMemory: vSetHeader=Nm.h, vSetModuleRef=Nm  # /ActiveEcuC/Nm PLAIN_TEXT InitMemory function description of Nm in UnfilteredViewInInvariantProject (UnfilteredInvariantProjectModelView) .
          vSetInitFunctionInstance: vSetInitPhase=INIT_MEMORY
        PduR_PreInit: vSetHeader=PduR.h, vSetConfigType=PduR_PBConfigType, vSetConfigPtrClass=PDUR_INIT_DATA, vSetModuleRef=PduR  # /ActiveEcuC/PduR PLAIN_TEXT PreInit function description of PduR in UnfilteredViewInInvariantProject (UnfilteredInvariantProjectModelView) .
          vSetInitFunctionInstance: vSetInitPhase=INIT_ONE, vSetConfigPtrName=PduR_Config_Ptr
        PduR_Init: vSetHeader=PduR.h, vSetConfigType=PduR_PBConfigType, vSetConfigPtrClass=PDUR_INIT_DATA, vSetModuleRef=PduR  # /ActiveEcuC/PduR PLAIN_TEXT Init function description of PduR in UnfilteredViewInInvariantProject (UnfilteredInvariantProjectModelView) .
          vSetInitFunctionInstance: vSetInitPhase=INIT_TWO_COM, vSetConfigPtrName=PduR_Config_Ptr
        PduR_InitMemory: vSetHeader=PduR.h, vSetModuleRef=PduR  # /ActiveEcuC/PduR PLAIN_TEXT InitMemory function description of PduR in UnfilteredViewInInvariantProject (UnfilteredInvariantProjectModelView) .
          vSetInitFunctionInstance: vSetInitPhase=INIT_MEMORY
        SchM_Start: vSetHeader=Rte_Main.h, vSetModuleRef=Rte  # /ActiveEcuC/Rte PLAIN_TEXT Automatically generated by BswInitFctConfigurationService.
          vSetInitFunctionInstance: vSetInitPhase=NO_INIT
        Rte_InitMemory: vSetHeader=Rte_Main.h, vSetModuleRef=Rte  # /ActiveEcuC/Rte PLAIN_TEXT Automatically generated by BswInitFctConfigurationService.
          vSetInitFunctionInstance: vSetInitPhase=INIT_MEMORY
        Rte_Start: vSetHeader=Rte_Main.h, vSetModuleRef=Rte  # /ActiveEcuC/Rte PLAIN_TEXT Automatically generated by BswInitFctConfigurationService.
          vSetInitFunctionInstance: vSetInitPhase=INIT_THREE
        SchM_Init: vSetHeader=Rte_Main.h, vSetModuleRef=Rte  # /ActiveEcuC/Rte PLAIN_TEXT Automatically generated by BswInitFctConfigurationService.
          vSetInitFunctionInstance: vSetInitPhase=NO_INIT
        Rte_StartTiming: vSetHeader=Rte_Main.h, vSetModuleRef=Rte  # /ActiveEcuC/Rte PLAIN_TEXT Automatically generated by BswInitFctConfigurationService.
          vSetInitFunctionInstance: vSetInitPhase=NO_INIT
        SchM_StartTiming: vSetHeader=Rte_Main.h, vSetModuleRef=Rte  # /ActiveEcuC/Rte PLAIN_TEXT Automatically generated by BswInitFctConfigurationService.
          vSetInitFunctionInstance: vSetInitPhase=NO_INIT
        Adc_Init: vSetHeader=Adc.h, vSetConfigType=Adc_ConfigType, vSetConfigPtrClass=ADC_APPL_CONST, vSetModuleRef=Adc  # /ActiveEcuC/Adc PLAIN_TEXT Initialization of VttAdc Module
          vSetInitFunctionInstance: vSetInitPhase=INIT_TWO_MCAL, vSetConfigPtrName=AdcConfigSet
        Pwm_Init: vSetHeader=Pwm.h, vSetConfigType=Pwm_ConfigType, vSetConfigPtrClass=PWM_APPL_CONST, vSetModuleRef=Pwm  # /ActiveEcuC/Pwm PLAIN_TEXT Initialization of VttPwm Module
          vSetInitFunctionInstance: vSetInitPhase=INIT_TWO_POST_NVMREADALL, vSetConfigPtrName=PwmChannelConfigSet
        Dcm_Init: vSetHeader=Dcm.h, vSetConfigType=Dcm_ConfigType, vSetConfigPtrClass=DCM_CONST, vSetModuleRef=Dcm  # /ActiveEcuC/Dcm PLAIN_TEXT Dcm_Init function description
          vSetInitFunctionInstance: vSetInitPhase=INIT_TWO_POST_NVMREADALL, vSetConfigPtrName=NULL_PTR
        Dcm_InitMemory: vSetHeader=Dcm.h, vSetModuleRef=Dcm  # /ActiveEcuC/Dcm PLAIN_TEXT Dcm_InitMemory function description
          vSetInitFunctionInstance: vSetInitPhase=INIT_MEMORY
        Dem_PreInit: vSetHeader=Dem.h, vSetConfigType=Dem_ConfigType, vSetConfigPtrClass=DEM_INIT_DATA, vSetModuleRef=Dem  # /ActiveEcuC/Dem PLAIN_TEXT PreInit function description of Dem in UnfilteredViewInInvariantProject (UnfilteredInvariantProjectModelView) .
          vSetInitFunctionInstance: vSetInitPhase=INIT_ZERO, vSetConfigPtrName=Dem_Config_Ptr
        Dem_InitMemory: vSetHeader=Dem.h, vSetModuleRef=Dem  # /ActiveEcuC/Dem PLAIN_TEXT InitMemory function description of Dem in UnfilteredViewInInvariantProject (UnfilteredInvariantProjectModelView) .
          vSetInitFunctionInstance: vSetInitPhase=INIT_MEMORY
        Dem_Init: vSetHeader=Dem.h, vSetConfigType=Dem_ConfigType, vSetConfigPtrClass=DEM_INIT_DATA, vSetModuleRef=Dem  # /ActiveEcuC/Dem PLAIN_TEXT Init function description of Dem in UnfilteredViewInInvariantProject (UnfilteredInvariantProjectModelView) .
          vSetInitFunctionInstance: vSetInitPhase=INIT_TWO_POST_NVMREADALL, vSetConfigPtrName=Dem_Config_Ptr
        NvM_Init: vSetHeader=NvM.h, vSetModuleRef=NvM  # /ActiveEcuC/NvM PLAIN_TEXT Initialization of the NVRAM Manager, to make it ready for NvM_ReadAll being requested
          vSetInitFunctionInstance: vSetInitPhase=INIT_TWO_SYS
        Fee_Init: vSetHeader=Fee.h, vSetModuleRef=Fee  # /ActiveEcuC/Fee PLAIN_TEXT Initialization of the FEE
          vSetInitFunctionInstance: vSetInitPhase=INIT_TWO_IF
        Fls_Init: vSetHeader=Fls.h, vSetConfigType=Fls_ConfigType, vSetConfigPtrClass=FLS_APPL_CONST, vSetModuleRef=Fls  # /ActiveEcuC/Fls PLAIN_TEXT Initialization of VttFls Module
          vSetInitFunctionInstance: vSetInitPhase=INIT_TWO_MCAL, vSetConfigPtrName=FlsConfigSet
        CanTp_InitMemory: vSetHeader=CanTp.h, vSetModuleRef=CanTp  # /ActiveEcuC/CanTp PLAIN_TEXT InitMemory function description of CanTp in UnfilteredViewInInvariantProject (UnfilteredInvariantProjectModelView) .
          vSetInitFunctionInstance: vSetInitPhase=INIT_MEMORY
        CanTp_Init: vSetHeader=CanTp.h, vSetConfigType=CanTp_ConfigType, vSetConfigPtrClass=CANTP_INIT_DATA, vSetModuleRef=CanTp  # /ActiveEcuC/CanTp PLAIN_TEXT Init function description of CanTp in UnfilteredViewInInvariantProject (UnfilteredInvariantProjectModelView) .
          vSetInitFunctionInstance: vSetInitPhase=INIT_TWO_TP, vSetConfigPtrName=CanTp_Config_Ptr
  module config Os: implementation-config-variant=VARIANT-PRE-COMPILE, module-description=Os_Impl
    OsPublishedInformation: OsKernelVersion=7, OsPlatformName=VTT
      VTT (OsDerivativeInformation):
        OsExceptionVectorTableAlignment = 0
        OsInterruptVectorTableAlignment = 0
        OsHardwareManuals = N/A
        OsMpuPrivilegedRegionsConfigurable = false
        OsMpuAlignment = 0
        OsMpuEndAddressAccessible = true
        OsStackAlignment = 0
        OsSystemIntCtrl: OsSystemIntCtrlPrioOrder=ASC, OsSystemIntCtrlMaxPrios=200, OsSystemIntCtrlBaseAddress=0, OsSystemIntCtrlMaxSources=10000
          ExternalIRQ (OsSystemIntCtrlSlaveConfig): OsSystemIntCtrlMasterSource=0
        STM0 (OsHardwareTimer): OsHardwareTimerUnit=FRT, OsHardwareTimerId=0, OsHardwareTimerSize=32, OsHardwareTimerType=STM, OsHardwareTimerBaseAddress=0
          STM0_Ch0 (OsHardwareTimerChannel): OsHardwareTimerChannelId=0, OsHardwareTimerChannelIntSource=0, OsHardwareTimerChannelOffset=0
        OsPhysicalCore:
          OsPhysicalCoreIsAutostart = true
          OsPhysicalCoreId = 0
          OsPhysicalCoreExceptionSources = 0
          OsPhysicalCoreMasterStartAllowed = true
          OsPhysicalCorePrivelegedHwAccess = true
        DEFAULT (OsInterruptSupportedType):
          OsInterruptSupportedTypeSeparateSources = false
          OsInterruptSupportedTypeSeparatePriority = false
          OsInterruptSupportedTypeIsMapped = false
          OsInterruptSupportedTypePostActionRequired = false
    OS_APPMODE_ANY (OsAppMode)
    OSDEFAULTAPPMODE (OsAppMode)
    OsOS:
      OsStackMonitoring = true
      OsStatus = EXTENDED
      OsUseArti = false
      OsUseGetServiceId = false
      OsUseParameterAccess = false
      OsUseResScheduler = true
      OsForcibleTermination = false
      OsGenerateCalloutStubs = true
      OsGenerateMemMap = COMPLETE
      OsGenerateMemMapForNearAddressing = true
      OsGenerateMemMapForThreads = false
      OsServiceProtection = false
      OsStackUsageMeasurement = false
      OsUseXSignalAsyncApiCalls = false
      OsFpuUsage = NONE
      OsUseCase = STANDARD
      OsScalabilityClass = SC1
      OsNumberOfCores = 1
      OsMasterCore = Os/OsCore0
      OsSystemTimer = Os/SystemTimer
      OsStackSummary
        11 x OsStack, all with OsStackCore=Os/OsCore0:
          OsCore0_Kernel: OsStackSize=1024, OsStackType=CORE_KERNEL_STACK, OsStackUser=Os/OsCore0
          OsCore0_Init: OsStackSize=1024, OsStackType=CORE_INIT_STACK, OsStackUser=Os/OsCore0
          OsCore0_Task_Prio4294967295: OsStackSize=1024, OsStackType=TASK_SHARED_PRIORITY_STACK, OsStackUser=Os/IdleTask_OsCore0
          OsCore0_Isr_Core: OsStackSize=1024, OsStackType=ISR_SHARED_CORE_STACK, OsStackUser=Os/CounterIsr_SystemTimer
          OsCore0_Task_Prio10: OsStackSize=1024, OsStackType=TASK_SHARED_PRIORITY_STACK, OsStackUser=Os/Init_Task
          Main_Task: OsStackSize=1024, OsStackType=TASK_EXTENDED_STACK, OsStackUser=Os/Main_Task
          OsCore0_Shutdown: OsStackSize=1024, OsStackType=CORE_SHUTDOWN_STACK, OsStackUser=Os/OsCore0
          OsCore0_Error: OsStackSize=1024, OsStackType=CORE_ERROR_STACK, OsStackUser=Os/OsCore0
          OsCore0_Task_Prio4: OsStackSize=320, OsStackType=TASK_SHARED_PRIORITY_STACK, OsStackUser=Os/Io_Task
          OsCore0_Task_Prio1: OsStackSize=1024, OsStackType=TASK_SHARED_PRIORITY_STACK, OsStackUser=Os/SpeedTask
          Rte_Task: OsStackSize=320, OsStackType=TASK_EXTENDED_STACK, OsStackUser=Os/Rte_Task
      OsHooks: OsErrorHook=true, OsPostTaskHook=false, OsPreTaskHook=false, OsShutdownHook=true, OsStartupHook=false
    OsCore0 (OsCore):
      OsCoreIsAutostart = true
      OsCoreIsAutosar = true
      OsCorePhysicalCoreRef = VTT/OsPhysicalCore
      OsCoreEcucCoreRef = EcucHardware/EcucCoreDefinition
      OsCoreIdleTask = Os/IdleTask_OsCore0
      OsCoreSystemApplication = Os/SystemApplication_OsCore0
      OsCoreResScheduler = Os/RES_SCHEDULER_OsCore0
      OsCoreStacks:
        OsCoreKernelStackSize = 1024
        OsCoreStartupStackSize = 1024
        OsCoreShutdownStackSize = 1024
        OsCoreErrorStackSize = 1024
        OsCoreProtectionStackSize = 1024
        OsCoreInitStackSize = 1024
    IdleTask_OsCore0 (OsTask):
      OsTaskActivation = 1
      OsTaskPriority = 4294967295
      OsTaskSchedule = FULL
      OsTaskStackSharing = false
      OsTaskStackSize = 1024
      OsTaskType = AUTO
      OsTaskUsesFpu = false
      OsTaskAccessingApplication = Os/SystemApplication_OsCore0
      OsTaskResourceRef = Os/RES_SCHEDULER_OsCore0
      OsTaskAutostart: OsTaskAppModeRef=Os/OS_APPMODE_ANY
    SystemApplication_OsCore0 (OsApplication):
      OsTrusted = true
      OsTrustedApplicationDelayTimingViolationCall = false
      OsTrustedApplicationWithProtection = false
      OsApplicationIsPrivileged = true
      OsAppUseTrustedFunctionStubs = false
      OsApplicationCoreRef = EcucHardware/EcucCoreDefinition
      OsAppTaskRef = Os/IdleTask_OsCore0
      OsAppCounterRef = Os/SystemTimer
      OsAppIsrRef = Os/CounterIsr_SystemTimer
      OsAppTaskRef = Os/Init_Task
      OsAppTaskRef = Os/Rte_Task
      OsAppTaskRef = Os/Main_Task
      OsAppAlarmRef = Os/Rte_Al_TE2_Main_Task_0_10ms
      OsAppAlarmRef = Os/Rte_Al_TE2_Main_Task_0_20ms
      OsAppTaskRef = Os/Io_Task
      OsAppAlarmRef = Os/Rte_Al_TE_Fee_Fee_MainFunction
      OsAppAlarmRef = Os/Rte_Al_TE_CpApController_RCtApController_ReadSpeed
      OsAppTaskRef = Os/SpeedTask
      OsAppAlarmRef = Os/Rte_Al_TE_CpApController_RCtApController_ActuationControl
      OsAppAlarmRef = Os/Rte_Al_TE_CpApController_RCtApController_ErrorDetection
      OsApplicationHooks: OsAppErrorHook=false, OsAppShutdownHook=false, OsAppStartupHook=false
    SystemTimer (OsCounter):
      OsCounterMaxAllowedValue = 2147483647
      OsCounterMinCycle = 1
      OsCounterType = HARDWARE
      OsSecondsPerTick = 0.001
      OsCounterTicksPerBase = 1
      OsCounterAccessingApplication = Os/SystemApplication_OsCore0
      OsDriver: OsDriverHighResolution=false, OsDriverHardwareTimerChannelRef=STM0/STM0_Ch0, OsDriverIsrRef=Os/CounterIsr_SystemTimer
    CounterIsr_SystemTimer (OsIsr):
      OsIsrInterruptPriority = 0
      OsIsrCategory = CATEGORY_2
      OsIsrInterruptType = EXTERNAL
      OsIsrStackSize = 1024
      OsIsrEnableNesting = false
      OsIsrUsesFpu = false
      OsIsrInitialEnableInterruptSource = false
      OsIsrSpecialFunctionName = Os_TimerPfrtIsr
      OsIsrInterruptSource = 1
      OsIsrInterruptMapping = VTT/DEFAULT
    RES_SCHEDULER_OsCore0 (OsResource): OsResourceProperty=STANDARD, OsResourceAccessingApplication=Os/SystemApplication_OsCore0
    3 x OsTask, all with OsTaskActivation=1, OsTaskSchedule=NON, OsTaskStackSharing=false, OsTaskType=AUTO, OsTaskUsesFpu=false, OsTaskAccessingApplication=Os/SystemApplication_OsCore0, OsTaskResourceRef=Os/RES_SCHEDULER_OsCore0:
      Init_Task: OsTaskPriority=10, OsTaskStackSize=1024
        OsTaskAutostart: OsTaskAppModeRef=Os/OSDEFAULTAPPMODE
      Rte_Task: OsTaskPriority=2, OsTaskStackSize=320, OsTaskEventRef=Os/Rte_Ev_Run_CpApController_RCtApController_ActuationControl, OsTaskEventRef=Os/Rte_Ev_Run_CpApController_RCtApController_ErrorDetection
      Main_Task: OsTaskPriority=3, OsTaskStackSize=1024, OsTaskEventRef=Os/Rte_Ev_Cyclic2_Main_Task_0_10ms, OsTaskEventRef=Os/Rte_Ev_Cyclic2_Main_Task_0_20ms, OsTaskEventRef=Os/Rte_Ev_Run_Fee_Fee_MainFunction
    Rte_Al_TE2_Main_Task_0_10ms (OsAlarm): OsAlarmCounterRef=Os/SystemTimer, OsAlarmAccessingApplication=Os/SystemApplication_OsCore0
      OsAlarmAction
        OsAlarmSetEvent: OsAlarmSetEventRef=Os/Rte_Ev_Cyclic2_Main_Task_0_10ms, OsAlarmSetEventTaskRef=Os/Main_Task
    Rte_Al_TE2_Main_Task_0_20ms (OsAlarm): OsAlarmCounterRef=Os/SystemTimer, OsAlarmAccessingApplication=Os/SystemApplication_OsCore0
      OsAlarmAction
        OsAlarmSetEvent: OsAlarmSetEventRef=Os/Rte_Ev_Cyclic2_Main_Task_0_20ms, OsAlarmSetEventTaskRef=Os/Main_Task
    Rte_Ev_Cyclic2_Main_Task_0_10ms (OsEvent)
    Rte_Ev_Cyclic2_Main_Task_0_20ms (OsEvent)
    Io_Task (OsTask):
      OsTaskActivation = 1
      OsTaskPriority = 4
      OsTaskSchedule = NON
      OsTaskStackSharing = false
      OsTaskStackSize = 320
      OsTaskType = AUTO
      OsTaskUsesFpu = false
      OsTaskAccessingApplication = Os/SystemApplication_OsCore0
      OsTaskResourceRef = Os/RES_SCHEDULER_OsCore0
    Rte_Al_TE_Fee_Fee_MainFunction (OsAlarm): OsAlarmCounterRef=Os/SystemTimer, OsAlarmAccessingApplication=Os/SystemApplication_OsCore0
      OsAlarmAction
        OsAlarmSetEvent: OsAlarmSetEventRef=Os/Rte_Ev_Run_Fee_Fee_MainFunction, OsAlarmSetEventTaskRef=Os/Main_Task
    Rte_Ev_Run_Fee_Fee_MainFunction (OsEvent)
    Rte_Al_TE_CpApController_RCtApController_ReadSpeed (OsAlarm): OsAlarmCounterRef=Os/SystemTimer, OsAlarmAccessingApplication=Os/SystemApplication_OsCore0
      OsAlarmAction
        OsAlarmActivateTask: OsAlarmActivateTaskRef=Os/SpeedTask
    SpeedTask (OsTask):
      OsTaskActivation = 1
      OsTaskPriority = 1
      OsTaskSchedule = NON
      OsTaskStackSharing = false
      OsTaskStackSize = 1024
      OsTaskType = AUTO
      OsTaskUsesFpu = false
      OsTaskAccessingApplication = Os/SystemApplication_OsCore0
      OsTaskResourceRef = Os/RES_SCHEDULER_OsCore0
    Rte_Al_TE_CpApController_RCtApController_ActuationControl (OsAlarm): OsAlarmCounterRef=Os/SystemTimer, OsAlarmAccessingApplication=Os/SystemApplication_OsCore0
      OsAlarmAction
        OsAlarmSetEvent: OsAlarmSetEventRef=Os/Rte_Ev_Run_CpApController_RCtApController_ActuationControl, OsAlarmSetEventTaskRef=Os/Rte_Task
    Rte_Ev_Run_CpApController_RCtApController_ActuationControl (OsEvent)
    Rte_Al_TE_CpApController_RCtApController_ErrorDetection (OsAlarm): OsAlarmCounterRef=Os/SystemTimer, OsAlarmAccessingApplication=Os/SystemApplication_OsCore0
      OsAlarmAction
        OsAlarmSetEvent: OsAlarmSetEventRef=Os/Rte_Ev_Run_CpApController_RCtApController_ErrorDetection, OsAlarmSetEventTaskRef=Os/Rte_Task
    Rte_Ev_Run_CpApController_RCtApController_ErrorDetection (OsEvent)
  module config Det: implementation-config-variant=VARIANT-PRE-COMPILE, module-description=Det_Impl
    DetGeneral:
      DetVersionInfoApi = false
      DetEnableDet = true
      DetExtDebugSupport = false
      DetGlobalFilterSize = 0
      DetBreakFilterSize = 0
      DetLogBufferSize = 0
      DetReportErrorRecursionLimit = 0
      DetReportRuntimeErrorRecursionLimit = 0
      DetReportTransientFaultRecursionLimit = 0
      DetDltFilterSize = 0
    DetConfigSet
  module config Com: implementation-config-variant=VARIANT-PRE-COMPILE, module-description=Com_Impl
    ComGeneration:
      ComOutOfBoundsWriteProtectionStrategy = NONE
      ComOutOfBoundsWriteSanitizer = false
      ComOutOfBoundsReadSanitizer = false
      ComReduceConstantData2Define = false
      ComBoolDataInArrayOfStructStrategy = BOOLEAN
      ComDeduplicateIndirectedData = true
      ComDataDeduplicationStrategy = WITH_CAST
      ComReduceBoolDataByNegationThreshold = 2
      ComReduceBoolDataByNumericalComparisonThreshold = 2
      ComReduceBoolDataByNumericalRelationThreshold = 2
      ComReduceBoolDataByNumericalOperandStrategy = WITH_ANY_VALUE
      ComReduceNumericalDataByOffsetThreshold = 2
      ComReduceNumericalDataByArraySubtractionThreshold = 2
      ComReduceDataByStreaming = false
      ComShortSymbols = false
      ComInterfacesForDeactivatedData = false
      ComReferringKeysInComments = false
      ComNumberOfElementsCommentThreshold = 1000
    ComOptimization:
      ComTxProcessingISRLockThreshold = 1
      ComRxProcessingISRLockThreshold = 1
      ComGatewayProcessingISRLockThreshold = 1
      ComGatewayDescriptionProcessingISRLockThreshold = 1
      ComIPduGroupISRLockThreshold = 1
    ComConfig: ComConfigurationId=0, ComRxImmediateNotificationCacheSize=0, ComRxDeferredNotificationCacheSize=1
      ComMainFunctionTx: ComMainTxTimeBase=0.01
      ComMainFunctionRx: ComMainRxTimeBase=0.01
      Signal_Fan_Speed_4a82392d_Rx (ComSignal):
        ComBitPosition = 8
        ComBitSize = 16
        ComSignalEndianness = LITTLE_ENDIAN
        ComSignalType = UINT16
        ComSignalInitValue = 0
        ComSignalAccess = ACCESS_NEEDED_BY_SWC_OR_COM
        ComHandleId = 1
        ComTimeout = 0.1
        ComTimeoutNotification = Rte_COMCbkRxTOut_Signal_Fan_Speed_4a82392d_Rx
        ComNotification = Rte_COMCbk_Signal_Fan_Speed_4a82392d_Rx
        ComSystemTemplateSystemSignalRef = SignalPduMapping_eb5b8f262b3bf3e6
      Comfort_HeadUnit_Frame_PDU_6df1e8d4_Rx (ComIPdu):
        ComIPduDirection = RECEIVE
        ComIPduType = NORMAL
        ComIPduHandleId = 1
        ComIPduSignalProcessing = DEFERRED
        ComIPduCancellationSupport = false
        ComIPduSignalRef = Signal_Fan_Speed_4a82392d_Rx
        ComPduIdRef = EcucPduCollection/Comfort_HeadUnit_Frame_PDU_6df1e8d4_Rx
        ComIPduMainFunctionRef = ComMainFunctionRx
        ComIPduGroupRef = ComIPduGroupRx
      Signal_Fan_Fault_da741978_Tx (ComSignal):
        ComBitPosition = 0
        ComBitSize = 8
        ComSignalEndianness = LITTLE_ENDIAN
        ComSignalType = UINT8
        ComTransferProperty = TRIGGERED_ON_CHANGE
        ComSignalInitValue = 0
        ComSignalAccess = ACCESS_NEEDED_BY_SWC_OR_COM
        ComHandleId = 0
        ComSystemTemplateSystemSignalRef = SignalPduMapping_712c3b5c8821b4c2
      Comfort_Fan_Frame_PDU_68b7e774_Tx (ComIPdu):
        ComIPduDirection = SEND
        ComIPduType = NORMAL
        ComIPduHandleId = 0
        ComIPduSignalProcessing = DEFERRED
        ComIPduCancellationSupport = false
        ComIPduSignalRef = Signal_Fan_Fault_da741978_Tx
        ComPduIdRef = EcucPduCollection/Comfort_Fan_Frame_PDU_68b7e774_Tx
        ComIPduMainFunctionRef = ComMainFunctionTx
        ComIPduGroupRef = ComIPduGroupTx
        ComTxIPdu: ComMinimumDelayTime=0, ComTxIPduUnusedAreasDefault=0
          ComTxModeTrue
            ComTxMode: ComTxModeMode=MIXED, ComTxModeTimePeriod=1, ComTxModeTimeOffset=0, ComTxModeNumberOfRepetitions=0
          ComTxModeFalse
            ComTxMode: ComTxModeMode=NONE
      ComIPduGroupRx (ComIPduGroup): ComIPduGroupHandleId=1
      ComIPduGroupTx (ComIPduGroup): ComIPduGroupHandleId=0
      Comfort_DrivingCycle_Frame_PDU_b08df3c0_Rx (ComIPdu):
        ComIPduDirection = RECEIVE
        ComIPduType = NORMAL
        ComIPduHandleId = 0
        ComIPduSignalProcessing = DEFERRED
        ComIPduCancellationSupport = false
        ComIPduSignalRef = Signal_DrivingCycle_e990e847_Rx
        ComPduIdRef = EcucPduCollection/Comfort_DrivingCycle_Frame_PDU_b08df3c0_Rx
        ComIPduMainFunctionRef = ComMainFunctionRx
      Signal_DrivingCycle_e990e847_Rx (ComSignal):
        ComBitPosition = 0
        ComBitSize = 8
        ComSignalEndianness = LITTLE_ENDIAN
        ComSignalType = UINT8
        ComSignalInitValue = 0
        ComSignalAccess = ACCESS_NEEDED_BY_SWC_OR_COM
        ComHandleId = 0
        ComSystemTemplateSystemSignalRef = SignalPduMapping_8352acddb81fe614
    ComGeneral:
      ComConfigurationUseDet = true
      ComSafeBswChecks = true
      ComEnableSignalGroupArrayApi = false
      ComRetryFailedTransmitRequests = true
      ComSupportedIPduGroups = 2
      ComVersionInfoApi = false
      ComMetaDataSupport = false
      ComDeferredEventCacheSupport = false
      ComDescriptionGateway = false
      ComStrictRepetitionPeriod = false
      ComMixedModePeriodicSuppression = false
      ComSignalGateway = NONE
      ComMultiPartition = false
      ComUserCbkHeaderFile = Rte_Cbk.h
  module config ComM: implementation-config-variant=VARIANT-PRE-COMPILE, module-description=ComM_Impl
    ComMGeneral:
      ComMPncIdCounting = COMM_PNC_ID_COUNT_FROM_NM_MESSAGE
      ComMPncSupport = false
      ComMDevErrorDetect = true
      ComMEcuGroupClassification = 3
      ComMModeLimitationEnabled = false
      ComMSynchronousWakeUp = true
      ComMTMinFullComModeDuration = 5
      ComMVersionInfoApi = false
      ComMWakeupInhibitionEnabled = false
      ComMSafeBswChecks = true
      ComMGeneration: ComMOutOfBoundsWriteSanitizer=false, ComMOutOfBoundsReadSanitizer=false
    ComMConfigSet: ComMPncEnabled=false
      Connector_Fan_ECU_fbc5880ce1a0cdea_90249745 (ComMChannel):
        ComMBusType = COMM_BUS_TYPE_CAN
        ComMChannelId = 0
        ComMFullCommRequestNotificationEnabled = false
        ComMMainFunctionPeriod = 0.02
        ComMNoCom = false
        ComMNoWakeup = false
        Connector_Fan_ECU_fbc5880ce1a0cdea_d2ce69be (ComMUserPerChannel): ComMUserChannel=Connector_Fan_ECU_fbc5880ce1a0cdea_1e36b570
        ComMNetworkManagement: ComMNmVariant=FULL, ComMPncNmRequest=false
      Connector_Fan_ECU_fbc5880ce1a0cdea_1e36b570 (ComMUser): ComMUserIdentifier=0, ComMUserModeNotification=false
  module config VTTEcuC: implementation-config-variant=VARIANT-PRE-COMPILE, module-description=VTTEcuC_Impl
    EcucGeneral:
      ByteOrder = LITTLE_ENDIAN
      AtomicBitAccessInBitfield = false
      CPUType = CPU32Bit
      BitOrder = LSB_to_MSB
      AtomicVariableAccess = Atomic32BitAccess
      SizeOfEnum = Size32Bit
      SizeOfInt = Size32Bit
      SizeOfROMPointer = Size32Bit
      SizeOfRAMPointer = Size32Bit
      BitFieldDataType = INT
      StructAlignment = Auto
      ArrayAlignment = Auto
      StructInArrayAlignment = Auto
      DummyFunction = false
      DummyStatement = false
      DummyStatementKind = None
      ConditionalGenerating = true
      EcucBswImplementationCodeType = EcuCSourceCode
      EcuCUseStdReturnTypeForRte = false
    EcucHardware
      EcucCoreDefinition: EcucCoreId=0
