[part 2 of 2: package /ActiveEcuC]
AUTOSAR XML (schema 00050)
package /ActiveEcuC  (continued)
  module config VTTOs: implementation-config-variant=VARIANT-PRE-COMPILE, module-description=Os_Impl
    OsOS:
      OsStackMonitoring = true
      OsStatus = EXTENDED
      OsUseArti = false
      OsUseGetServiceId = false
      OsUseParameterAccess = false
      OsUseResScheduler = true
      OsForcibleTermination = false
      OsGenerateCalloutStubs = true
      OsGenerateMemMap = COMPLETE
      OsGenerateMemMapForNearAddressing = true
      OsGenerateMemMapForThreads = false
      OsServiceProtection = false
      OsStackUsageMeasurement = false
      OsUseXSignalAsyncApiCalls = false
      OsFpuUsage = NONE
      OsUseCase = STANDARD
      OsScalabilityClass = SC1
      OsNumberOfCores = 1
      OsMasterCore = VTTOs/OsCore0
      OsSystemTimer = VTTOs/SystemTimer
      OsHooks: OsErrorHook=true, OsPostTaskHook=false, OsPreTaskHook=false, OsShutdownHook=true, OsStartupHook=false
      OsStackSummary
        11 x OsStack, all with OsStackCore=VTTOs/OsCore0:
          OsCore0_Kernel: OsStackSize=1024, OsStackType=CORE_KERNEL_STACK, OsStackUser=VTTOs/OsCore0
          OsCore0_Init: OsStackSize=1024, OsStackType=CORE_INIT_STACK, OsStackUser=VTTOs/OsCore0
          OsCore0_Isr_Core: OsStackSize=1024, OsStackType=ISR_SHARED_CORE_STACK, OsStackUser=CanIsrRx_0, OsStackUser=CanIsrErr_0, OsStackUser=CanIsrTx_0, OsStackUser=VTTOs/CounterIsr_SystemTimer, OsStackUser=AdcIsr_0, OsStackUser=CanIsrWakeup_0, OsStackUser=PwmIsr_0
          OsCore0_Task_Prio4294967295: OsStackSize=1024, OsStackType=TASK_SHARED_PRIORITY_STACK, OsStackUser=VTTOs/IdleTask_OsCore0
          OsCore0_Task_Prio10: OsStackSize=1024, OsStackType=TASK_SHARED_PRIORITY_STACK, OsStackUser=VTTOs/Init_Task
          Main_Task: OsStackSize=1024, OsStackType=TASK_EXTENDED_STACK, OsStackUser=VTTOs/Main_Task
          OsCore0_Shutdown: OsStackSize=1024, OsStackType=CORE_SHUTDOWN_STACK, OsStackUser=VTTOs/OsCore0
          OsCore0_Error: OsStackSize=1024, OsStackType=CORE_ERROR_STACK, OsStackUser=VTTOs/OsCore0
          OsCore0_Task_Prio4: OsStackSize=320, OsStackType=TASK_SHARED_PRIORITY_STACK, OsStackUser=VTTOs/Io_Task
          OsCore0_Task_Prio1: OsStackSize=1024, OsStackType=TASK_SHARED_PRIORITY_STACK, OsStackUser=VTTOs/SpeedTask
          Rte_Task: OsStackSize=320, OsStackType=TASK_EXTENDED_STACK, OsStackUser=VTTOs/Rte_Task
    OsPublishedInformation: OsKernelVersion=7, OsPlatformName=VTT
      VTT (OsDerivativeInformation):
        OsMpuAlignment = 0
        OsMpuEndAddressAccessible = true
        OsMpuPrivilegedRegionsConfigurable = false
        OsStackAlignment = 0
        OsInterruptVectorTableAlignment = 0
        OsExceptionVectorTableAlignment = 0
        OsHardwareManuals = N/A
        STM0 (OsHardwareTimer): OsHardwareTimerId=0, OsHardwareTimerUnit=FRT, OsHardwareTimerSize=32, OsHardwareTimerBaseAddress=0, OsHardwareTimerType=STM
          STM0_Ch0 (OsHardwareTimerChannel): OsHardwareTimerChannelId=0, OsHardwareTimerChannelIntSource=0, OsHardwareTimerChannelOffset=0
        OsSystemIntCtrl: OsSystemIntCtrlMaxSources=10000, OsSystemIntCtrlMaxPrios=200, OsSystemIntCtrlPrioOrder=ASC, OsSystemIntCtrlBaseAddress=0
          ExternalIRQ (OsSystemIntCtrlSlaveConfig): OsSystemIntCtrlMasterSource=0
        OsPhysicalCore:
          OsPhysicalCoreId = 0
          OsPhysicalCoreExceptionSources = 0
          OsPhysicalCoreIsAutostart = true
          OsPhysicalCoreMasterStartAllowed = true
          OsPhysicalCorePrivelegedHwAccess = true
        DEFAULT (OsInterruptSupportedType):
          OsInterruptSupportedTypeSeparateSources = false
          OsInterruptSupportedTypeSeparatePriority = false
          OsInterruptSupportedTypeIsMapped = false
          OsInterruptSupportedTypePostActionRequired = false
    OS_APPMODE_ANY (OsAppMode)
    OSDEFAULTAPPMODE (OsAppMode)
    3 x OsIsr, all with OsIsrInterruptPriority=10, OsIsrInitialEnableInterruptSource=false, OsIsrCategory=CATEGORY_2, OsIsrInterruptType=EXTERNAL, OsIsrStackSize=1024, OsIsrEnableNesting=false, OsIsrUsesFpu=false, OsIsrInterruptMapping=VTT/DEFAULT:
      CanIsrErr_0: OsIsrInterruptSource=0  # /ActiveEcuC/VTTCan PLAIN_TEXT Can BusOff event (common for all controllers)
      CanIsrTx_0: OsIsrInterruptSource=1  # /ActiveEcuC/VTTCan PLAIN_TEXT Can TX messages event (common for all controllers)
      CanIsrRx_0: OsIsrInterruptSource=2  # /ActiveEcuC/VTTCan PLAIN_TEXT Can RX messages event (common for all controllers)
    OsCore0 (OsCore):
      OsCoreIsAutostart = true
      OsCoreIsAutosar = true
      OsCorePhysicalCoreRef = VTT/OsPhysicalCore
      OsCoreEcucCoreRef = EcucHardware/EcucCoreDefinition
      OsCoreIdleTask = VTTOs/IdleTask_OsCore0
      OsCoreSystemApplication = VTTOs/SystemApplication_OsCore0
      OsCoreResScheduler = VTTOs/RES_SCHEDULER_OsCore0
      OsCoreStacks:
        OsCoreKernelStackSize = 1024
        OsCoreStartupStackSize = 1024
        OsCoreShutdownStackSize = 1024
        OsCoreErrorStackSize = 1024
        OsCoreProtectionStackSize = 1024
        OsCoreInitStackSize = 1024
    IdleTask_OsCore0 (OsTask):
      OsTaskActivation = 1
      OsTaskPriority = 4294967295
      OsTaskSchedule = FULL
      OsTaskStackSharing = false
      OsTaskStackSize = 1024
      OsTaskType = AUTO
      OsTaskUsesFpu = false
      OsTaskAccessingApplication = VTTOs/SystemApplication_OsCore0
      OsTaskResourceRef = VTTOs/RES_SCHEDULER_OsCore0
      OsTaskAutostart: OsTaskAppModeRef=VTTOs/OS_APPMODE_ANY
    SystemApplication_OsCore0 (OsApplication):
      OsTrusted = true
      OsTrustedApplicationDelayTimingViolationCall = false
      OsTrustedApplicationWithProtection = false
      OsApplicationIsPrivileged = true
      OsAppUseTrustedFunctionStubs = false
      OsApplicationCoreRef = EcucHardware/EcucCoreDefinition
      OsAppIsrRef = CanIsrErr_0
      OsAppIsrRef = CanIsrRx_0
      OsAppIsrRef = CanIsrTx_0
      OsAppTaskRef = VTTOs/IdleTask_OsCore0
      OsAppCounterRef = VTTOs/SystemTimer
      OsAppIsrRef = VTTOs/CounterIsr_SystemTimer
      OsAppTaskRef = VTTOs/Init_Task
      OsAppTaskRef = VTTOs/Rte_Task
      OsAppTaskRef = VTTOs/Main_Task
      OsAppAlarmRef = VTTOs/Rte_Al_TE2_Main_Task_0_10ms
      OsAppIsrRef = AdcIsr_0
      OsAppTaskRef = VTTOs/Io_Task
      OsAppIsrRef = CanIsrWakeup_0
      OsAppAlarmRef = VTTOs/Rte_Al_TE2_Main_Task_0_20ms
      OsAppTaskRef = VTTOs/SpeedTask
      OsAppAlarmRef = VTTOs/Rte_Al_TE_Fee_Fee_MainFunction
      OsAppAlarmRef = VTTOs/Rte_Al_TE_CpApController_RCtApController_ReadSpeed
      OsAppAlarmRef = VTTOs/Rte_Al_TE_CpApController_RCtApController_ActuationControl
      OsAppAlarmRef = VTTOs/Rte_Al_TE_CpApController_RCtApController_ErrorDetection
      OsAppIsrRef = PwmIsr_0
      OsApplicationHooks: OsAppErrorHook=false, OsAppShutdownHook=false, OsAppStartupHook=false
    SystemTimer (OsCounter):
      OsCounterMaxAllowedValue = 2147483647
      OsCounterMinCycle = 1
      OsCounterTicksPerBase = 1
      OsCounterType = HARDWARE
      OsSecondsPerTick = 0.001
      OsCounterAccessingApplication = VTTOs/SystemApplication_OsCore0
      OsDriver: OsDriverHighResolution=false, OsDriverHardwareTimerChannelRef=STM0/STM0_Ch0, OsDriverIsrRef=VTTOs/CounterIsr_SystemTimer
    CounterIsr_SystemTimer (OsIsr):
      OsIsrInterruptPriority = 20
      OsIsrInitialEnableInterruptSource = false
      OsIsrCategory = CATEGORY_2
      OsIsrInterruptType = EXTERNAL
      OsIsrStackSize = 1024
      OsIsrEnableNesting = false
      OsIsrUsesFpu = false
      OsIsrSpecialFunctionName = Os_TimerPfrtIsr
      OsIsrInterruptSource = 3
      OsIsrInterruptMapping = VTT/DEFAULT
    RES_SCHEDULER_OsCore0 (OsResource): OsResourceProperty=STANDARD, OsResourceAccessingApplication=VTTOs/SystemApplication_OsCore0
    3 x OsTask, all with OsTaskActivation=1, OsTaskSchedule=NON, OsTaskStackSharing=false, OsTaskType=AUTO, OsTaskUsesFpu=false, OsTaskAccessingApplication=VTTOs/SystemApplication_OsCore0, OsTaskResourceRef=VTTOs/RES_SCHEDULER_OsCore0:
      Init_Task: OsTaskPriority=10, OsTaskStackSize=1024
        OsTaskAutostart: OsTaskAppModeRef=VTTOs/OSDEFAULTAPPMODE
      Rte_Task: OsTaskPriority=2, OsTaskStackSize=320, OsTaskEventRef=VTTOs/Rte_Ev_Run_CpApController_RCtApController_ActuationControl, OsTaskEventRef=VTTOs/Rte_Ev_Run_CpApController_RCtApController_ErrorDetection
      Main_Task: OsTaskPriority=3, OsTaskStackSize=1024, OsTaskEventRef=VTTOs/Rte_Ev_Cyclic2_Main_Task_0_10ms, OsTaskEventRef=VTTOs/Rte_Ev_Cyclic2_Main_Task_0_20ms, OsTaskEventRef=VTTOs/Rte_Ev_Run_Fee_Fee_MainFunction
    Rte_Ev_Cyclic2_Main_Task_0_20ms (OsEvent)
    Rte_Ev_Cyclic2_Main_Task_0_10ms (OsEvent)
    Rte_Al_TE2_Main_Task_0_10ms (OsAlarm): OsAlarmCounterRef=VTTOs/SystemTimer, OsAlarmAccessingApplication=VTTOs/SystemApplication_OsCore0
      OsAlarmAction
        OsAlarmSetEvent: OsAlarmSetEventRef=VTTOs/Rte_Ev_Cyclic2_Main_Task_0_10ms, OsAlarmSetEventTaskRef=VTTOs/Main_Task
    Rte_Al_TE2_Main_Task_0_20ms (OsAlarm): OsAlarmCounterRef=VTTOs/SystemTimer, OsAlarmAccessingApplication=VTTOs/SystemApplication_OsCore0
      OsAlarmAction
        OsAlarmSetEvent: OsAlarmSetEventRef=VTTOs/Rte_Ev_Cyclic2_Main_Task_0_20ms, OsAlarmSetEventTaskRef=VTTOs/Main_Task
    AdcIsr_0 (OsIsr):  # /ActiveEcuC/VTTAdc PLAIN_TEXT ADC Completed Interrupt for 0. This OsInterrupt container has been created automatically based on the driver conﬁguration
      OsIsrInterruptPriority = 5
      OsIsrInitialEnableInterruptSource = true
      OsIsrCategory = CATEGORY_2
      OsIsrInterruptType = EXTERNAL
      OsIsrStackSize = 1024
      OsIsrEnableNesting = false
      OsIsrUsesFpu = false
      OsIsrInterruptSource = 4
      OsIsrInterruptMapping = VTT/DEFAULT
    Io_Task (OsTask):
      OsTaskActivation = 1
      OsTaskPriority = 4
      OsTaskSchedule = NON
      OsTaskStackSharing = false
      OsTaskStackSize = 320
      OsTaskType = AUTO
      OsTaskUsesFpu = false
      OsTaskAccessingApplication = VTTOs/SystemApplication_OsCore0
      OsTaskResourceRef = VTTOs/RES_SCHEDULER_OsCore0
    CanIsrWakeup_0 (OsIsr):  # /ActiveEcuC/VTTCan PLAIN_TEXT Can Wakeup event (common for all controllers)
      OsIsrInterruptPriority = 1
      OsIsrInitialEnableInterruptSource = false
      OsIsrCategory = CATEGORY_2
      OsIsrInterruptType = EXTERNAL
      OsIsrInterruptSource = 5
      OsIsrStackSize = 1024
      OsIsrEnableNesting = false
      OsIsrUsesFpu = false
    Rte_Al_TE_Fee_Fee_MainFunction (OsAlarm): OsAlarmCounterRef=VTTOs/SystemTimer, OsAlarmAccessingApplication=VTTOs/SystemApplication_OsCore0
      OsAlarmAction
        OsAlarmSetEvent: OsAlarmSetEventRef=VTTOs/Rte_Ev_Run_Fee_Fee_MainFunction, OsAlarmSetEventTaskRef=VTTOs/Main_Task
    Rte_Ev_Run_Fee_Fee_MainFunction (OsEvent)
    Rte_Al_TE_CpApController_RCtApController_ReadSpeed (OsAlarm): OsAlarmCounterRef=VTTOs/SystemTimer, OsAlarmAccessingApplication=VTTOs/SystemApplication_OsCore0
      OsAlarmAction
        OsAlarmActivateTask: OsAlarmActivateTaskRef=VTTOs/SpeedTask
    SpeedTask (OsTask):
      OsTaskActivation = 1
      OsTaskPriority = 1
      OsTaskSchedule = NON
      OsTaskStackSharing = false
      OsTaskStackSize = 1024
      OsTaskType = AUTO
      OsTaskUsesFpu = false
      OsTaskAccessingApplication = VTTOs/SystemApplication_OsCore0
      OsTaskResourceRef = VTTOs/RES_SCHEDULER_OsCore0
    Rte_Al_TE_CpApController_RCtApController_ActuationControl (OsAlarm): OsAlarmCounterRef=VTTOs/SystemTimer, OsAlarmAccessingApplication=VTTOs/SystemApplication_OsCore0
      OsAlarmAction
        OsAlarmSetEvent: OsAlarmSetEventRef=VTTOs/Rte_Ev_Run_CpApController_RCtApController_ActuationControl, OsAlarmSetEventTaskRef=VTTOs/Rte_Task
    Rte_Ev_Run_CpApController_RCtApController_ActuationControl (OsEvent)
    Rte_Ev_Run_CpApController_RCtApController_ErrorDetection (OsEvent)
    Rte_Al_TE_CpApController_RCtApController_ErrorDetection (OsAlarm): OsAlarmCounterRef=VTTOs/SystemTimer, OsAlarmAccessingApplication=VTTOs/SystemApplication_OsCore0
      OsAlarmAction
        OsAlarmSetEvent: OsAlarmSetEventRef=VTTOs/Rte_Ev_Run_CpApController_RCtApController_ErrorDetection, OsAlarmSetEventTaskRef=VTTOs/Rte_Task
    PwmIsr_0 (OsIsr):  # /ActiveEcuC/VTTPwm PLAIN_TEXT PWM Interrupt for PwmChannel0. This OsInterrupt container has been created automatically based on the driver conﬁguration
      OsIsrInterruptPriority = 1
      OsIsrInitialEnableInterruptSource = false
      OsIsrCategory = CATEGORY_2
      OsIsrInterruptType = EXTERNAL
      OsIsrInterruptSource = 6
      OsIsrStackSize = 1024
      OsIsrEnableNesting = false
      OsIsrUsesFpu = false
  module config EcuC: implementation-config-variant=VARIANT-PRE-COMPILE, module-description=EcuC_Impl
    EcucPduCollection: PduIdTypeEnum=UINT8, PduLengthTypeEnum=UINT16
      14 x Pdu, all with PduLength=8, J1939Requestable=false:
        Comfort_HeadUnit_Frame_PDU_80f4a911_Rx: DynamicLength=false, SysTPduToFrameMappingRef=PduToFrameMapping_242c7490ec0b90cb
        Comfort_Fan_Frame_PDU_b6a0c8d2_Tx: DynamicLength=false, SysTPduToFrameMappingRef=PduToFrameMapping_da70f57f84e0c52f
        Comfort_Fan_Frame_PDU_68b7e774_Tx: DynamicLength=false
        Comfort_HeadUnit_Frame_PDU_6df1e8d4_Rx: DynamicLength=false
        Comfort_Fan_NM_PDU_Rx_68476f29_Rx: DynamicLength=false, SysTPduToFrameMappingRef=PduToFrameMapping_f9a155ae7a02421d
        Comfort_Fan_NM_PDU_Tx_3bb98271_Tx: DynamicLength=false, SysTPduToFrameMappingRef=PduToFrameMapping_60c901503b06c4eb
        Diag_Response_Fan_ECU_PDU_15224d29_Tx: DynamicLength=true
        Diag_Request_Fan_ECU_PDU_5809d877_Rx: DynamicLength=true
        Diag_Response_Fan_ECU_PDU_a20a679e_Tx: DynamicLength=true
        Comfort_TP_Diag_Request_Fan_ECU_Frame_PDU_c4e708c3_Rx: DynamicLength=false, SysTPduToFrameMappingRef=PduToFrameMapping_c1fb90dd528ac694
        Comfort_TP_Diag_Response_Fan_ECU_Frame_PDU_44cf1fc1_Tx: DynamicLength=false, SysTPduToFrameMappingRef=PduToFrameMapping_216562903d228812
        Diag_Request_Fan_ECU_PDU_96ea3459_Rx: DynamicLength=true
        Comfort_DrivingCycle_Frame_PDU_b08df3c0_Rx: DynamicLength=false
        Comfort_DrivingCycle_Frame_PDU_e1cdd903_Rx: DynamicLength=false, SysTPduToFrameMappingRef=PduToFrameMapping_f092b7843c42ae66
    EcucGeneral:
      CPUType = CPU32Bit
      ByteOrder = LITTLE_ENDIAN
      BitOrder = MSB_to_LSB
      AtomicBitAccessInBitfield = false
      AtomicVariableAccess = Atomic32BitAccess
      SizeOfEnum = Size32Bit
      SizeOfInt = Size32Bit
      SizeOfROMPointer = Size32Bit
      SizeOfRAMPointer = Size32Bit
      BitFieldDataType = INT
      StructAlignment = Auto
      ArrayAlignment = Auto
      StructInArrayAlignment = Auto
      DummyFunction = false
      DummyStatement = true
      DummyStatementKind = SelfAssignment
      ConditionalGenerating = true
      EcucBswImplementationCodeType = EcuCSourceCode
      EcuCUseStdReturnTypeForRte = false
      PostbuildLoadable: AlignmentFillPattern=170, PBROMStartAddress=0, PBRAMStartAddress=0, PBROMEndAddress=0, PBRAMEndAddress=0
      BswInitialization
        47 x InitFunction:
          BswM_PreInit: Header=BswM.h, InitPhase=INIT_ONE, ConfigType=BswM_ConfigType, ConfigPtrClass=BSWM_INIT_DATA, ConfigPtrName=BswM_Config_Ptr, ModuleRef=BswM  # /ActiveEcuC/BswM PLAIN_TEXT PreInit function description of BswM in UnfilteredViewInInvariantProject (UnfilteredInvariantProjectModelView) .
          BswM_InitMemory: Header=BswM.h, InitPhase=INIT_MEMORY, ModuleRef=BswM  # /ActiveEcuC/BswM PLAIN_TEXT InitMemory function description of BswM in UnfilteredViewInInvariantProject (UnfilteredInvariantProjectModelView) .
          BswM_Init: Header=BswM.h, InitPhase=NO_INIT, ConfigType=BswM_ConfigType, ConfigPtrClass=BSWM_INIT_DATA, ConfigPtrName=BswM_Config_Ptr, ModuleRef=BswM  # /ActiveEcuC/BswM PLAIN_TEXT Init function description of BswM in UnfilteredViewInInvariantProject (UnfilteredInvariantProjectModelView) .
          CanIf_Init: Header=CanIf.h, InitPhase=INIT_TWO_IF, ConfigType=CanIf_ConfigType, ConfigPtrClass=CANIF_INIT_DATA, ConfigPtrName=CanIf_Config_Ptr, ModuleRef=CanIf  # /ActiveEcuC/CanIf PLAIN_TEXT Init function description of CanIf in UnfilteredViewInInvariantProject (UnfilteredInvariantProjectModelView) .
          CanIf_InitMemory: Header=CanIf.h, InitPhase=INIT_MEMORY, ModuleRef=CanIf  # /ActiveEcuC/CanIf PLAIN_TEXT InitMemory function description of CanIf in UnfilteredViewInInvariantProject (UnfilteredInvariantProjectModelView) .
          CanNm_InitMemory: Header=CanNm.h, InitPhase=INIT_MEMORY, ModuleRef=CanNm  # /ActiveEcuC/CanNm PLAIN_TEXT InitMemory function description of CanNm in UnfilteredViewInInvariantProject (UnfilteredInvariantProjectModelView) .
          CanNm_Init: Header=CanNm.h, InitPhase=INIT_TWO_NM, ConfigType=CanNm_ConfigType, ConfigPtrClass=CANNM_INIT_DATA, ConfigPtrName=CanNm_Config_Ptr, ModuleRef=CanNm  # /ActiveEcuC/CanNm PLAIN_TEXT Init function description of CanNm in UnfilteredViewInInvariantProject (UnfilteredInvariantProjectModelView) .
          CanSM_InitMemory: Header=CanSM_EcuM.h, InitPhase=INIT_MEMORY, ModuleRef=CanSM  # /ActiveEcuC/CanSM PLAIN_TEXT InitMemory function description of CanSM in UnfilteredViewInInvariantProject (UnfilteredInvariantProjectModelView) .
          CanSM_Init: Header=CanSM_EcuM.h, InitPhase=INIT_TWO_SM, ConfigType=CanSM_ConfigType, ConfigPtrClass=CANSM_INIT_DATA, ConfigPtrName=CanSM_Config_Ptr, ModuleRef=CanSM  # /ActiveEcuC/CanSM PLAIN_TEXT Init function description of CanSM in UnfilteredViewInInvariantProject (UnfilteredInvariantProjectModelView) .
          Can_Init: Header=Can.h, InitPhase=INIT_TWO_DRV, ConfigType=Can_ConfigType, ConfigPtrClass=CAN_INIT_DATA, ConfigPtrName=Can_Config_Ptr, ModuleRef=Can  # /ActiveEcuC/Can PLAIN_TEXT Init function description of Can in UnfilteredViewInInvariantProject (UnfilteredInvariantProjectModelView) .
          Can_InitMemory: Header=Can.h, InitPhase=INIT_MEMORY, ModuleRef=Can  # /ActiveEcuC/Can PLAIN_TEXT InitMemory function description of Can in UnfilteredViewInInvariantProject (UnfilteredInvariantProjectModelView) .
          ComM_PreInit: Header=ComM.h, InitPhase=INIT_ONE, ConfigType=ComM_ConfigType, ConfigPtrClass=COMM_INIT_DATA, ConfigPtrName=ComM_Config_Ptr, ModuleRef=ComM  # /ActiveEcuC/ComM PLAIN_TEXT PreInit function description of ComM in UnfilteredViewInInvariantProject (UnfilteredInvariantProjectModelView) .
          ComM_Init: Header=ComM.h, InitPhase=INIT_TWO_POST_NVMREADALL, ConfigType=ComM_ConfigType, ConfigPtrClass=COMM_INIT_DATA, ConfigPtrName=ComM_Config_Ptr, ModuleRef=ComM  # /ActiveEcuC/ComM PLAIN_TEXT Init function description of ComM in UnfilteredViewInInvariantProject (UnfilteredInvariantProjectModelView) .
          ComM_PostInit: Header=ComM.h, InitPhase=INIT_THREE, ModuleRef=ComM  # /ActiveEcuC/ComM PLAIN_TEXT Post-Initialization of the ComM and its internal state machine
          ComM_InitMemory: Header=ComM.h, InitPhase=INIT_MEMORY, ModuleRef=ComM  # /ActiveEcuC/ComM PLAIN_TEXT InitMemory function description of ComM in UnfilteredViewInInvariantProject (UnfilteredInvariantProjectModelView) .
          ComXf_Init: Header=ComXf.h, InitPhase=NO_INIT, ModuleRef=ComXf  # /ActiveEcuC/ComXf PLAIN_TEXT Automatically generated by BswInitFctConfigurationService.
          Com_Init: Header=Com.h, InitPhase=INIT_TWO_COM, ConfigType=Com_ConfigType, ConfigPtrClass=COM_INIT_DATA, ConfigPtrName=Com_Config_Ptr, ModuleRef=Com  # /ActiveEcuC/Com PLAIN_TEXT Init function description of Com in UnfilteredViewInInvariantProject (UnfilteredInvariantProjectModelView) .
          Com_InitMemory: Header=Com.h, InitPhase=INIT_MEMORY, ModuleRef=Com  # /ActiveEcuC/Com PLAIN_TEXT InitMemory function description of Com in UnfilteredViewInInvariantProject (UnfilteredInvariantProjectModelView) .
          Det_InitMemory: Header=Det.h, InitPhase=INIT_MEMORY, ModuleRef=Det  # /ActiveEcuC/Det PLAIN_TEXT InitMemory function description of Det in UnfilteredViewInInvariantProject (UnfilteredInvariantProjectModelView) .
          Det_Init: Header=Det.h, InitPhase=INIT_ZERO, ConfigType=Det_ConfigType, ConfigPtrClass=DET_INIT_DATA, ConfigPtrName=Det_Config_Ptr, ModuleRef=Det  # /ActiveEcuC/Det PLAIN_TEXT Init function description of Det in UnfilteredViewInInvariantProject (UnfilteredInvariantProjectModelView) .
          EcuM_Init: Header=EcuM.h, InitPhase=NO_INIT, ConfigType=EcuM_PbConfigType, ConfigPtrClass=ECUM_INIT_DATA, ConfigPtrName=EcuM_Config_Ptr, ModuleRef=EcuM  # /ActiveEcuC/EcuM PLAIN_TEXT Init function description of EcuM in UnfilteredViewInInvariantProject (UnfilteredInvariantProjectModelView) .
          Mcu_Init: Header=Mcu.h, InitPhase=INIT_TWO_MCAL, ConfigType=Mcu_ConfigType, ConfigPtrClass=MCU_APPL_CONST, ConfigPtrName=McuModuleConfiguration, ModuleRef=Mcu  # /ActiveEcuC/Mcu PLAIN_TEXT Initialization of VttMcu Module
          Nm_PreInit: Header=Nm.h, InitPhase=INIT_ONE, ConfigType=Nm_ConfigType, ConfigPtrClass=NM_INIT_DATA, ConfigPtrName=Nm_Config_Ptr, ModuleRef=Nm  # /ActiveEcuC/Nm PLAIN_TEXT PreInit function description of Nm in UnfilteredViewInInvariantProject (UnfilteredInvariantProjectModelView) .
          Nm_PostInit: Header=Nm.h, InitPhase=INIT_THREE, ModuleRef=Nm  # /ActiveEcuC/Nm PLAIN_TEXT Post-Initialization of the Network Management and its internal state machine
          Nm_InitMemory: Header=Nm.h, InitPhase=INIT_MEMORY, ModuleRef=Nm  # /ActiveEcuC/Nm PLAIN_TEXT InitMemory function description of Nm in UnfilteredViewInInvariantProject (UnfilteredInvariantProjectModelView) .
          Nm_Init: Header=Nm.h, InitPhase=INIT_TWO_NM, ConfigType=Nm_ConfigType, ConfigPtrClass=NM_INIT_DATA, ConfigPtrName=Nm_Config_Ptr, ModuleRef=Nm  # /ActiveEcuC/Nm PLAIN_TEXT Init function description of Nm in UnfilteredViewInInvariantProject (UnfilteredInvariantProjectModelView) .
          PduR_PreInit: Header=PduR.h, InitPhase=INIT_ONE, ConfigType=PduR_PBConfigType, ConfigPtrClass=PDUR_INIT_DATA, ConfigPtrName=PduR_Config_Ptr, ModuleRef=PduR  # /ActiveEcuC/PduR PLAIN_TEXT PreInit function description of PduR in UnfilteredViewInInvariantProject (UnfilteredInvariantProjectModelView) .
          PduR_InitMemory: Header=PduR.h, InitPhase=INIT_MEMORY, ModuleRef=PduR  # /ActiveEcuC/PduR PLAIN_TEXT InitMemory function description of PduR in UnfilteredViewInInvariantProject (UnfilteredInvariantProjectModelView) .
          PduR_Init: Header=PduR.h, InitPhase=INIT_TWO_COM, ConfigType=PduR_PBConfigType, ConfigPtrClass=PDUR_INIT_DATA, ConfigPtrName=PduR_Config_Ptr, ModuleRef=PduR  # /ActiveEcuC/PduR PLAIN_TEXT Init function description of PduR in UnfilteredViewInInvariantProject (UnfilteredInvariantProjectModelView) .
          SchM_StartTiming: Header=Rte_Main.h, InitPhase=NO_INIT, ModuleRef=Rte  # /ActiveEcuC/Rte PLAIN_TEXT Automatically generated by BswInitFctConfigurationService.
          Rte_InitMemory: Header=Rte_Main.h, InitPhase=INIT_MEMORY, ModuleRef=Rte  # /ActiveEcuC/Rte PLAIN_TEXT Automatically generated by BswInitFctConfigurationService.
          SchM_Start: Header=Rte_Main.h, InitPhase=NO_INIT, ModuleRef=Rte  # /ActiveEcuC/Rte PLAIN_TEXT Automatically generated by BswInitFctConfigurationService.
          Rte_Start: Header=Rte_Main.h, InitPhase=INIT_THREE, ModuleRef=Rte  # /ActiveEcuC/Rte PLAIN_TEXT Automatically generated by BswInitFctConfigurationService.
          Rte_StartTiming: Header=Rte_Main.h, InitPhase=NO_INIT, ModuleRef=Rte  # /ActiveEcuC/Rte PLAIN_TEXT Automatically generated by BswInitFctConfigurationService.
          SchM_Init: Header=Rte_Main.h, InitPhase=NO_INIT, ModuleRef=Rte  # /ActiveEcuC/Rte PLAIN_TEXT Automatically generated by BswInitFctConfigurationService.
          Adc_Init: Header=Adc.h, InitPhase=INIT_TWO_MCAL, ConfigType=Adc_ConfigType, ConfigPtrClass=ADC_APPL_CONST, ConfigPtrName=AdcConfigSet, ModuleRef=Adc  # /ActiveEcuC/Adc PLAIN_TEXT Initialization of VttAdc Module
          Pwm_Init: Header=Pwm.h, InitPhase=INIT_TWO_MCAL, ConfigType=Pwm_ConfigType, ConfigPtrClass=PWM_APPL_CONST, ConfigPtrName=PwmChannelConfigSet, ModuleRef=Pwm  # /ActiveEcuC/Pwm PLAIN_TEXT Initialization of VttPwm Module
          Dcm_Init: Header=Dcm.h, InitPhase=INIT_TWO_POST_NVMREADALL, ConfigType=Dcm_ConfigType, ConfigPtrClass=DCM_CONST, ConfigPtrName=NULL_PTR, ModuleRef=Dcm  # /ActiveEcuC/Dcm PLAIN_TEXT Dcm_Init function description
          Dcm_InitMemory: Header=Dcm.h, InitPhase=INIT_MEMORY, ModuleRef=Dcm  # /ActiveEcuC/Dcm PLAIN_TEXT Dcm_InitMemory function description
          Dem_InitMemory: Header=Dem.h, InitPhase=INIT_MEMORY, ModuleRef=Dem  # /ActiveEcuC/Dem PLAIN_TEXT InitMemory function description of Dem in UnfilteredViewInInvariantProject (UnfilteredInvariantProjectModelView) .
          Dem_Init: Header=Dem.h, InitPhase=INIT_TWO_POST_NVMREADALL, ConfigType=Dem_ConfigType, ConfigPtrClass=DEM_INIT_DATA, ConfigPtrName=Dem_Config_Ptr, ModuleRef=Dem  # /ActiveEcuC/Dem PLAIN_TEXT Init function description of Dem in UnfilteredViewInInvariantProject (UnfilteredInvariantProjectModelView) .
          Dem_PreInit: Header=Dem.h, InitPhase=INIT_ZERO, ConfigType=Dem_ConfigType, ConfigPtrClass=DEM_INIT_DATA, ConfigPtrName=Dem_Config_Ptr, ModuleRef=Dem  # /ActiveEcuC/Dem PLAIN_TEXT PreInit function description of Dem in UnfilteredViewInInvariantProject (UnfilteredInvariantProjectModelView) .
          NvM_Init: Header=NvM.h, InitPhase=INIT_TWO_SYS, ModuleRef=NvM  # /ActiveEcuC/NvM PLAIN_TEXT Initialization of the NVRAM Manager, to make it ready for NvM_ReadAll being requested
          Fee_Init: Header=Fee.h, InitPhase=INIT_TWO_IF, ModuleRef=Fee  # /ActiveEcuC/Fee PLAIN_TEXT Initialization of the FEE
          Fls_Init: Header=Fls.h, InitPhase=INIT_TWO_MCAL, ConfigType=Fls_ConfigType, ConfigPtrClass=FLS_APPL_CONST, ConfigPtrName=FlsConfigSet, ModuleRef=Fls  # /ActiveEcuC/Fls PLAIN_TEXT Initialization of VttFls Module
          CanTp_InitMemory: Header=CanTp.h, InitPhase=INIT_MEMORY, ModuleRef=CanTp  # /ActiveEcuC/CanTp PLAIN_TEXT InitMemory function description of CanTp in UnfilteredViewInInvariantProject (UnfilteredInvariantProjectModelView) .
          CanTp_Init: Header=CanTp.h, InitPhase=INIT_TWO_TP, ConfigType=CanTp_ConfigType, ConfigPtrClass=CANTP_INIT_DATA, ConfigPtrName=CanTp_Config_Ptr, ModuleRef=CanTp  # /ActiveEcuC/CanTp PLAIN_TEXT Init function description of CanTp in UnfilteredViewInInvariantProject (UnfilteredInvariantProjectModelView) .
    EcucHardware
      EcucCoreDefinition: EcucCoreId=0
  module config VTTMcu: implementation-config-variant=VARIANT-PRE-COMPILE, module-description=VTTMcu_Impl
    McuGeneralConfiguration:
      McuDevErrorDetect = true
      McuGetRamStateApi = false
      McuInitClock = true
      McuNoPll = true
      McuPerformResetApi = true
      McuVersionInfoApi = false
      McuSafeBswChecks = false
    McuPublishedInformation
    McuModuleConfiguration
      McuClockSettingConfig
      4 x McuModeSettingConf:
        POWER_OFF: McuMode=3, McuVttMode=VTTMCU_MODE_POWER_OFF
        SLEEP: McuMode=1, McuVttMode=VTTMCU_MODE_SLEEP
        RESET: McuMode=2, McuVttMode=VTTMCU_MODE_RESET
        NORMAL: McuMode=0, McuVttMode=VTTMCU_MODE_NORMAL
  module config ComXf: implementation-config-variant=VARIANT-PRE-COMPILE, module-description=ComXf_Impl
    XfrmGeneral: XfrmDevErrorDetect=true, XfrmVersionInfoApi=false
  module config CanSM: implementation-config-variant=VARIANT-PRE-COMPILE, module-description=CanSM_Impl
    CanSMConfiguration: CanSMModeRequestRepetitionMax=10, CanSMModeRequestRepetitionTime=0.1
      CANChannel_213aa5c2 (CanSMManagerNetwork):
        CanSMBorCounterL1ToL2 = 5
        CanSMBorTimeL1 = 1
        CanSMBorTimeL2 = 3
        CanSMBorTimeTxEnsured = 5
        CanSMBorTxConfirmationPolling = false
        CanSMComMNetworkHandleRef = Connector_Fan_ECU_fbc5880ce1a0cdea_90249745
        Controller_Fan_ECU_02f7c8db915351a9_f6205173 (CanSMController): CanSMControllerId=CanIfCtrlDrvCfg_7d254554/Controller_Fan_ECU_02f7c8db915351a9_92c03ed2
    CanSMGeneral:
      CanSMDevErrorDetect = true
      CanSMMainFunctionTimePeriod = 0.01
      CanSMVersionInfoApi = false
      CanSMBorCheckLevel = false
      CanSMSafeBswChecks = true
      CanSMSetBaudrateApi = true
      CanSMGeneration: CanSMOutOfBoundsWriteSanitizer=false, CanSMOutOfBoundsReadSanitizer=false
  module config VTTCntrl: implementation-config-variant=VARIANT-PRE-COMPILE, module-description=VTTCntrl_Impl
    VttGeneral: VttPreferredInputAsrVersion=4.2.1, VttRequiredEcucGeneratorVersion=1.0, VttEntryPointName=main, VttHeaderFile=, VttUserCalloutOnStateChange=false
    VttSystemVariables
      3 x VttSysVarType:
        sint64
        float64
        uint64
  module config VTTvSet: implementation-config-variant=VARIANT-PRE-COMPILE, module-description=VTTvSet_Impl
    vSetPlatform: vSetBitOrder=LSB_to_MSB, vSetByteOrder=LITTLE_ENDIAN
    vSetGeneral: vSetDummyStatementKind=None
    vSetCalibration
    vSetBswInitialization
      47 x vSetInitFunction:
        Nm_PreInit: vSetHeader=Nm.h, vSetConfigType=Nm_ConfigType, vSetConfigPtrClass=NM_INIT_DATA, vSetModuleRef=Nm
          vSetInitFunctionInstance: vSetInitPhase=INIT_ONE, vSetConfigPtrName=Nm_Config_Ptr
        Det_InitMemory: vSetHeader=Det.h, vSetModuleRef=Det
          vSetInitFunctionInstance: vSetInitPhase=INIT_MEMORY
        PduR_Init: vSetHeader=PduR.h, vSetConfigPtrClass=PDUR_INIT_DATA, vSetConfigType=PduR_PBConfigType, vSetModuleRef=PduR
          vSetInitFunctionInstance: vSetInitPhase=INIT_TWO_COM, vSetConfigPtrName=PduR_Config_Ptr
        SchM_Init: vSetHeader=Rte_Main.h, vSetModuleRef=Rte
          vSetInitFunctionInstance: vSetInitPhase=NO_INIT
        ComM_InitMemory: vSetHeader=ComM.h, vSetModuleRef=ComM
          vSetInitFunctionInstance: vSetInitPhase=INIT_MEMORY
        ComXf_Init: vSetHeader=ComXf.h, vSetModuleRef=ComXf
          vSetInitFunctionInstance: vSetInitPhase=NO_INIT
        ComM_Init: vSetHeader=ComM.h, vSetConfigPtrClass=COMM_INIT_DATA, vSetConfigType=ComM_ConfigType, vSetModuleRef=ComM
          vSetInitFunctionInstance: vSetInitPhase=INIT_TWO_POST_NVMREADALL, vSetConfigPtrName=ComM_Config_Ptr
        Can_InitMemory: vSetHeader=Can.h, vSetModuleRef=VTTCan
          vSetInitFunctionInstance: vSetInitPhase=INIT_MEMORY
        PduR_InitMemory: vSetHeader=PduR.h, vSetModuleRef=PduR
          vSetInitFunctionInstance: vSetInitPhase=INIT_MEMORY
        CanIf_InitMemory: vSetHeader=CanIf.h, vSetModuleRef=CanIf
          vSetInitFunctionInstance: vSetInitPhase=INIT_MEMORY
        Rte_Start: vSetHeader=Rte_Main.h, vSetModuleRef=Rte
          vSetInitFunctionInstance: vSetInitPhase=INIT_THREE
        CanSM_InitMemory: vSetHeader=CanSM_EcuM.h, vSetModuleRef=CanSM
          vSetInitFunctionInstance: vSetInitPhase=INIT_MEMORY
        Com_Init: vSetHeader=Com.h, vSetConfigType=Com_ConfigType, vSetConfigPtrClass=COM_INIT_DATA, vSetModuleRef=Com
          vSetInitFunctionInstance: vSetInitPhase=INIT_TWO_COM, vSetConfigPtrName=Com_Config_Ptr
        EcuM_Init: vSetHeader=EcuM.h, vSetConfigPtrClass=ECUM_INIT_DATA, vSetConfigType=EcuM_PbConfigType, vSetModuleRef=EcuM
          vSetInitFunctionInstance: vSetInitPhase=NO_INIT, vSetConfigPtrName=EcuM_Config_Ptr
        BswM_InitMemory: vSetHeader=BswM.h, vSetModuleRef=BswM
          vSetInitFunctionInstance: vSetInitPhase=INIT_MEMORY
        Nm_PostInit: vSetHeader=Nm.h, vSetModuleRef=Nm
          vSetInitFunctionInstance: vSetInitPhase=INIT_THREE
        ComM_PreInit: vSetHeader=ComM.h, vSetConfigType=ComM_ConfigType, vSetConfigPtrClass=COMM_INIT_DATA, vSetModuleRef=ComM
          vSetInitFunctionInstance: vSetInitPhase=INIT_ONE, vSetConfigPtrName=ComM_Config_Ptr
        Com_InitMemory: vSetHeader=Com.h, vSetModuleRef=Com
          vSetInitFunctionInstance: vSetInitPhase=INIT_MEMORY
        Rte_StartTiming: vSetHeader=Rte_Main.h, vSetModuleRef=Rte
          vSetInitFunctionInstance: vSetInitPhase=NO_INIT
        CanNm_Init: vSetHeader=CanNm.h, vSetConfigType=CanNm_ConfigType, vSetConfigPtrClass=CANNM_INIT_DATA, vSetModuleRef=CanNm
          vSetInitFunctionInstance: vSetInitPhase=INIT_TWO_NM, vSetConfigPtrName=CanNm_Config_Ptr
        CanSM_Init: vSetHeader=CanSM_EcuM.h, vSetConfigPtrClass=CANSM_INIT_DATA, vSetConfigType=CanSM_ConfigType, vSetModuleRef=CanSM
          vSetInitFunctionInstance: vSetInitPhase=INIT_TWO_SM, vSetConfigPtrName=CanSM_Config_Ptr
        Rte_InitMemory: vSetHeader=Rte_Main.h, vSetModuleRef=Rte
          vSetInitFunctionInstance: vSetInitPhase=INIT_MEMORY
        BswM_PreInit: vSetHeader=BswM.h, vSetConfigType=BswM_ConfigType, vSetConfigPtrClass=BSWM_INIT_DATA, vSetModuleRef=BswM
          vSetInitFunctionInstance: vSetInitPhase=INIT_ONE, vSetConfigPtrName=BswM_Config_Ptr
        Nm_InitMemory: vSetHeader=Nm.h, vSetModuleRef=Nm
          vSetInitFunctionInstance: vSetInitPhase=INIT_MEMORY
        BswM_Init: vSetHeader=BswM.h, vSetConfigPtrClass=BSWM_INIT_DATA, vSetConfigType=BswM_ConfigType, vSetModuleRef=BswM
          vSetInitFunctionInstance: vSetInitPhase=NO_INIT, vSetConfigPtrName=BswM_Config_Ptr
        CanNm_InitMemory: vSetHeader=CanNm.h, vSetModuleRef=CanNm
          vSetInitFunctionInstance: vSetInitPhase=INIT_MEMORY
        ComM_PostInit: vSetHeader=ComM.h, vSetModuleRef=ComM
          vSetInitFunctionInstance: vSetInitPhase=INIT_THREE
        Nm_Init: vSetHeader=Nm.h, vSetConfigType=Nm_ConfigType, vSetConfigPtrClass=NM_INIT_DATA, vSetModuleRef=Nm
          vSetInitFunctionInstance: vSetInitPhase=INIT_TWO_NM, vSetConfigPtrName=Nm_Config_Ptr
        PduR_PreInit: vSetHeader=PduR.h, vSetConfigType=PduR_PBConfigType, vSetConfigPtrClass=PDUR_INIT_DATA, vSetModuleRef=PduR
          vSetInitFunctionInstance: vSetInitPhase=INIT_ONE, vSetConfigPtrName=PduR_Config_Ptr
        Mcu_Init: vSetHeader=Mcu.h, vSetConfigPtrClass=MCU_APPL_CONST, vSetConfigType=Mcu_ConfigType, vSetModuleRef=VTTMcu
          vSetInitFunctionInstance: vSetInitPhase=INIT_TWO_MCAL, vSetConfigPtrName=McuModuleConfiguration
        CanIf_Init: vSetHeader=CanIf.h, vSetConfigType=CanIf_ConfigType, vSetConfigPtrClass=CANIF_INIT_DATA, vSetModuleRef=CanIf
          vSetInitFunctionInstance: vSetInitPhase=INIT_TWO_IF, vSetConfigPtrName=CanIf_Config_Ptr
        Can_Init: vSetHeader=Can.h, vSetConfigPtrClass=CAN_INIT_DATA, vSetConfigType=Can_ConfigType, vSetModuleRef=VTTCan
          vSetInitFunctionInstance: vSetInitPhase=INIT_TWO_DRV, vSetConfigPtrName=Can_Config_Ptr
        SchM_Start: vSetHeader=Rte_Main.h, vSetModuleRef=Rte
          vSetInitFunctionInstance: vSetInitPhase=NO_INIT
        Det_Init: vSetHeader=Det.h, vSetConfigType=Det_ConfigType, vSetConfigPtrClass=DET_INIT_DATA, vSetModuleRef=Det
          vSetInitFunctionInstance: vSetInitPhase=INIT_ZERO, vSetConfigPtrName=Det_Config_Ptr
        SchM_StartTiming: vSetHeader=Rte_Main.h, vSetModuleRef=Rte
          vSetInitFunctionInstance: vSetInitPhase=NO_INIT
        Adc_Init: vSetHeader=Adc.h, vSetConfigType=Adc_ConfigType, vSetConfigPtrClass=ADC_APPL_CONST, vSetModuleRef=VTTAdc
          vSetInitFunctionInstance: vSetInitPhase=INIT_TWO_MCAL, vSetConfigPtrName=AdcConfigSet
        Pwm_Init: vSetHeader=Pwm.h, vSetConfigType=Pwm_ConfigType, vSetConfigPtrClass=PWM_APPL_CONST, vSetModuleRef=VTTPwm
          vSetInitFunctionInstance: vSetInitPhase=INIT_TWO_POST_NVMREADALL, vSetConfigPtrName=PwmChannelConfigSet
        Dcm_InitMemory: vSetHeader=Dcm.h, vSetModuleRef=Dcm
          vSetInitFunctionInstance: vSetInitPhase=INIT_MEMORY
        Dem_Init: vSetHeader=Dem.h, vSetConfigType=Dem_ConfigType, vSetConfigPtrClass=DEM_INIT_DATA, vSetModuleRef=Dem
          vSetInitFunctionInstance: vSetInitPhase=INIT_TWO_POST_NVMREADALL, vSetConfigPtrName=Dem_Config_Ptr
        NvM_Init: vSetHeader=NvM.h, vSetModuleRef=NvM
          vSetInitFunctionInstance: vSetInitPhase=INIT_TWO_SYS
        Dem_InitMemory: vSetHeader=Dem.h, vSetModuleRef=Dem
          vSetInitFunctionInstance: vSetInitPhase=INIT_MEMORY
        Dcm_Init: vSetHeader=Dcm.h, vSetConfigType=Dcm_ConfigType, vSetConfigPtrClass=DCM_CONST, vSetModuleRef=Dcm
          vSetInitFunctionInstance: vSetInitPhase=INIT_TWO_POST_NVMREADALL, vSetConfigPtrName=NULL_PTR
        Dem_PreInit: vSetHeader=Dem.h, vSetConfigType=Dem_ConfigType, vSetConfigPtrClass=DEM_INIT_DATA, vSetModuleRef=Dem
          vSetInitFunctionInstance: vSetInitPhase=INIT_ZERO, vSetConfigPtrName=Dem_Config_Ptr
        Fee_Init: vSetHeader=Fee.h, vSetModuleRef=Fee
          vSetInitFunctionInstance: vSetInitPhase=INIT_TWO_IF
        Fls_Init: vSetHeader=Fls.h, vSetConfigType=Fls_ConfigType, vSetConfigPtrClass=FLS_APPL_CONST, vSetModuleRef=VTTFls
          vSetInitFunctionInstance: vSetInitPhase=INIT_TWO_MCAL, vSetConfigPtrName=FlsConfigSet
        CanTp_Init: vSetHeader=CanTp.h, vSetConfigPtrClass=CANTP_INIT_DATA, vSetConfigType=CanTp_ConfigType, vSetModuleRef=CanTp
          vSetInitFunctionInstance: vSetInitPhase=INIT_TWO_TP, vSetConfigPtrName=CanTp_Config_Ptr
        CanTp_InitMemory: vSetHeader=CanTp.h, vSetModuleRef=CanTp
          vSetInitFunctionInstance: vSetInitPhase=INIT_MEMORY
  module config MemMap: implementation-config-variant=VARIANT-PRE-COMPILE, module-description=MemMap_Impl
    vHsmGlobalRamBuffer (MemMapAddressingModeSet): MemMapCompilerMemClassSymbolImpl=
      vHsmGlobalRamBuffer (MemMapAddressingMode): MemMapAlignmentSelector=UNSPECIFIED, MemMapAlignmentSelector=32, MemMapLinkerLogicalGroupRef=vHsmGlobalRamBuffer
    vHsmIpcMemory (MemMapAddressingModeSet): MemMapCompilerMemClassSymbolImpl=
      vHsmIpcMemory (MemMapAddressingMode): MemMapAlignmentSelector=32, MemMapLinkerLogicalGroupRef=vHsmIpcMemory
    vHsm_Generic (MemMapAllocation)
      3 x MemMapSectionSpecificMapping:
        vHsmGlobalRamBuffer: MemMapAddressingModeSetRef=MemMap/vHsmGlobalRamBuffer, MemMapMemorySectionRef=CRYPTO_30_VHSM_GLOBAL_VAR_NOINIT_32BIT, MemMapMemorySectionRef=CRYPTO_30_VHSM_GLOBAL_VAR_NOINIT_UNSPECIFIED
        vHsmIpcMemory: MemMapAddressingModeSetRef=MemMap/vHsmIpcMemory, MemMapMemorySectionRef=CRYPTO_30_VHSM_IPC_MEMORY_VAR_NOINIT_32BIT
        vHsmRamCode: MemMapAddressingModeSetRef=MemMap/vHsmRamCode, MemMapMemorySectionRef=CRYPTO_30_VHSM_RAMCODE
    vHsmRamCode (MemMapAddressingModeSet): MemMapCompilerMemClassSymbolImpl=
      vHsmRamCode (MemMapAddressingMode): MemMapAlignmentSelector=UNSPECIFIED
    MemMap_Common (MemMapModule): MemMapGenerateAdditionalMemorySections=true
      113 x MemMapAdditionalMemorySection, all with MemMapMemorySectionFileName=MemMap_Common.h, MemMapMemorySectionPrefix=:
        CODE: MemMapMemorySectionSymbol=CODE, MemMapMemorySectionSwAddrMethodRef=CODE
        CODE_FAST: MemMapMemorySectionSymbol=CODE_FAST, MemMapMemorySectionSwAddrMethodRef=CODE_FAST
        CODE_ISR: MemMapMemorySectionSymbol=CODE_ISR, MemMapMemorySectionSwAddrMethodRef=CODE_ISR
        CONST: MemMapMemorySectionAlignment=UNSPECIFIED, MemMapMemorySectionSymbol=CONST, MemMapMemorySectionSwAddrMethodRef=CONST
        CONST_8BIT: MemMapMemorySectionAlignment=8, MemMapMemorySectionSymbol=CONST_8BIT, MemMapMemorySectionSwAddrMethodRef=CONST
        CONST_16BIT: MemMapMemorySectionAlignment=16, MemMapMemorySectionSymbol=CONST_16BIT, MemMapMemorySectionSwAddrMethodRef=CONST
        CONST_32BIT: MemMapMemorySectionAlignment=32, MemMapMemorySectionSymbol=CONST_32BIT, MemMapMemorySectionSwAddrMethodRef=CONST
        CONST_64BIT: MemMapMemorySectionAlignment=64, MemMapMemorySectionSymbol=CONST_64BIT, MemMapMemorySectionSwAddrMethodRef=CONST
        CONST_8: MemMapMemorySectionAlignment=8, MemMapMemorySectionSymbol=CONST_8, MemMapMemorySectionSwAddrMethodRef=CONST
        CONST_16: MemMapMemorySectionAlignment=16, MemMapMemorySectionSymbol=CONST_16, MemMapMemorySectionSwAddrMethodRef=CONST
        CONST_32: MemMapMemorySectionAlignment=32, MemMapMemorySectionSymbol=CONST_32, MemMapMemorySectionSwAddrMethodRef=CONST
        CONST_64: MemMapMemorySectionAlignment=64, MemMapMemorySectionSymbol=CONST_64, MemMapMemorySectionSwAddrMethodRef=CONST
        CONST_UNSPECIFIED: MemMapMemorySectionAlignment=UNSPECIFIED, MemMapMemorySectionSymbol=CONST_UNSPECIFIED, MemMapMemorySectionSwAddrMethodRef=CONST
        CONST_FAST_8BIT: MemMapMemorySectionAlignment=8, MemMapMemorySectionSymbol=CONST_FAST_8BIT, MemMapMemorySectionSwAddrMethodRef=CONST_FAST
        CONST_FAST_16BIT: MemMapMemorySectionAlignment=16, MemMapMemorySectionSymbol=CONST_FAST_16BIT, MemMapMemorySectionSwAddrMethodRef=CONST_FAST
        CONST_FAST_32BIT: MemMapMemorySectionAlignment=32, MemMapMemorySectionSymbol=CONST_FAST_32BIT, MemMapMemorySectionSwAddrMethodRef=CONST_FAST
        CONST_FAST_64BIT: MemMapMemorySectionAlignment=64, MemMapMemorySectionSymbol=CONST_FAST_64BIT, MemMapMemorySectionSwAddrMethodRef=CONST_FAST
        CONST_FAST_8: MemMapMemorySectionAlignment=8, MemMapMemorySectionSymbol=CONST_FAST_8, MemMapMemorySectionSwAddrMethodRef=CONST_FAST
        CONST_FAST_16: MemMapMemorySectionAlignment=16, MemMapMemorySectionSymbol=CONST_FAST_16, MemMapMemorySectionSwAddrMethodRef=CONST_FAST
        CONST_FAST_32: MemMapMemorySectionAlignment=32, MemMapMemorySectionSymbol=CONST_FAST_32, MemMapMemorySectionSwAddrMethodRef=CONST_FAST
        CONST_FAST_64: MemMapMemorySectionAlignment=64, MemMapMemorySectionSymbol=CONST_FAST_64, MemMapMemorySectionSwAddrMethodRef=CONST_FAST
        CONST_FAST_UNSPECIFIED: MemMapMemorySectionAlignment=UNSPECIFIED, MemMapMemorySectionSymbol=CONST_FAST_UNSPECIFIED, MemMapMemorySectionSwAddrMethodRef=CONST_FAST
        CONST_PBCFG: MemMapMemorySectionSymbol=CONST_PBCFG, MemMapMemorySectionSwAddrMethodRef=CONST_PBCFG
        PBCFG_GLOBALROOT: MemMapMemorySectionSymbol=PBCFG_GLOBALROOT, MemMapMemorySectionSwAddrMethodRef=PBCFG_GLOBALROOT
        VAR: MemMapMemorySectionAlignment=UNSPECIFIED, MemMapMemorySectionSymbol=VAR, MemMapMemorySectionSwAddrMethodRef=VAR_INIT
        VAR_INIT_8BIT: MemMapMemorySectionAlignment=8, MemMapMemorySectionSymbol=VAR_INIT_8BIT, MemMapMemorySectionSwAddrMethodRef=VAR_INIT
        VAR_INIT_16BIT: MemMapMemorySectionAlignment=16, MemMapMemorySectionSymbol=VAR_INIT_16BIT, MemMapMemorySectionSwAddrMethodRef=VAR_INIT
        VAR_INIT_32BIT: MemMapMemorySectionAlignment=32, MemMapMemorySectionSymbol=VAR_INIT_32BIT, MemMapMemorySectionSwAddrMethodRef=VAR_INIT
        VAR_INIT_64BIT: MemMapMemorySectionAlignment=64, MemMapMemorySectionSymbol=VAR_INIT_64BIT, MemMapMemorySectionSwAddrMethodRef=VAR_INIT
        VAR_INIT_8: MemMapMemorySectionAlignment=8, MemMapMemorySectionSymbol=VAR_INIT_8, MemMapMemorySectionSwAddrMethodRef=VAR_INIT
        VAR_INIT_16: MemMapMemorySectionAlignment=16, MemMapMemorySectionSymbol=VAR_INIT_16, MemMapMemorySectionSwAddrMethodRef=VAR_INIT
        VAR_INIT_32: MemMapMemorySectionAlignment=32, MemMapMemorySectionSymbol=VAR_INIT_32, MemMapMemorySectionSwAddrMethodRef=VAR_INIT
        VAR_INIT_64: MemMapMemorySectionAlignment=64, MemMapMemorySectionSymbol=VAR_INIT_64, MemMapMemorySectionSwAddrMethodRef=VAR_INIT
        VAR_INIT_UNSPECIFIED: MemMapMemorySectionAlignment=UNSPECIFIED, MemMapMemorySectionSymbol=VAR_INIT_UNSPECIFIED, MemMapMemorySectionSwAddrMethodRef=VAR_INIT
        VAR_NOINIT_8BIT: MemMapMemorySectionAlignment=8, MemMapMemorySectionSymbol=VAR_NOINIT_8BIT, MemMapMemorySectionSwAddrMethodRef=VAR_NO_INIT
        VAR_NOINIT_16BIT: MemMapMemorySectionAlignment=16, MemMapMemorySectionSymbol=VAR_NOINIT_16BIT, MemMapMemorySectionSwAddrMethodRef=VAR_NO_INIT
        VAR_NOINIT_32BIT: MemMapMemorySectionAlignment=32, MemMapMemorySectionSymbol=VAR_NOINIT_32BIT, MemMapMemorySectionSwAddrMethodRef=VAR_NO_INIT
        VAR_NOINIT_64BIT: MemMapMemorySectionAlignment=64, MemMapMemorySectionSymbol=VAR_NOINIT_64BIT, MemMapMemorySectionSwAddrMethodRef=VAR_NO_INIT
        VAR_NO_INIT_8: MemMapMemorySectionAlignment=8, MemMapMemorySectionSymbol=VAR_NO_INIT_8, MemMapMemorySectionSwAddrMethodRef=VAR_NO_INIT
        VAR_NO_INIT_16: MemMapMemorySectionAlignment=16, MemMapMemorySectionSymbol=VAR_NO_INIT_16, MemMapMemorySectionSwAddrMethodRef=VAR_NO_INIT
        VAR_NO_INIT_32: MemMapMemorySectionAlignment=32, MemMapMemorySectionSymbol=VAR_NO_INIT_32, MemMapMemorySectionSwAddrMethodRef=VAR_NO_INIT
        VAR_NO_INIT_64: MemMapMemorySectionAlignment=64, MemMapMemorySectionSymbol=VAR_NO_INIT_64, MemMapMemorySectionSwAddrMethodRef=VAR_NO_INIT
        VAR_NOINIT_UNSPECIFIED: MemMapMemorySectionAlignment=UNSPECIFIED, MemMapMemorySectionSymbol=VAR_NOINIT_UNSPECIFIED, MemMapMemorySectionSwAddrMethodRef=VAR_NO_INIT
        VAR_NO_INIT_UNSPECIFIED: MemMapMemorySectionAlignment=UNSPECIFIED, MemMapMemorySectionSymbol=VAR_NO_INIT_UNSPECIFIED, MemMapMemorySectionSwAddrMethodRef=VAR_NO_INIT
        VAR_ZERO_INIT_8BIT: MemMapMemorySectionAlignment=8, MemMapMemorySectionSymbol=VAR_ZERO_INIT_8BIT, MemMapMemorySectionSwAddrMethodRef=VAR_CLEARED
        VAR_ZERO_INIT_16BIT: MemMapMemorySectionAlignment=16, MemMapMemorySectionSymbol=VAR_ZERO_INIT_16BIT, MemMapMemorySectionSwAddrMethodRef=VAR_CLEARED
        VAR_ZERO_INIT_32BIT: MemMapMemorySectionAlignment=32, MemMapMemorySectionSymbol=VAR_ZERO_INIT_32BIT, MemMapMemorySectionSwAddrMethodRef=VAR_CLEARED
        VAR_ZERO_INIT_64BIT: MemMapMemorySectionAlignment=64, MemMapMemorySectionSymbol=VAR_ZERO_INIT_64BIT, MemMapMemorySectionSwAddrMethodRef=VAR_CLEARED
        VAR_CLEARED_8: MemMapMemorySectionAlignment=8, MemMapMemorySectionSymbol=VAR_CLEARED_8, MemMapMemorySectionSwAddrMethodRef=VAR_CLEARED
        VAR_CLEARED_16: MemMapMemorySectionAlignment=16, MemMapMemorySectionSymbol=VAR_CLEARED_16, MemMapMemorySectionSwAddrMethodRef=VAR_CLEARED
        VAR_CLEARED_32: MemMapMemorySectionAlignment=32, MemMapMemorySectionSymbol=VAR_CLEARED_32, MemMapMemorySectionSwAddrMethodRef=VAR_CLEARED
        VAR_CLEARED_64: MemMapMemorySectionAlignment=64, MemMapMemorySectionSymbol=VAR_CLEARED_64, MemMapMemorySectionSwAddrMethodRef=VAR_CLEARED
        VAR_CLEARED_UNSPECIFIED: MemMapMemorySectionAlignment=UNSPECIFIED, MemMapMemorySectionSymbol=VAR_CLEARED_UNSPECIFIED, MemMapMemorySectionSwAddrMethodRef=VAR_CLEARED
        VAR_ZERO_INIT_UNSPECIFIED: MemMapMemorySectionAlignment=UNSPECIFIED, MemMapMemorySectionSymbol=VAR_ZERO_INIT_UNSPECIFIED, MemMapMemorySectionSwAddrMethodRef=VAR_CLEARED
        VAR_FAST_INIT_8BIT: MemMapMemorySectionAlignment=8, MemMapMemorySectionSymbol=VAR_FAST_INIT_8BIT, MemMapMemorySectionSwAddrMethodRef=VAR_FAST_INIT
        VAR_FAST_INIT_16BIT: MemMapMemorySectionAlignment=16, MemMapMemorySectionSymbol=VAR_FAST_INIT_16BIT, MemMapMemorySectionSwAddrMethodRef=VAR_FAST_INIT
        VAR_FAST_INIT_32BIT: MemMapMemorySectionAlignment=32, MemMapMemorySectionSymbol=VAR_FAST_INIT_32BIT, MemMapMemorySectionSwAddrMethodRef=VAR_FAST_INIT
        VAR_FAST_INIT_64BIT: MemMapMemorySectionAlignment=64, MemMapMemorySectionSymbol=VAR_FAST_INIT_64BIT, MemMapMemorySectionSwAddrMethodRef=VAR_FAST_INIT
        VAR_FAST_INIT_8: MemMapMemorySectionAlignment=8, MemMapMemorySectionSymbol=VAR_FAST_INIT_8, MemMapMemorySectionSwAddrMethodRef=VAR_FAST_INIT
        VAR_FAST_INIT_16: MemMapMemorySectionAlignment=16, MemMapMemorySectionSymbol=VAR_FAST_INIT_16, MemMapMemorySectionSwAddrMethodRef=VAR_FAST_INIT
        VAR_FAST_INIT_32: MemMapMemorySectionAlignment=32, MemMapMemorySectionSymbol=VAR_FAST_INIT_32, MemMapMemorySectionSwAddrMethodRef=VAR_FAST_INIT
        VAR_FAST_INIT_64: MemMapMemorySectionAlignment=64, MemMapMemorySectionSymbol=VAR_FAST_INIT_64, MemMapMemorySectionSwAddrMethodRef=VAR_FAST_INIT
        VAR_FAST_INIT_UNSPECIFIED: MemMapMemorySectionAlignment=UNSPECIFIED, MemMapMemorySectionSymbol=VAR_FAST_INIT_UNSPECIFIED, MemMapMemorySectionSwAddrMethodRef=VAR_FAST_INIT
        VAR_FAST_NOINIT_8BIT: MemMapMemorySectionAlignment=8, MemMapMemorySectionSymbol=VAR_FAST_NOINIT_8BIT, MemMapMemorySectionSwAddrMethodRef=VAR_FAST_NO_INIT
        VAR_FAST_NOINIT_16BIT: MemMapMemorySectionAlignment=16, MemMapMemorySectionSymbol=VAR_FAST_NOINIT_16BIT, MemMapMemorySectionSwAddrMethodRef=VAR_FAST_NO_INIT
        VAR_FAST_NOINIT_32BIT: MemMapMemorySectionAlignment=32, MemMapMemorySectionSymbol=VAR_FAST_NOINIT_32BIT, MemMapMemorySectionSwAddrMethodRef=VAR_FAST_NO_INIT
        VAR_FAST_NOINIT_64BIT: MemMapMemorySectionAlignment=64, MemMapMemorySectionSymbol=VAR_FAST_NOINIT_64BIT, MemMapMemorySectionSwAddrMethodRef=VAR_FAST_NO_INIT
        VAR_FAST_NO_INIT_8: MemMapMemorySectionAlignment=8, MemMapMemorySectionSymbol=VAR_FAST_NO_INIT_8, MemMapMemorySectionSwAddrMethodRef=VAR_FAST_NO_INIT
        VAR_FAST_NO_INIT_16: MemMapMemorySectionAlignment=16, MemMapMemorySectionSymbol=VAR_FAST_NO_INIT_16, MemMapMemorySectionSwAddrMethodRef=VAR_FAST_NO_INIT
        VAR_FAST_NO_INIT_32: MemMapMemorySectionAlignment=32, MemMapMemorySectionSymbol=VAR_FAST_NO_INIT_32, MemMapMemorySectionSwAddrMethodRef=VAR_FAST_NO_INIT
        VAR_FAST_NO_INIT_64: MemMapMemorySectionAlignment=64, MemMapMemorySectionSymbol=VAR_FAST_NO_INIT_64, MemMapMemorySectionSwAddrMethodRef=VAR_FAST_NO_INIT
        VAR_FAST_NOINIT_UNSPECIFIED: MemMapMemorySectionAlignment=UNSPECIFIED, MemMapMemorySectionSymbol=VAR_FAST_NOINIT_UNSPECIFIED, MemMapMemorySectionSwAddrMethodRef=VAR_FAST_NO_INIT
        VAR_FAST_NO_INIT_UNSPECIFIED: MemMapMemorySectionAlignment=UNSPECIFIED, MemMapMemorySectionSymbol=VAR_FAST_NO_INIT_UNSPECIFIED, MemMapMemorySectionSwAddrMethodRef=VAR_FAST_NO_INIT
        VAR_FAST_ZERO_INIT_8BIT: MemMapMemorySectionAlignment=8, MemMapMemorySectionSymbol=VAR_FAST_ZERO_INIT_8BIT, MemMapMemorySectionSwAddrMethodRef=VAR_FAST_CLEARED
        VAR_FAST_ZERO_INIT_16BIT: MemMapMemorySectionAlignment=16, MemMapMemorySectionSymbol=VAR_FAST_ZERO_INIT_16BIT, MemMapMemorySectionSwAddrMethodRef=VAR_FAST_CLEARED
        VAR_FAST_ZERO_INIT_32BIT: MemMapMemorySectionAlignment=32, MemMapMemorySectionSymbol=VAR_FAST_ZERO_INIT_32BIT, MemMapMemorySectionSwAddrMethodRef=VAR_FAST_CLEARED
        VAR_FAST_ZERO_INIT_64BIT: MemMapMemorySectionAlignment=64, MemMapMemorySectionSymbol=VAR_FAST_ZERO_INIT_64BIT, MemMapMemorySectionSwAddrMethodRef=VAR_FAST_CLEARED
        VAR_FAST_CLEARED_8: MemMapMemorySectionAlignment=8, MemMapMemorySectionSymbol=VAR_FAST_CLEARED_8, MemMapMemorySectionSwAddrMethodRef=VAR_FAST_CLEARED
        VAR_FAST_CLEARED_16: MemMapMemorySectionAlignment=16, MemMapMemorySectionSymbol=VAR_FAST_CLEARED_16, MemMapMemorySectionSwAddrMethodRef=VAR_FAST_CLEARED
        VAR_FAST_CLEARED_32: MemMapMemorySectionAlignment=32, MemMapMemorySectionSymbol=VAR_FAST_CLEARED_32, MemMapMemorySectionSwAddrMethodRef=VAR_FAST_CLEARED
        VAR_FAST_CLEARED_64: MemMapMemorySectionAlignment=64, MemMapMemorySectionSymbol=VAR_FAST_CLEARED_64, MemMapMemorySectionSwAddrMethodRef=VAR_FAST_CLEARED
        VAR_FAST_CLEARED_UNSPECIFIED: MemMapMemorySectionAlignment=UNSPECIFIED, MemMapMemorySectionSymbol=VAR_FAST_CLEARED_UNSPECIFIED, MemMapMemorySectionSwAddrMethodRef=VAR_FAST_CLEARED
        VAR_FAST_ZERO_INIT_UNSPECIFIED: MemMapMemorySectionAlignment=UNSPECIFIED, MemMapMemorySectionSymbol=VAR_FAST_ZERO_INIT_UNSPECIFIED, MemMapMemorySectionSwAddrMethodRef=VAR_FAST_CLEARED
        VAR_NOCACHE_INIT_8BIT: MemMapMemorySectionAlignment=8, MemMapMemorySectionSymbol=VAR_NOCACHE_INIT_8BIT, MemMapMemorySectionSwAddrMethodRef=VAR_NOCACHE_INIT
        VAR_NOCACHE_INIT_16BIT: MemMapMemorySectionAlignment=16, MemMapMemorySectionSymbol=VAR_NOCACHE_INIT_16BIT, MemMapMemorySectionSwAddrMethodRef=VAR_NOCACHE_INIT
        VAR_NOCACHE_INIT_32BIT: MemMapMemorySectionAlignment=32, MemMapMemorySectionSymbol=VAR_NOCACHE_INIT_32BIT, MemMapMemorySectionSwAddrMethodRef=VAR_NOCACHE_INIT
        VAR_NOCACHE_INIT_64BIT: MemMapMemorySectionAlignment=64, MemMapMemorySectionSymbol=VAR_NOCACHE_INIT_64BIT, MemMapMemorySectionSwAddrMethodRef=VAR_NOCACHE_INIT
        VAR_NOCACHE_INIT_8: MemMapMemorySectionAlignment=8, MemMapMemorySectionSymbol=VAR_NOCACHE_INIT_8, MemMapMemorySectionSwAddrMethodRef=VAR_NOCACHE_INIT
        VAR_NOCACHE_INIT_16: MemMapMemorySectionAlignment=16, MemMapMemorySectionSymbol=VAR_NOCACHE_INIT_16, MemMapMemorySectionSwAddrMethodRef=VAR_NOCACHE_INIT
        VAR_NOCACHE_INIT_32: MemMapMemorySectionAlignment=32, MemMapMemorySectionSymbol=VAR_NOCACHE_INIT_32, MemMapMemorySectionSwAddrMethodRef=VAR_NOCACHE_INIT
        VAR_NOCACHE_INIT_64: MemMapMemorySectionAlignment=64, MemMapMemorySectionSymbol=VAR_NOCACHE_INIT_64, MemMapMemorySectionSwAddrMethodRef=VAR_NOCACHE_INIT
        VAR_NOCACHE_INIT_UNSPECIFIED: MemMapMemorySectionAlignment=UNSPECIFIED, MemMapMemorySectionSymbol=VAR_NOCACHE_INIT_UNSPECIFIED, MemMapMemorySectionSwAddrMethodRef=VAR_NOCACHE_INIT
        VAR_NOCACHE_NOINIT_8BIT: MemMapMemorySectionAlignment=8, MemMapMemorySectionSymbol=VAR_NOCACHE_NOINIT_8BIT, MemMapMemorySectionSwAddrMethodRef=VAR_NOCACHE_NO_INIT
        VAR_NOCACHE_NOINIT_16BIT: MemMapMemorySectionAlignment=16, MemMapMemorySectionSymbol=VAR_NOCACHE_NOINIT_16BIT, MemMapMemorySectionSwAddrMethodRef=VAR_NOCACHE_NO_INIT
        VAR_NOCACHE_NOINIT_32BIT: MemMapMemorySectionAlignment=32, MemMapMemorySectionSymbol=VAR_NOCACHE_NOINIT_32BIT, MemMapMemorySectionSwAddrMethodRef=VAR_NOCACHE_NO_INIT
        VAR_NOCACHE_NOINIT_64BIT: MemMapMemorySectionAlignment=64, MemMapMemorySectionSymbol=VAR_NOCACHE_NOINIT_64BIT, MemMapMemorySectionSwAddrMethodRef=VAR_NOCACHE_NO_INIT
        VAR_NOCACHE_NO_INIT_8: MemMapMemorySectionAlignment=8, MemMapMemorySectionSymbol=VAR_NOCACHE_NO_INIT_8, MemMapMemorySectionSwAddrMethodRef=VAR_NOCACHE_NO_INIT
        VAR_NOCACHE_NO_INIT_16: MemMapMemorySectionAlignment=16, MemMapMemorySectionSymbol=VAR_NOCACHE_NO_INIT_16, MemMapMemorySectionSwAddrMethodRef=VAR_NOCACHE_NO_INIT
        VAR_NOCACHE_NO_INIT_32: MemMapMemorySectionAlignment=32, MemMapMemorySectionSymbol=VAR_NOCACHE_NO_INIT_32, MemMapMemorySectionSwAddrMethodRef=VAR_NOCACHE_NO_INIT
        VAR_NOCACHE_NO_INIT_64: MemMapMemorySectionAlignment=64, MemMapMemorySectionSymbol=VAR_NOCACHE_NO_INIT_64, MemMapMemorySectionSwAddrMethodRef=VAR_NOCACHE_NO_INIT
        VAR_NOCACHE_NOINIT_UNSPECIFIED: MemMapMemorySectionAlignment=UNSPECIFIED, MemMapMemorySectionSymbol=VAR_NOCACHE_NOINIT_UNSPECIFIED, MemMapMemorySectionSwAddrMethodRef=VAR_NOCACHE_NO_INIT
        VAR_NOCACHE_NO_INIT_UNSPECIFIED: MemMapMemorySectionAlignment=UNSPECIFIED, MemMapMemorySectionSymbol=VAR_NOCACHE_NO_INIT_UNSPECIFIED, MemMapMemorySectionSwAddrMethodRef=VAR_NOCACHE_NO_INIT
        VAR_NOCACHE_ZERO_INIT_8BIT: MemMapMemorySectionAlignment=8, MemMapMemorySectionSymbol=VAR_NOCACHE_ZERO_INIT_8BIT, MemMapMemorySectionSwAddrMethodRef=VAR_NOCACHE_CLEARED
        VAR_NOCACHE_ZERO_INIT_16BIT: MemMapMemorySectionAlignment=16, MemMapMemorySectionSymbol=VAR_NOCACHE_ZERO_INIT_16BIT, MemMapMemorySectionSwAddrMethodRef=VAR_NOCACHE_CLEARED
        VAR_NOCACHE_ZERO_INIT_32BIT: MemMapMemorySectionAlignment=32, MemMapMemorySectionSymbol=VAR_NOCACHE_ZERO_INIT_32BIT, MemMapMemorySectionSwAddrMethodRef=VAR_NOCACHE_CLEARED
        VAR_NOCACHE_ZERO_INIT_64BIT: MemMapMemorySectionAlignment=64, MemMapMemorySectionSymbol=VAR_NOCACHE_ZERO_INIT_64BIT, MemMapMemorySectionSwAddrMethodRef=VAR_NOCACHE_CLEARED
        VAR_NOCACHE_CLEARED_8: MemMapMemorySectionAlignment=8, MemMapMemorySectionSymbol=VAR_NOCACHE_CLEARED_8, MemMapMemorySectionSwAddrMethodRef=VAR_NOCACHE_CLEARED
        VAR_NOCACHE_CLEARED_16: MemMapMemorySectionAlignment=16, MemMapMemorySectionSymbol=VAR_NOCACHE_CLEARED_16, MemMapMemorySectionSwAddrMethodRef=VAR_NOCACHE_CLEARED
        VAR_NOCACHE_CLEARED_32: MemMapMemorySectionAlignment=32, MemMapMemorySectionSymbol=VAR_NOCACHE_CLEARED_32, MemMapMemorySectionSwAddrMethodRef=VAR_NOCACHE_CLEARED
        VAR_NOCACHE_CLEARED_64: MemMapMemorySectionAlignment=64, MemMapMemorySectionSymbol=VAR_NOCACHE_CLEARED_64, MemMapMemorySectionSwAddrMethodRef=VAR_NOCACHE_CLEARED
        VAR_NOCACHE_CLEARED_UNSPECIFIED: MemMapMemorySectionAlignment=UNSPECIFIED, MemMapMemorySectionSymbol=VAR_NOCACHE_CLEARED_UNSPECIFIED, MemMapMemorySectionSwAddrMethodRef=VAR_NOCACHE_CLEARED
        VAR_NOCACHE_ZERO_INIT_UNSPECIFIED: MemMapMemorySectionAlignment=UNSPECIFIED, MemMapMemorySectionSymbol=VAR_NOCACHE_ZERO_INIT_UNSPECIFIED, MemMapMemorySectionSwAddrMethodRef=VAR_NOCACHE_CLEARED
        VAR_PBCFG: MemMapMemorySectionAlignment=UNSPECIFIED, MemMapMemorySectionSymbol=VAR_PBCFG, MemMapMemorySectionSwAddrMethodRef=VAR_PBCFG
    MSR_Generic (MemMapAllocation)
      8 x MemMapGenericMapping:
        MSR_CODE: MemMapSwAddressMethodRef=CODE, MemMapSwAddressMethodRef=CALLOUT_CODE, MemMapSwAddressMethodRef=CODE_FAST, MemMapSwAddressMethodRef=CODE_ISR, MemMapAddressingModeSetRef=MemMap/MSR_CODE
        MSR_CONST: MemMapSwAddressMethodRef=CONST_8, MemMapSwAddressMethodRef=CONST_16, MemMapSwAddressMethodRef=CONST_32, MemMapSwAddressMethodRef=CONST_64, MemMapSwAddressMethodRef=CONST_BOOLEAN, MemMapSwAddressMethodRef=CONST_FAST_8, MemMapSwAddressMethodRef=CONST_FAST_16, MemMapSwAddressMethodRef=CONST_FAST_32, MemMapSwAddressMethodRef=CONST_FAST_64, MemMapSwAddressMethodRef=CONST_FAST_BOOLEAN, MemMapSwAddressMethodRef=CONST_FAST_UNSPECIFIED, MemMapSwAddressMethodRef=CONST_UNSPECIFIED, MemMapAddressingModeSetRef=MemMap/MSR_CONST, MemMapSwAddressMethodRef=CONFIG_DATA, MemMapSwAddressMethodRef=CONST, MemMapSwAddressMethodRef=CONST_FAST
        MSR_PBCFG_CONST: MemMapSwAddressMethodRef=CONST_PBCFG, MemMapAddressingModeSetRef=MemMap/MSR_PBCFG_CONST, MemMapSwAddressMethodRef=PBCFG_GLOBALROOT
        MSR_PBCFG_VAR: MemMapSwAddressMethodRef=VAR_PBCFG, MemMapAddressingModeSetRef=MemMap/MSR_PBCFG_VAR
        MSR_VAR_CLEARED: MemMapSwAddressMethodRef=VAR_ZERO_INIT_8, MemMapSwAddressMethodRef=VAR_ZERO_INIT_16, MemMapSwAddressMethodRef=VAR_ZERO_INIT_32, MemMapSwAddressMethodRef=VAR_ZERO_INIT_64, MemMapSwAddressMethodRef=VAR_ZERO_INIT_UNSPECIFIED, MemMapAddressingModeSetRef=MemMap/MSR_VAR_CLEARED, MemMapSwAddressMethodRef=VAR_ZERO_INIT_BOOLEAN, MemMapSwAddressMethodRef=VAR_FAST_ZERO_INIT_8, MemMapSwAddressMethodRef=VAR_FAST_ZERO_INIT_16, MemMapSwAddressMethodRef=VAR_FAST_ZERO_INIT_32, MemMapSwAddressMethodRef=VAR_FAST_ZERO_INIT_64, MemMapSwAddressMethodRef=VAR_FAST_ZERO_INIT_BOOLEAN, MemMapSwAddressMethodRef=VAR_FAST_ZERO_INIT_UNSPECIFIED, MemMapSwAddressMethodRef=VAR_NOCACHE_ZERO_INIT_8, MemMapSwAddressMethodRef=VAR_NOCACHE_ZERO_INIT_16, MemMapSwAddressMethodRef=VAR_NOCACHE_ZERO_INIT_32, MemMapSwAddressMethodRef=VAR_NOCACHE_ZERO_INIT_64, MemMapSwAddressMethodRef=VAR_NOCACHE_ZERO_INIT_BOOLEAN, MemMapSwAddressMethodRef=VAR_NOCACHE_ZERO_INIT_UNSPECIFIED, MemMapSwAddressMethodRef=VAR_CLEARED_BOOLEAN, MemMapSwAddressMethodRef=VAR_CLEARED_8, MemMapSwAddressMethodRef=VAR_CLEARED_16, MemMapSwAddressMethodRef=VAR_CLEARED_32, MemMapSwAddressMethodRef=VAR_CLEARED_64, MemMapSwAddressMethodRef=VAR_CLEARED_UNSPECIFIED, MemMapSwAddressMethodRef=VAR_FAST_CLEARED_BOOLEAN, MemMapSwAddressMethodRef=VAR_FAST_CLEARED_8, MemMapSwAddressMethodRef=VAR_FAST_CLEARED_16, MemMapSwAddressMethodRef=VAR_FAST_CLEARED_32, MemMapSwAddressMethodRef=VAR_FAST_CLEARED_64, MemMapSwAddressMethodRef=VAR_FAST_CLEARED_UNSPECIFIED, MemMapSwAddressMethodRef=VAR_NOCACHE_CLEARED_BOOLEAN, MemMapSwAddressMethodRef=VAR_NOCACHE_CLEARED_8, MemMapSwAddressMethodRef=VAR_NOCACHE_CLEARED_16, MemMapSwAddressMethodRef=VAR_NOCACHE_CLEARED_32, MemMapSwAddressMethodRef=VAR_NOCACHE_CLEARED_64, MemMapSwAddressMethodRef=VAR_NOCACHE_CLEARED_UNSPECIFIED, MemMapSwAddressMethodRef=VAR_CLEARED, MemMapSwAddressMethodRef=VAR_FAST_CLEARED, MemMapSwAddressMethodRef=VAR_NOCACHE_CLEARED, MemMapSwAddressMethodRef=VAR_ZERO_INIT
        MSR_VAR_INIT: MemMapSwAddressMethodRef=VAR_FAST_INIT_8, MemMapSwAddressMethodRef=VAR_FAST_INIT_16, MemMapSwAddressMethodRef=VAR_FAST_INIT_32, MemMapSwAddressMethodRef=VAR_FAST_INIT_64, MemMapSwAddressMethodRef=VAR_FAST_INIT_UNSPECIFIED, MemMapSwAddressMethodRef=VAR_INIT_8, MemMapSwAddressMethodRef=VAR_INIT_16, MemMapSwAddressMethodRef=VAR_INIT_32, MemMapSwAddressMethodRef=VAR_INIT_64, MemMapSwAddressMethodRef=VAR_INIT_BOOLEAN, MemMapSwAddressMethodRef=VAR_INIT_UNSPECIFIED, MemMapAddressingModeSetRef=MemMap/MSR_VAR_INIT, MemMapSwAddressMethodRef=VAR_FAST_INIT_BOOLEAN, MemMapSwAddressMethodRef=VAR_NOCACHE_INIT_8, MemMapSwAddressMethodRef=VAR_NOCACHE_INIT_16, MemMapSwAddressMethodRef=VAR_NOCACHE_INIT_32, MemMapSwAddressMethodRef=VAR_NOCACHE_INIT_64, MemMapSwAddressMethodRef=VAR_NOCACHE_INIT_BOOLEAN, MemMapSwAddressMethodRef=VAR_NOCACHE_INIT_UNSPECIFIED, MemMapSwAddressMethodRef=VAR_INIT, MemMapSwAddressMethodRef=VAR_FAST_INIT, MemMapSwAddressMethodRef=VAR_NOCACHE_INIT
        MSR_VAR_NO_INIT: MemMapAddressingModeSetRef=MemMap/MSR_VAR_NO_INIT, MemMapSwAddressMethodRef=VAR_FAST_NO_INIT_8, MemMapSwAddressMethodRef=VAR_FAST_NO_INIT_16, MemMapSwAddressMethodRef=VAR_FAST_NO_INIT_32, MemMapSwAddressMethodRef=VAR_FAST_NO_INIT_64, MemMapSwAddressMethodRef=VAR_FAST_NO_INIT_UNSPECIFIED, MemMapSwAddressMethodRef=VAR_NO_INIT_8, MemMapSwAddressMethodRef=VAR_NO_INIT_16, MemMapSwAddressMethodRef=VAR_NO_INIT_32, MemMapSwAddressMethodRef=VAR_NO_INIT_64, MemMapSwAddressMethodRef=VAR_NO_INIT_UNSPECIFIED, MemMapSwAddressMethodRef=VAR_NO_INIT_BOOLEAN, MemMapSwAddressMethodRef=VAR_FAST_NO_INIT_BOOLEAN, MemMapSwAddressMethodRef=VAR_NOCACHE_NO_INIT_8, MemMapSwAddressMethodRef=VAR_NOCACHE_NO_INIT_16, MemMapSwAddressMethodRef=VAR_NOCACHE_NO_INIT_32, MemMapSwAddressMethodRef=VAR_NOCACHE_NO_INIT_64, MemMapSwAddressMethodRef=VAR_NOCACHE_NO_INIT_BOOLEAN, MemMapSwAddressMethodRef=VAR_NOCACHE_NO_INIT_UNSPECIFIED, MemMapSwAddressMethodRef=VAR_FAST_NOINIT_8, MemMapSwAddressMethodRef=VAR_FAST_NOINIT_16, MemMapSwAddressMethodRef=VAR_FAST_NOINIT_32, MemMapSwAddressMethodRef=VAR_FAST_NOINIT_64, MemMapSwAddressMethodRef=VAR_FAST_NOINIT_UNSPECIFIED, MemMapSwAddressMethodRef=VAR_NOINIT_8, MemMapSwAddressMethodRef=VAR_NOINIT_16, MemMapSwAddressMethodRef=VAR_NOINIT_32, MemMapSwAddressMethodRef=VAR_NOINIT_64, MemMapSwAddressMethodRef=VAR_NOINIT_UNSPECIFIED, MemMapSwAddressMethodRef=VAR_NOINIT_BOOLEAN, MemMapSwAddressMethodRef=VAR_FAST_NOINIT_BOOLEAN, MemMapSwAddressMethodRef=VAR_NOCACHE_NOINIT_8, MemMapSwAddressMethodRef=VAR_NOCACHE_NOINIT_16, MemMapSwAddressMethodRef=VAR_NOCACHE_NOINIT_32, MemMapSwAddressMethodRef=VAR_NOCACHE_NOINIT_64, MemMapSwAddressMethodRef=VAR_NOCACHE_NOINIT_BOOLEAN, MemMapSwAddressMethodRef=VAR_NOCACHE_NOINIT_UNSPECIFIED, MemMapSwAddressMethodRef=VAR_NO_INIT, MemMapSwAddressMethodRef=VAR_FAST_NO_INIT, MemMapSwAddressMethodRef=VAR_NOCACHE_NO_INIT
        MSR_VAR_SAVED_ZONE: MemMapAddressingModeSetRef=MemMap/MSR_VAR_SAVED_ZONE, MemMapSwAddressMethodRef=VAR_SAVED_ZONE_BOOLEAN, MemMapSwAddressMethodRef=VAR_SAVED_ZONE_8, MemMapSwAddressMethodRef=VAR_SAVED_ZONE_16, MemMapSwAddressMethodRef=VAR_SAVED_ZONE_32, MemMapSwAddressMethodRef=VAR_SAVED_ZONE_64, MemMapSwAddressMethodRef=VAR_SAVED_ZONE_UNSPECIFIED, MemMapSwAddressMethodRef=VAR_SAVED_ZONE
    8 x MemMapAddressingModeSet, all with MemMapCompilerMemClassSymbolImpl=:
      MSR_CODE
        MSR_CODE (MemMapAddressingMode):
          MemMapAlignmentSelector = UNSPECIFIED
          MemMapAlignmentSelector = 8
          MemMapAlignmentSelector = 16
          MemMapAlignmentSelector = 32
          MemMapAlignmentSelector = 64
          MemMapAlignmentSelector = BOOLEAN
      MSR_CONST
        MSR_CONST (MemMapAddressingMode):
          MemMapAlignmentSelector = UNSPECIFIED
          MemMapAlignmentSelector = 8
          MemMapAlignmentSelector = 16
          MemMapAlignmentSelector = 32
          MemMapAlignmentSelector = 64
          MemMapAlignmentSelector = BOOLEAN
          MemMapLinkerLogicalGroupRef = MSR_CONST
      MSR_PBCFG_CONST
        MSR_PBCFG_CONST (MemMapAddressingMode):
          MemMapAlignmentSelector = UNSPECIFIED
          MemMapAlignmentSelector = 8
          MemMapAlignmentSelector = 16
          MemMapAlignmentSelector = 32
          MemMapAlignmentSelector = 64
          MemMapAlignmentSelector = BOOLEAN
          MemMapLinkerLogicalGroupRef = MSR_PBCFG_CONST
      MSR_PBCFG_VAR
        MSR_PBCFG_VAR (MemMapAddressingMode):
          MemMapAlignmentSelector = UNSPECIFIED
          MemMapAlignmentSelector = 8
          MemMapAlignmentSelector = 16
          MemMapAlignmentSelector = 32
          MemMapAlignmentSelector = 64
          MemMapAlignmentSelector = BOOLEAN
          MemMapLinkerLogicalGroupRef = MSR_PBCFG_VAR
      MSR_VAR_CLEARED
        MSR_VAR_CLEARED (MemMapAddressingMode):
          MemMapAlignmentSelector = UNSPECIFIED
          MemMapAlignmentSelector = 8
          MemMapAlignmentSelector = 16
          MemMapAlignmentSelector = 32
          MemMapAlignmentSelector = 64
          MemMapAlignmentSelector = BOOLEAN
          MemMapLinkerLogicalGroupRef = MSR_VAR
      MSR_VAR_INIT
        MSR_VAR_INIT (MemMapAddressingMode):
          MemMapAlignmentSelector = UNSPECIFIED
          MemMapAlignmentSelector = 8
          MemMapAlignmentSelector = 16
          MemMapAlignmentSelector = 32
          MemMapAlignmentSelector = 64
          MemMapAlignmentSelector = BOOLEAN
          MemMapLinkerLogicalGroupRef = MSR_VAR
      MSR_VAR_NO_INIT
        MSR_VAR_NO_INIT (MemMapAddressingMode):
          MemMapAlignmentSelector = UNSPECIFIED
          MemMapAlignmentSelector = 8
          MemMapAlignmentSelector = 16
          MemMapAlignmentSelector = 32
          MemMapAlignmentSelector = 64
          MemMapAlignmentSelector = BOOLEAN
          MemMapLinkerLogicalGroupRef = MSR_VAR
      MSR_VAR_SAVED_ZONE
        MSR_VAR_SAVED_ZONE (MemMapAddressingMode):
          MemMapAlignmentSelector = UNSPECIFIED
          MemMapAlignmentSelector = 8
          MemMapAlignmentSelector = 16
          MemMapAlignmentSelector = 32
          MemMapAlignmentSelector = 64
          MemMapAlignmentSelector = BOOLEAN
          MemMapLinkerLogicalGroupRef = MSR_VAR_SAVED_ZONE
    MemMapGeneral:
      MemMapGeneration = FULL
      MemMapCompatibilityGeneration = FULL
      MemMapTypedPragmas = true
      MemMapGeneratePragmas = true
      MemMapErrorChecks = ALL
      MemMapGeneratePragmasForNearAddressing = true
    4 x MemMapAddressingModeSet, all with MemMapCompilerMemClassSymbolImpl=:
      OS_GLOBALSHARED_VAR_INIT
        OS_GLOBALSHARED_VAR_INIT (MemMapAddressingMode):
          MemMapAlignmentSelector = BOOLEAN
          MemMapAlignmentSelector = 8
          MemMapAlignmentSelector = 16
          MemMapAlignmentSelector = 32
          MemMapAlignmentSelector = 64
          MemMapAlignmentSelector = UNSPECIFIED
      OS_GLOBALSHARED_VAR_NOINIT
        OS_GLOBALSHARED_VAR_NOINIT (MemMapAddressingMode):
          MemMapAlignmentSelector = BOOLEAN
          MemMapAlignmentSelector = 8
          MemMapAlignmentSelector = 16
          MemMapAlignmentSelector = 32
          MemMapAlignmentSelector = 64
          MemMapAlignmentSelector = UNSPECIFIED
      OS_GLOBALSHARED_VAR_ZERO_INIT
        OS_GLOBALSHARED_VAR_ZERO_INIT (MemMapAddressingMode):
          MemMapAlignmentSelector = BOOLEAN
          MemMapAlignmentSelector = 8
          MemMapAlignmentSelector = 16
          MemMapAlignmentSelector = 32
          MemMapAlignmentSelector = 64
          MemMapAlignmentSelector = UNSPECIFIED
      OS_GLOBALSHARED_VAR_SAVED_ZONE
        OS_GLOBALSHARED_VAR_SAVED_ZONE (MemMapAddressingMode):
          MemMapAlignmentSelector = BOOLEAN
          MemMapAlignmentSelector = 8
          MemMapAlignmentSelector = 16
          MemMapAlignmentSelector = 32
          MemMapAlignmentSelector = 64
          MemMapAlignmentSelector = UNSPECIFIED
    OS_Generic (MemMapAllocation)
      10 x MemMapGenericMapping:
        OS_GLOBALSHARED_VAR_INIT: MemMapAddressingModeSetRef=MemMap/OS_GLOBALSHARED_VAR_INIT, MemMapSwAddressMethodRef=GLOBALSHARED_VAR_INIT, MemMapSwAddressMethodRef=GLOBALSHARED_VAR_FAST_INIT, MemMapSwAddressMethodRef=GLOBALSHARED_VAR_NOCACHE_INIT
        OS_GLOBALSHARED_VAR_NOINIT: MemMapAddressingModeSetRef=MemMap/OS_GLOBALSHARED_VAR_NOINIT, MemMapSwAddressMethodRef=GLOBALSHARED_VAR_NO_INIT, MemMapSwAddressMethodRef=GLOBALSHARED_VAR_FAST_NO_INIT, MemMapSwAddressMethodRef=GLOBALSHARED_VAR_NOCACHE_NO_INIT
        OS_GLOBALSHARED_VAR_ZERO_INIT: MemMapAddressingModeSetRef=MemMap/OS_GLOBALSHARED_VAR_ZERO_INIT, MemMapSwAddressMethodRef=GLOBALSHARED_VAR_CLEARED, MemMapSwAddressMethodRef=GLOBALSHARED_VAR_FAST_CLEARED, MemMapSwAddressMethodRef=GLOBALSHARED_VAR_NOCACHE_CLEARED
        OS_GLOBALSHARED_VAR_SAVED_ZONE: MemMapAddressingModeSetRef=MemMap/OS_GLOBALSHARED_VAR_SAVED_ZONE, MemMapSwAddressMethodRef=GLOBALSHARED_VAR_SAVED_ZONE
        OS_GLOBALSHARED_CONST: MemMapAddressingModeSetRef=MemMap/MSR_CONST, MemMapSwAddressMethodRef=GLOBALSHARED_CONST, MemMapSwAddressMethodRef=GLOBALSHARED_CONST_FAST
        OS_SystemApplication_OsCore0_VAR_INIT: MemMapAddressingModeSetRef=MemMap/OS_SystemApplication_OsCore0_VAR_INIT, MemMapSwAddressMethodRef=SystemApplication_OsCore0_VAR_INIT, MemMapSwAddressMethodRef=SystemApplication_OsCore0_VAR_FAST_INIT, MemMapSwAddressMethodRef=SystemApplication_OsCore0_VAR_NOCACHE_INIT
        OS_SystemApplication_OsCore0_VAR_NOINIT: MemMapAddressingModeSetRef=MemMap/OS_SystemApplication_OsCore0_VAR_NOINIT, MemMapSwAddressMethodRef=SystemApplication_OsCore0_VAR_NO_INIT, MemMapSwAddressMethodRef=SystemApplication_OsCore0_VAR_FAST_NO_INIT, MemMapSwAddressMethodRef=SystemApplication_OsCore0_VAR_NOCACHE_NO_INIT
        OS_SystemApplication_OsCore0_VAR_ZERO_INIT: MemMapAddressingModeSetRef=MemMap/OS_SystemApplication_OsCore0_VAR_ZERO_INIT, MemMapSwAddressMethodRef=SystemApplication_OsCore0_VAR_CLEARED, MemMapSwAddressMethodRef=SystemApplication_OsCore0_VAR_FAST_CLEARED, MemMapSwAddressMethodRef=SystemApplication_OsCore0_VAR_NOCACHE_CLEARED
        OS_SystemApplication_OsCore0_VAR_SAVED_ZONE: MemMapAddressingModeSetRef=MemMap/OS_SystemApplication_OsCore0_VAR_SAVED_ZONE, MemMapSwAddressMethodRef=SystemApplication_OsCore0_VAR_SAVED_ZONE
        OS_SystemApplication_OsCore0_CONST: MemMapAddressingModeSetRef=MemMap/MSR_CONST, MemMapSwAddressMethodRef=SystemApplication_OsCore0_CONST, MemMapSwAddressMethodRef=SystemApplication_OsCore0_CONST_FAST
    4 x MemMapAddressingModeSet, all with MemMapCompilerMemClassSymbolImpl=:
      OS_SystemApplication_OsCore0_VAR_INIT
        OS_SystemApplication_OsCore0_VAR_INIT (MemMapAddressingMode):
          MemMapAlignmentSelector = BOOLEAN
          MemMapAlignmentSelector = 8
          MemMapAlignmentSelector = 16
          MemMapAlignmentSelector = 32
          MemMapAlignmentSelector = 64
          MemMapAlignmentSelector = UNSPECIFIED
      OS_SystemApplication_OsCore0_VAR_NOINIT
        OS_SystemApplication_OsCore0_VAR_NOINIT (MemMapAddressingMode):
          MemMapAlignmentSelector = BOOLEAN
          MemMapAlignmentSelector = 8
          MemMapAlignmentSelector = 16
          MemMapAlignmentSelector = 32
          MemMapAlignmentSelector = 64
          MemMapAlignmentSelector = UNSPECIFIED
      OS_SystemApplication_OsCore0_VAR_ZERO_INIT
        OS_SystemApplication_OsCore0_VAR_ZERO_INIT (MemMapAddressingMode):
          MemMapAlignmentSelector = BOOLEAN
          MemMapAlignmentSelector = 8
          MemMapAlignmentSelector = 16
          MemMapAlignmentSelector = 32
          MemMapAlignmentSelector = 64
          MemMapAlignmentSelector = UNSPECIFIED
      OS_SystemApplication_OsCore0_VAR_SAVED_ZONE
        OS_SystemApplication_OsCore0_VAR_SAVED_ZONE (MemMapAddressingMode):
          MemMapAlignmentSelector = BOOLEAN
          MemMapAlignmentSelector = 8
          MemMapAlignmentSelector = 16
          MemMapAlignmentSelector = 32
          MemMapAlignmentSelector = 64
          MemMapAlignmentSelector = UNSPECIFIED
  module config VTTMemMap: implementation-config-variant=VARIANT-PRE-COMPILE, module-description=VTTMemMap_Impl
    MemMapGeneral:
      MemMapGeneration = FULL
      MemMapCompatibilityGeneration = FULL
      MemMapTypedPragmas = true
      MemMapGeneratePragmas = true
      MemMapErrorChecks = ALL
      MemMapGeneratePragmasForNearAddressing = true
    MemMap_Common (MemMapModule): MemMapGenerateAdditionalMemorySections=true
      113 x MemMapAdditionalMemorySection, all with MemMapMemorySectionFileName=MemMap_Common.h, MemMapMemorySectionPrefix=:
        CONST_32BIT: MemMapMemorySectionSymbol=CONST_32BIT, MemMapMemorySectionAlignment=32, MemMapMemorySectionSwAddrMethodRef=CONST
        VAR_NOCACHE_NO_INIT_32: MemMapMemorySectionSymbol=VAR_NOCACHE_NO_INIT_32, MemMapMemorySectionAlignment=32, MemMapMemorySectionSwAddrMethodRef=VAR_NOCACHE_NO_INIT
        VAR_INIT_8: MemMapMemorySectionAlignment=8, MemMapMemorySectionSymbol=VAR_INIT_8, MemMapMemorySectionSwAddrMethodRef=VAR_INIT
        VAR_FAST_INIT_32: MemMapMemorySectionAlignment=32, MemMapMemorySectionSymbol=VAR_FAST_INIT_32, MemMapMemorySectionSwAddrMethodRef=VAR_FAST_INIT
        CONST: MemMapMemorySectionSymbol=CONST, MemMapMemorySectionAlignment=UNSPECIFIED, MemMapMemorySectionSwAddrMethodRef=CONST
        VAR_FAST_INIT_UNSPECIFIED: MemMapMemorySectionAlignment=UNSPECIFIED, MemMapMemorySectionSymbol=VAR_FAST_INIT_UNSPECIFIED, MemMapMemorySectionSwAddrMethodRef=VAR_FAST_INIT
        VAR_INIT_UNSPECIFIED: MemMapMemorySectionSymbol=VAR_INIT_UNSPECIFIED, MemMapMemorySectionAlignment=UNSPECIFIED, MemMapMemorySectionSwAddrMethodRef=VAR_INIT
        VAR_NOCACHE_ZERO_INIT_16BIT: MemMapMemorySectionSymbol=VAR_NOCACHE_ZERO_INIT_16BIT, MemMapMemorySectionAlignment=16, MemMapMemorySectionSwAddrMethodRef=VAR_NOCACHE_CLEARED
        VAR_FAST_CLEARED_16: MemMapMemorySectionSymbol=VAR_FAST_CLEARED_16, MemMapMemorySectionAlignment=16, MemMapMemorySectionSwAddrMethodRef=VAR_FAST_CLEARED
        VAR_NOCACHE_CLEARED_16: MemMapMemorySectionAlignment=16, MemMapMemorySectionSymbol=VAR_NOCACHE_CLEARED_16, MemMapMemorySectionSwAddrMethodRef=VAR_NOCACHE_CLEARED
        VAR_INIT_32BIT: MemMapMemorySectionAlignment=32, MemMapMemorySectionSymbol=VAR_INIT_32BIT, MemMapMemorySectionSwAddrMethodRef=VAR_INIT
        VAR_NOCACHE_NOINIT_16BIT: MemMapMemorySectionAlignment=16, MemMapMemorySectionSymbol=VAR_NOCACHE_NOINIT_16BIT, MemMapMemorySectionSwAddrMethodRef=VAR_NOCACHE_NO_INIT
        VAR_NOCACHE_ZERO_INIT_64BIT: MemMapMemorySectionAlignment=64, MemMapMemorySectionSymbol=VAR_NOCACHE_ZERO_INIT_64BIT, MemMapMemorySectionSwAddrMethodRef=VAR_NOCACHE_CLEARED
        VAR_NO_INIT_64: MemMapMemorySectionSymbol=VAR_NO_INIT_64, MemMapMemorySectionAlignment=64, MemMapMemorySectionSwAddrMethodRef=VAR_NO_INIT
        CONST_FAST_UNSPECIFIED: MemMapMemorySectionSymbol=CONST_FAST_UNSPECIFIED, MemMapMemorySectionAlignment=UNSPECIFIED, MemMapMemorySectionSwAddrMethodRef=CONST_FAST
        VAR_FAST_ZERO_INIT_32BIT: MemMapMemorySectionAlignment=32, MemMapMemorySectionSymbol=VAR_FAST_ZERO_INIT_32BIT, MemMapMemorySectionSwAddrMethodRef=VAR_FAST_CLEARED
        VAR_NOCACHE_ZERO_INIT_UNSPECIFIED: MemMapMemorySectionSymbol=VAR_NOCACHE_ZERO_INIT_UNSPECIFIED, MemMapMemorySectionAlignment=UNSPECIFIED, MemMapMemorySectionSwAddrMethodRef=VAR_NOCACHE_CLEARED
        VAR_INIT_16BIT: MemMapMemorySectionAlignment=16, MemMapMemorySectionSymbol=VAR_INIT_16BIT, MemMapMemorySectionSwAddrMethodRef=VAR_INIT
        VAR_NO_INIT_16: MemMapMemorySectionAlignment=16, MemMapMemorySectionSymbol=VAR_NO_INIT_16, MemMapMemorySectionSwAddrMethodRef=VAR_NO_INIT
        VAR_NOINIT_16BIT: MemMapMemorySectionSymbol=VAR_NOINIT_16BIT, MemMapMemorySectionAlignment=16, MemMapMemorySectionSwAddrMethodRef=VAR_NO_INIT
        CONST_PBCFG: MemMapMemorySectionSymbol=CONST_PBCFG, MemMapMemorySectionSwAddrMethodRef=CONST_PBCFG
        VAR_FAST_INIT_64BIT: MemMapMemorySectionAlignment=64, MemMapMemorySectionSymbol=VAR_FAST_INIT_64BIT, MemMapMemorySectionSwAddrMethodRef=VAR_FAST_INIT
        VAR_NO_INIT_UNSPECIFIED: MemMapMemorySectionSymbol=VAR_NO_INIT_UNSPECIFIED, MemMapMemorySectionAlignment=UNSPECIFIED, MemMapMemorySectionSwAddrMethodRef=VAR_NO_INIT
        VAR_NOCACHE_INIT_16BIT: MemMapMemorySectionSymbol=VAR_NOCACHE_INIT_16BIT, MemMapMemorySectionAlignment=16, MemMapMemorySectionSwAddrMethodRef=VAR_NOCACHE_INIT
        CONST_FAST_32BIT: MemMapMemorySectionAlignment=32, MemMapMemorySectionSymbol=CONST_FAST_32BIT, MemMapMemorySectionSwAddrMethodRef=CONST_FAST
        CONST_FAST_64: MemMapMemorySectionAlignment=64, MemMapMemorySectionSymbol=CONST_FAST_64, MemMapMemorySectionSwAddrMethodRef=CONST_FAST
        PBCFG_GLOBALROOT: MemMapMemorySectionSymbol=PBCFG_GLOBALROOT, MemMapMemorySectionSwAddrMethodRef=PBCFG_GLOBALROOT
        VAR_NOCACHE_INIT_64: MemMapMemorySectionAlignment=64, MemMapMemorySectionSymbol=VAR_NOCACHE_INIT_64, MemMapMemorySectionSwAddrMethodRef=VAR_NOCACHE_INIT
        VAR_FAST_NO_INIT_32: MemMapMemorySectionSymbol=VAR_FAST_NO_INIT_32, MemMapMemorySectionAlignment=32, MemMapMemorySectionSwAddrMethodRef=VAR_FAST_NO_INIT
        CODE_ISR: MemMapMemorySectionSymbol=CODE_ISR, MemMapMemorySectionSwAddrMethodRef=CODE_ISR
        VAR_NO_INIT_32: MemMapMemorySectionAlignment=32, MemMapMemorySectionSymbol=VAR_NO_INIT_32, MemMapMemorySectionSwAddrMethodRef=VAR_NO_INIT
        VAR_CLEARED_16: MemMapMemorySectionSymbol=VAR_CLEARED_16, MemMapMemorySectionAlignment=16, MemMapMemorySectionSwAddrMethodRef=VAR_CLEARED
        VAR_ZERO_INIT_UNSPECIFIED: MemMapMemorySectionSymbol=VAR_ZERO_INIT_UNSPECIFIED, MemMapMemorySectionAlignment=UNSPECIFIED, MemMapMemorySectionSwAddrMethodRef=VAR_CLEARED
        CONST_64BIT: MemMapMemorySectionSymbol=CONST_64BIT, MemMapMemorySectionAlignment=64, MemMapMemorySectionSwAddrMethodRef=CONST
        VAR_FAST_CLEARED_8: MemMapMemorySectionAlignment=8, MemMapMemorySectionSymbol=VAR_FAST_CLEARED_8, MemMapMemorySectionSwAddrMethodRef=VAR_FAST_CLEARED
        CONST_FAST_16: MemMapMemorySectionSymbol=CONST_FAST_16, MemMapMemorySectionAlignment=16, MemMapMemorySectionSwAddrMethodRef=CONST_FAST
        VAR_FAST_NOINIT_16BIT: MemMapMemorySectionAlignment=16, MemMapMemorySectionSymbol=VAR_FAST_NOINIT_16BIT, MemMapMemorySectionSwAddrMethodRef=VAR_FAST_NO_INIT
        VAR_FAST_CLEARED_64: MemMapMemorySectionAlignment=64, MemMapMemorySectionSymbol=VAR_FAST_CLEARED_64, MemMapMemorySectionSwAddrMethodRef=VAR_FAST_CLEARED
        VAR_INIT_8BIT: MemMapMemorySectionAlignment=8, MemMapMemorySectionSymbol=VAR_INIT_8BIT, MemMapMemorySectionSwAddrMethodRef=VAR_INIT
        VAR_CLEARED_UNSPECIFIED: MemMapMemorySectionAlignment=UNSPECIFIED, MemMapMemorySectionSymbol=VAR_CLEARED_UNSPECIFIED, MemMapMemorySectionSwAddrMethodRef=VAR_CLEARED
        VAR_FAST_NO_INIT_64: MemMapMemorySectionAlignment=64, MemMapMemorySectionSymbol=VAR_FAST_NO_INIT_64, MemMapMemorySectionSwAddrMethodRef=VAR_FAST_NO_INIT
        VAR_PBCFG: MemMapMemorySectionAlignment=UNSPECIFIED, MemMapMemorySectionSymbol=VAR_PBCFG, MemMapMemorySectionSwAddrMethodRef=VAR_PBCFG
        VAR_CLEARED_32: MemMapMemorySectionSymbol=VAR_CLEARED_32, MemMapMemorySectionAlignment=32, MemMapMemorySectionSwAddrMethodRef=VAR_CLEARED
        VAR_FAST_NOINIT_32BIT: MemMapMemorySectionAlignment=32, MemMapMemorySectionSymbol=VAR_FAST_NOINIT_32BIT, MemMapMemorySectionSwAddrMethodRef=VAR_FAST_NO_INIT
        CONST_8BIT: MemMapMemorySectionSymbol=CONST_8BIT, MemMapMemorySectionAlignment=8, MemMapMemorySectionSwAddrMethodRef=CONST
        CONST_UNSPECIFIED: MemMapMemorySectionSymbol=CONST_UNSPECIFIED, MemMapMemorySectionAlignment=UNSPECIFIED, MemMapMemorySectionSwAddrMethodRef=CONST
        VAR_NOINIT_UNSPECIFIED: MemMapMemorySectionSymbol=VAR_NOINIT_UNSPECIFIED, MemMapMemorySectionAlignment=UNSPECIFIED, MemMapMemorySectionSwAddrMethodRef=VAR_NO_INIT
        VAR_FAST_INIT_8: MemMapMemorySectionSymbol=VAR_FAST_INIT_8, MemMapMemorySectionAlignment=8, MemMapMemorySectionSwAddrMethodRef=VAR_FAST_INIT
        VAR_NOCACHE_NO_INIT_8: MemMapMemorySectionSymbol=VAR_NOCACHE_NO_INIT_8, MemMapMemorySectionAlignment=8, MemMapMemorySectionSwAddrMethodRef=VAR_NOCACHE_NO_INIT
        VAR_NOCACHE_INIT_64BIT: MemMapMemorySectionAlignment=64, MemMapMemorySectionSymbol=VAR_NOCACHE_INIT_64BIT, MemMapMemorySectionSwAddrMethodRef=VAR_NOCACHE_INIT
        VAR_NOCACHE_NOINIT_64BIT: MemMapMemorySectionAlignment=64, MemMapMemorySectionSymbol=VAR_NOCACHE_NOINIT_64BIT, MemMapMemorySectionSwAddrMethodRef=VAR_NOCACHE_NO_INIT
        VAR_FAST_CLEARED_32: MemMapMemorySectionSymbol=VAR_FAST_CLEARED_32, MemMapMemorySectionAlignment=32, MemMapMemorySectionSwAddrMethodRef=VAR_FAST_CLEARED
        VAR_INIT_64: MemMapMemorySectionAlignment=64, MemMapMemorySectionSymbol=VAR_INIT_64, MemMapMemorySectionSwAddrMethodRef=VAR_INIT
        CONST_64: MemMapMemorySectionAlignment=64, MemMapMemorySectionSymbol=CONST_64, MemMapMemorySectionSwAddrMethodRef=CONST
        VAR_NOCACHE_INIT_8BIT: MemMapMemorySectionAlignment=8, MemMapMemorySectionSymbol=VAR_NOCACHE_INIT_8BIT, MemMapMemorySectionSwAddrMethodRef=VAR_NOCACHE_INIT
        VAR_NOCACHE_NOINIT_32BIT: MemMapMemorySectionAlignment=32, MemMapMemorySectionSymbol=VAR_NOCACHE_NOINIT_32BIT, MemMapMemorySectionSwAddrMethodRef=VAR_NOCACHE_NO_INIT
        VAR_FAST_NOINIT_64BIT: MemMapMemorySectionSymbol=VAR_FAST_NOINIT_64BIT, MemMapMemorySectionAlignment=64, MemMapMemorySectionSwAddrMethodRef=VAR_FAST_NO_INIT
        VAR_NOCACHE_NOINIT_UNSPECIFIED: MemMapMemorySectionSymbol=VAR_NOCACHE_NOINIT_UNSPECIFIED, MemMapMemorySectionAlignment=UNSPECIFIED, MemMapMemorySectionSwAddrMethodRef=VAR_NOCACHE_NO_INIT
        VAR_ZERO_INIT_8BIT: MemMapMemorySectionAlignment=8, MemMapMemorySectionSymbol=VAR_ZERO_INIT_8BIT, MemMapMemorySectionSwAddrMethodRef=VAR_CLEARED
        CONST_FAST_8: MemMapMemorySectionSymbol=CONST_FAST_8, MemMapMemorySectionAlignment=8, MemMapMemorySectionSwAddrMethodRef=CONST_FAST
        VAR_NOCACHE_NO_INIT_16: MemMapMemorySectionAlignment=16, MemMapMemorySectionSymbol=VAR_NOCACHE_NO_INIT_16, MemMapMemorySectionSwAddrMethodRef=VAR_NOCACHE_NO_INIT
        VAR_FAST_NO_INIT_8: MemMapMemorySectionAlignment=8, MemMapMemorySectionSymbol=VAR_FAST_NO_INIT_8, MemMapMemorySectionSwAddrMethodRef=VAR_FAST_NO_INIT
        VAR_NOCACHE_ZERO_INIT_8BIT: MemMapMemorySectionAlignment=8, MemMapMemorySectionSymbol=VAR_NOCACHE_ZERO_INIT_8BIT, MemMapMemorySectionSwAddrMethodRef=VAR_NOCACHE_CLEARED
        VAR_FAST_NOINIT_8BIT: MemMapMemorySectionAlignment=8, MemMapMemorySectionSymbol=VAR_FAST_NOINIT_8BIT, MemMapMemorySectionSwAddrMethodRef=VAR_FAST_NO_INIT
        VAR_NOCACHE_NO_INIT_64: MemMapMemorySectionSymbol=VAR_NOCACHE_NO_INIT_64, MemMapMemorySectionAlignment=64, MemMapMemorySectionSwAddrMethodRef=VAR_NOCACHE_NO_INIT
        VAR_NOCACHE_INIT_32BIT: MemMapMemorySectionSymbol=VAR_NOCACHE_INIT_32BIT, MemMapMemorySectionAlignment=32, MemMapMemorySectionSwAddrMethodRef=VAR_NOCACHE_INIT
        VAR_NOCACHE_INIT_8: MemMapMemorySectionSymbol=VAR_NOCACHE_INIT_8, MemMapMemorySectionAlignment=8, MemMapMemorySectionSwAddrMethodRef=VAR_NOCACHE_INIT
        VAR_ZERO_INIT_64BIT: MemMapMemorySectionAlignment=64, MemMapMemorySectionSymbol=VAR_ZERO_INIT_64BIT, MemMapMemorySectionSwAddrMethodRef=VAR_CLEARED
        VAR_NOCACHE_INIT_16: MemMapMemorySectionAlignment=16, MemMapMemorySectionSymbol=VAR_NOCACHE_INIT_16, MemMapMemorySectionSwAddrMethodRef=VAR_NOCACHE_INIT
        VAR_NOCACHE_INIT_UNSPECIFIED: MemMapMemorySectionSymbol=VAR_NOCACHE_INIT_UNSPECIFIED, MemMapMemorySectionAlignment=UNSPECIFIED, MemMapMemorySectionSwAddrMethodRef=VAR_NOCACHE_INIT
        VAR: MemMapMemorySectionAlignment=UNSPECIFIED, MemMapMemorySectionSymbol=VAR, MemMapMemorySectionSwAddrMethodRef=VAR_INIT
        VAR_NOCACHE_CLEARED_8: MemMapMemorySectionAlignment=8, MemMapMemorySectionSymbol=VAR_NOCACHE_CLEARED_8, MemMapMemorySectionSwAddrMethodRef=VAR_NOCACHE_CLEARED
        VAR_NOCACHE_CLEARED_64: MemMapMemorySectionSymbol=VAR_NOCACHE_CLEARED_64, MemMapMemorySectionAlignment=64, MemMapMemorySectionSwAddrMethodRef=VAR_NOCACHE_CLEARED
        CONST_FAST_16BIT: MemMapMemorySectionSymbol=CONST_FAST_16BIT, MemMapMemorySectionAlignment=16, MemMapMemorySectionSwAddrMethodRef=CONST_FAST
        VAR_FAST_INIT_64: MemMapMemorySectionSymbol=VAR_FAST_INIT_64, MemMapMemorySectionAlignment=64, MemMapMemorySectionSwAddrMethodRef=VAR_FAST_INIT
        VAR_FAST_ZERO_INIT_UNSPECIFIED: MemMapMemorySectionSymbol=VAR_FAST_ZERO_INIT_UNSPECIFIED, MemMapMemorySectionAlignment=UNSPECIFIED, MemMapMemorySectionSwAddrMethodRef=VAR_FAST_CLEARED
        VAR_NOCACHE_NO_INIT_UNSPECIFIED: MemMapMemorySectionAlignment=UNSPECIFIED, MemMapMemorySectionSymbol=VAR_NOCACHE_NO_INIT_UNSPECIFIED, MemMapMemorySectionSwAddrMethodRef=VAR_NOCACHE_NO_INIT
        VAR_NOCACHE_ZERO_INIT_32BIT: MemMapMemorySectionSymbol=VAR_NOCACHE_ZERO_INIT_32BIT, MemMapMemorySectionAlignment=32, MemMapMemorySectionSwAddrMethodRef=VAR_NOCACHE_CLEARED
        VAR_FAST_INIT_8BIT: MemMapMemorySectionSymbol=VAR_FAST_INIT_8BIT, MemMapMemorySectionAlignment=8, MemMapMemorySectionSwAddrMethodRef=VAR_FAST_INIT
        VAR_INIT_16: MemMapMemorySectionSymbol=VAR_INIT_16, MemMapMemorySectionAlignment=16, MemMapMemorySectionSwAddrMethodRef=VAR_INIT
        VAR_CLEARED_8: MemMapMemorySectionAlignment=8, MemMapMemorySectionSymbol=VAR_CLEARED_8, MemMapMemorySectionSwAddrMethodRef=VAR_CLEARED
        VAR_NOCACHE_INIT_32: MemMapMemorySectionSymbol=VAR_NOCACHE_INIT_32, MemMapMemorySectionAlignment=32, MemMapMemorySectionSwAddrMethodRef=VAR_NOCACHE_INIT
        VAR_FAST_CLEARED_UNSPECIFIED: MemMapMemorySectionAlignment=UNSPECIFIED, MemMapMemorySectionSymbol=VAR_FAST_CLEARED_UNSPECIFIED, MemMapMemorySectionSwAddrMethodRef=VAR_FAST_CLEARED
        CONST_8: MemMapMemorySectionSymbol=CONST_8, MemMapMemorySectionAlignment=8, MemMapMemorySectionSwAddrMethodRef=CONST
        VAR_ZERO_INIT_16BIT: MemMapMemorySectionAlignment=16, MemMapMemorySectionSymbol=VAR_ZERO_INIT_16BIT, MemMapMemorySectionSwAddrMethodRef=VAR_CLEARED
        VAR_FAST_INIT_16: MemMapMemorySectionSymbol=VAR_FAST_INIT_16, MemMapMemorySectionAlignment=16, MemMapMemorySectionSwAddrMethodRef=VAR_FAST_INIT
        VAR_NOCACHE_CLEARED_UNSPECIFIED: MemMapMemorySectionSymbol=VAR_NOCACHE_CLEARED_UNSPECIFIED, MemMapMemorySectionAlignment=UNSPECIFIED, MemMapMemorySectionSwAddrMethodRef=VAR_NOCACHE_CLEARED
        VAR_NOCACHE_NOINIT_8BIT: MemMapMemorySectionAlignment=8, MemMapMemorySectionSymbol=VAR_NOCACHE_NOINIT_8BIT, MemMapMemorySectionSwAddrMethodRef=VAR_NOCACHE_NO_INIT
        CODE: MemMapMemorySectionSymbol=CODE, MemMapMemorySectionSwAddrMethodRef=CODE
        CODE_FAST: MemMapMemorySectionSymbol=CODE_FAST, MemMapMemorySectionSwAddrMethodRef=CODE_FAST
        VAR_FAST_ZERO_INIT_8BIT: MemMapMemorySectionAlignment=8, MemMapMemorySectionSymbol=VAR_FAST_ZERO_INIT_8BIT, MemMapMemorySectionSwAddrMethodRef=VAR_FAST_CLEARED
        CONST_16BIT: MemMapMemorySectionSymbol=CONST_16BIT, MemMapMemorySectionAlignment=16, MemMapMemorySectionSwAddrMethodRef=CONST
        CONST_FAST_32: MemMapMemorySectionAlignment=32, MemMapMemorySectionSymbol=CONST_FAST_32, MemMapMemorySectionSwAddrMethodRef=CONST_FAST
        VAR_NO_INIT_8: MemMapMemorySectionAlignment=8, MemMapMemorySectionSymbol=VAR_NO_INIT_8, MemMapMemorySectionSwAddrMethodRef=VAR_NO_INIT
        VAR_FAST_NOINIT_UNSPECIFIED: MemMapMemorySectionSymbol=VAR_FAST_NOINIT_UNSPECIFIED, MemMapMemorySectionAlignment=UNSPECIFIED, MemMapMemorySectionSwAddrMethodRef=VAR_FAST_NO_INIT
        VAR_FAST_ZERO_INIT_16BIT: MemMapMemorySectionSymbol=VAR_FAST_ZERO_INIT_16BIT, MemMapMemorySectionAlignment=16, MemMapMemorySectionSwAddrMethodRef=VAR_FAST_CLEARED
        VAR_NOINIT_32BIT: MemMapMemorySectionAlignment=32, MemMapMemorySectionSymbol=VAR_NOINIT_32BIT, MemMapMemorySectionSwAddrMethodRef=VAR_NO_INIT
        CONST_16: MemMapMemorySectionSymbol=CONST_16, MemMapMemorySectionAlignment=16, MemMapMemorySectionSwAddrMethodRef=CONST
        CONST_32: MemMapMemorySectionSymbol=CONST_32, MemMapMemorySectionAlignment=32, MemMapMemorySectionSwAddrMethodRef=CONST
        VAR_FAST_ZERO_INIT_64BIT: MemMapMemorySectionAlignment=64, MemMapMemorySectionSymbol=VAR_FAST_ZERO_INIT_64BIT, MemMapMemorySectionSwAddrMethodRef=VAR_FAST_CLEARED
        VAR_NOINIT_64BIT: MemMapMemorySectionSymbol=VAR_NOINIT_64BIT, MemMapMemorySectionAlignment=64, MemMapMemorySectionSwAddrMethodRef=VAR_NO_INIT
        VAR_INIT_64BIT: MemMapMemorySectionAlignment=64, MemMapMemorySectionSymbol=VAR_INIT_64BIT, MemMapMemorySectionSwAddrMethodRef=VAR_INIT
        CONST_FAST_8BIT: MemMapMemorySectionAlignment=8, MemMapMemorySectionSymbol=CONST_FAST_8BIT, MemMapMemorySectionSwAddrMethodRef=CONST_FAST
        VAR_FAST_NO_INIT_UNSPECIFIED: MemMapMemorySectionAlignment=UNSPECIFIED, MemMapMemorySectionSymbol=VAR_FAST_NO_INIT_UNSPECIFIED, MemMapMemorySectionSwAddrMethodRef=VAR_FAST_NO_INIT
        CONST_FAST_64BIT: MemMapMemorySectionAlignment=64, MemMapMemorySectionSymbol=CONST_FAST_64BIT, MemMapMemorySectionSwAddrMethodRef=CONST_FAST
        VAR_NOINIT_8BIT: MemMapMemorySectionAlignment=8, MemMapMemorySectionSymbol=VAR_NOINIT_8BIT, MemMapMemorySectionSwAddrMethodRef=VAR_NO_INIT
        VAR_NOCACHE_CLEARED_32: MemMapMemorySectionSymbol=VAR_NOCACHE_CLEARED_32, MemMapMemorySectionAlignment=32, MemMapMemorySectionSwAddrMethodRef=VAR_NOCACHE_CLEARED
        VAR_FAST_INIT_16BIT: MemMapMemorySectionSymbol=VAR_FAST_INIT_16BIT, MemMapMemorySectionAlignment=16, MemMapMemorySectionSwAddrMethodRef=VAR_FAST_INIT
        VAR_INIT_32: MemMapMemorySectionAlignment=32, MemMapMemorySectionSymbol=VAR_INIT_32, MemMapMemorySectionSwAddrMethodRef=VAR_INIT
        VAR_ZERO_INIT_32BIT: MemMapMemorySectionSymbol=VAR_ZERO_INIT_32BIT, MemMapMemorySectionAlignment=32, MemMapMemorySectionSwAddrMethodRef=VAR_CLEARED
        VAR_FAST_NO_INIT_16: MemMapMemorySectionAlignment=16, MemMapMemorySectionSymbol=VAR_FAST_NO_INIT_16, MemMapMemorySectionSwAddrMethodRef=VAR_FAST_NO_INIT
        VAR_CLEARED_64: MemMapMemorySectionSymbol=VAR_CLEARED_64, MemMapMemorySectionAlignment=64, MemMapMemorySectionSwAddrMethodRef=VAR_CLEARED
        VAR_FAST_INIT_32BIT: MemMapMemorySectionAlignment=32, MemMapMemorySectionSymbol=VAR_FAST_INIT_32BIT, MemMapMemorySectionSwAddrMethodRef=VAR_FAST_INIT
    15 x MemMapAddressingModeSet, all with MemMapCompilerMemClassSymbolImpl=:
      MSR_VAR_CLEARED
        MSR_VAR_CLEARED (MemMapAddressingMode):
          MemMapAlignmentSelector = UNSPECIFIED
          MemMapAlignmentSelector = 8
          MemMapAlignmentSelector = 16
          MemMapAlignmentSelector = 32
          MemMapAlignmentSelector = 64
          MemMapAlignmentSelector = BOOLEAN
      MSR_VAR_NO_INIT
        MSR_VAR_NO_INIT (MemMapAddressingMode):
          MemMapAlignmentSelector = UNSPECIFIED
          MemMapAlignmentSelector = 8
          MemMapAlignmentSelector = 16
          MemMapAlignmentSelector = 32
          MemMapAlignmentSelector = 64
          MemMapAlignmentSelector = BOOLEAN
      vHsmGlobalRamBuffer
        vHsmGlobalRamBuffer (MemMapAddressingMode): MemMapAlignmentSelector=UNSPECIFIED, MemMapAlignmentSelector=32
      MSR_VAR_INIT
        MSR_VAR_INIT (MemMapAddressingMode):
          MemMapAlignmentSelector = UNSPECIFIED
          MemMapAlignmentSelector = 8
          MemMapAlignmentSelector = 16
          MemMapAlignmentSelector = 32
          MemMapAlignmentSelector = 64
          MemMapAlignmentSelector = BOOLEAN
      OS_GLOBALSHARED_VAR_INIT
        OS_GLOBALSHARED_VAR_INIT (MemMapAddressingMode):
          MemMapAlignmentSelector = BOOLEAN
          MemMapAlignmentSelector = 8
          MemMapAlignmentSelector = 16
          MemMapAlignmentSelector = 32
          MemMapAlignmentSelector = 64
          MemMapAlignmentSelector = UNSPECIFIED
      MSR_CODE
        MSR_CODE (MemMapAddressingMode):
          MemMapAlignmentSelector = UNSPECIFIED
          MemMapAlignmentSelector = 8
          MemMapAlignmentSelector = 16
          MemMapAlignmentSelector = 32
          MemMapAlignmentSelector = 64
          MemMapAlignmentSelector = BOOLEAN
      vHsmIpcMemory
        vHsmIpcMemory (MemMapAddressingMode): MemMapAlignmentSelector=32
      OS_GLOBALSHARED_VAR_SAVED_ZONE
        OS_GLOBALSHARED_VAR_SAVED_ZONE (MemMapAddressingMode):
          MemMapAlignmentSelector = BOOLEAN
          MemMapAlignmentSelector = 8
          MemMapAlignmentSelector = 16
          MemMapAlignmentSelector = 32
          MemMapAlignmentSelector = 64
          MemMapAlignmentSelector = UNSPECIFIED
      vHsmRamCode
        vHsmRamCode (MemMapAddressingMode): MemMapAlignmentSelector=UNSPECIFIED
      MSR_VAR_SAVED_ZONE
        MSR_VAR_SAVED_ZONE (MemMapAddressingMode):
          MemMapAlignmentSelector = UNSPECIFIED
          MemMapAlignmentSelector = 8
          MemMapAlignmentSelector = 16
          MemMapAlignmentSelector = 32
          MemMapAlignmentSelector = 64
          MemMapAlignmentSelector = BOOLEAN
      OS_GLOBALSHARED_VAR_NOINIT
        OS_GLOBALSHARED_VAR_NOINIT (MemMapAddressingMode):
          MemMapAlignmentSelector = BOOLEAN
          MemMapAlignmentSelector = 8
          MemMapAlignmentSelector = 16
          MemMapAlignmentSelector = 32
          MemMapAlignmentSelector = 64
          MemMapAlignmentSelector = UNSPECIFIED
      MSR_PBCFG_VAR
        MSR_PBCFG_VAR (MemMapAddressingMode):
          MemMapAlignmentSelector = UNSPECIFIED
          MemMapAlignmentSelector = 8
          MemMapAlignmentSelector = 16
          MemMapAlignmentSelector = 32
          MemMapAlignmentSelector = 64
          MemMapAlignmentSelector = BOOLEAN
      OS_GLOBALSHARED_VAR_ZERO_INIT
        OS_GLOBALSHARED_VAR_ZERO_INIT (MemMapAddressingMode):
          MemMapAlignmentSelector = BOOLEAN
          MemMapAlignmentSelector = 8
          MemMapAlignmentSelector = 16
          MemMapAlignmentSelector = 32
          MemMapAlignmentSelector = 64
          MemMapAlignmentSelector = UNSPECIFIED
      MSR_PBCFG_CONST
        MSR_PBCFG_CONST (MemMapAddressingMode):
          MemMapAlignmentSelector = UNSPECIFIED
          MemMapAlignmentSelector = 8
          MemMapAlignmentSelector = 16
          MemMapAlignmentSelector = 32
          MemMapAlignmentSelector = 64
          MemMapAlignmentSelector = BOOLEAN
      MSR_CONST
        MSR_CONST (MemMapAddressingMode):
          MemMapAlignmentSelector = UNSPECIFIED
          MemMapAlignmentSelector = 8
          MemMapAlignmentSelector = 16
          MemMapAlignmentSelector = 32
          MemMapAlignmentSelector = 64
          MemMapAlignmentSelector = BOOLEAN
    3 x MemMapAllocation:
      vHsm_Generic
        3 x MemMapSectionSpecificMapping:
          vHsmRamCode: MemMapAddressingModeSetRef=VTTMemMap/vHsmRamCode, MemMapMemorySectionRef=CRYPTO_30_VHSM_RAMCODE
          vHsmGlobalRamBuffer: MemMapAddressingModeSetRef=VTTMemMap/vHsmGlobalRamBuffer, MemMapMemorySectionRef=CRYPTO_30_VHSM_GLOBAL_VAR_NOINIT_32BIT, MemMapMemorySectionRef=CRYPTO_30_VHSM_GLOBAL_VAR_NOINIT_UNSPECIFIED
          vHsmIpcMemory: MemMapAddressingModeSetRef=VTTMemMap/vHsmIpcMemory, MemMapMemorySectionRef=CRYPTO_30_VHSM_IPC_MEMORY_VAR_NOINIT_32BIT
      MSR_Generic
        8 x MemMapGenericMapping:
          MSR_CONST: MemMapAddressingModeSetRef=VTTMemMap/MSR_CONST, MemMapSwAddressMethodRef=CONST_8, MemMapSwAddressMethodRef=CONST_16, MemMapSwAddressMethodRef=CONST_32, MemMapSwAddressMethodRef=CONST_64, MemMapSwAddressMethodRef=CONST_BOOLEAN, MemMapSwAddressMethodRef=CONST_FAST_8, MemMapSwAddressMethodRef=CONST_FAST_16, MemMapSwAddressMethodRef=CONST_FAST_32, MemMapSwAddressMethodRef=CONST_FAST_64, MemMapSwAddressMethodRef=CONST_FAST_BOOLEAN, MemMapSwAddressMethodRef=CONST_FAST_UNSPECIFIED, MemMapSwAddressMethodRef=CONST_UNSPECIFIED, MemMapSwAddressMethodRef=CONFIG_DATA, MemMapSwAddressMethodRef=CONST, MemMapSwAddressMethodRef=CONST_FAST
          MSR_VAR_CLEARED: MemMapAddressingModeSetRef=VTTMemMap/MSR_VAR_CLEARED, MemMapSwAddressMethodRef=VAR_ZERO_INIT_8, MemMapSwAddressMethodRef=VAR_ZERO_INIT_16, MemMapSwAddressMethodRef=VAR_ZERO_INIT_32, MemMapSwAddressMethodRef=VAR_ZERO_INIT_64, MemMapSwAddressMethodRef=VAR_ZERO_INIT_UNSPECIFIED, MemMapSwAddressMethodRef=VAR_ZERO_INIT_BOOLEAN, MemMapSwAddressMethodRef=VAR_FAST_ZERO_INIT_8, MemMapSwAddressMethodRef=VAR_FAST_ZERO_INIT_16, MemMapSwAddressMethodRef=VAR_FAST_ZERO_INIT_32, MemMapSwAddressMethodRef=VAR_FAST_ZERO_INIT_64, MemMapSwAddressMethodRef=VAR_FAST_ZERO_INIT_BOOLEAN, MemMapSwAddressMethodRef=VAR_FAST_ZERO_INIT_UNSPECIFIED, MemMapSwAddressMethodRef=VAR_NOCACHE_ZERO_INIT_8, MemMapSwAddressMethodRef=VAR_NOCACHE_ZERO_INIT_16, MemMapSwAddressMethodRef=VAR_NOCACHE_ZERO_INIT_32, MemMapSwAddressMethodRef=VAR_NOCACHE_ZERO_INIT_64, MemMapSwAddressMethodRef=VAR_NOCACHE_ZERO_INIT_BOOLEAN, MemMapSwAddressMethodRef=VAR_NOCACHE_ZERO_INIT_UNSPECIFIED, MemMapSwAddressMethodRef=VAR_CLEARED_BOOLEAN, MemMapSwAddressMethodRef=VAR_CLEARED_8, MemMapSwAddressMethodRef=VAR_CLEARED_16, MemMapSwAddressMethodRef=VAR_CLEARED_32, MemMapSwAddressMethodRef=VAR_CLEARED_64, MemMapSwAddressMethodRef=VAR_CLEARED_UNSPECIFIED, MemMapSwAddressMethodRef=VAR_FAST_CLEARED_BOOLEAN, MemMapSwAddressMethodRef=VAR_FAST_CLEARED_8, MemMapSwAddressMethodRef=VAR_FAST_CLEARED_16, MemMapSwAddressMethodRef=VAR_FAST_CLEARED_32, MemMapSwAddressMethodRef=VAR_FAST_CLEARED_64, MemMapSwAddressMethodRef=VAR_FAST_CLEARED_UNSPECIFIED, MemMapSwAddressMethodRef=VAR_NOCACHE_CLEARED_BOOLEAN, MemMapSwAddressMethodRef=VAR_NOCACHE_CLEARED_8, MemMapSwAddressMethodRef=VAR_NOCACHE_CLEARED_16, MemMapSwAddressMethodRef=VAR_NOCACHE_CLEARED_32, MemMapSwAddressMethodRef=VAR_NOCACHE_CLEARED_64, MemMapSwAddressMethodRef=VAR_NOCACHE_CLEARED_UNSPECIFIED, MemMapSwAddressMethodRef=VAR_CLEARED, MemMapSwAddressMethodRef=VAR_FAST_CLEARED, MemMapSwAddressMethodRef=VAR_NOCACHE_CLEARED, MemMapSwAddressMethodRef=VAR_ZERO_INIT
          MSR_PBCFG_CONST: MemMapAddressingModeSetRef=VTTMemMap/MSR_PBCFG_CONST, MemMapSwAddressMethodRef=CONST_PBCFG, MemMapSwAddressMethodRef=PBCFG_GLOBALROOT
          MSR_VAR_INIT: MemMapAddressingModeSetRef=VTTMemMap/MSR_VAR_INIT, MemMapSwAddressMethodRef=VAR_FAST_INIT_8, MemMapSwAddressMethodRef=VAR_FAST_INIT_16, MemMapSwAddressMethodRef=VAR_FAST_INIT_32, MemMapSwAddressMethodRef=VAR_FAST_INIT_64, MemMapSwAddressMethodRef=VAR_FAST_INIT_UNSPECIFIED, MemMapSwAddressMethodRef=VAR_INIT_8, MemMapSwAddressMethodRef=VAR_INIT_16, MemMapSwAddressMethodRef=VAR_INIT_32, MemMapSwAddressMethodRef=VAR_INIT_64, MemMapSwAddressMethodRef=VAR_INIT_BOOLEAN, MemMapSwAddressMethodRef=VAR_INIT_UNSPECIFIED, MemMapSwAddressMethodRef=VAR_FAST_INIT_BOOLEAN, MemMapSwAddressMethodRef=VAR_NOCACHE_INIT_8, MemMapSwAddressMethodRef=VAR_NOCACHE_INIT_16, MemMapSwAddressMethodRef=VAR_NOCACHE_INIT_32, MemMapSwAddressMethodRef=VAR_NOCACHE_INIT_64, MemMapSwAddressMethodRef=VAR_NOCACHE_INIT_BOOLEAN, MemMapSwAddressMethodRef=VAR_NOCACHE_INIT_UNSPECIFIED, MemMapSwAddressMethodRef=VAR_INIT, MemMapSwAddressMethodRef=VAR_FAST_INIT, MemMapSwAddressMethodRef=VAR_NOCACHE_INIT
          MSR_VAR_SAVED_ZONE: MemMapAddressingModeSetRef=VTTMemMap/MSR_VAR_SAVED_ZONE, MemMapSwAddressMethodRef=VAR_SAVED_ZONE_BOOLEAN, MemMapSwAddressMethodRef=VAR_SAVED_ZONE_8, MemMapSwAddressMethodRef=VAR_SAVED_ZONE_16, MemMapSwAddressMethodRef=VAR_SAVED_ZONE_32, MemMapSwAddressMethodRef=VAR_SAVED_ZONE_64, MemMapSwAddressMethodRef=VAR_SAVED_ZONE_UNSPECIFIED, MemMapSwAddressMethodRef=VAR_SAVED_ZONE
          MSR_PBCFG_VAR: MemMapAddressingModeSetRef=VTTMemMap/MSR_PBCFG_VAR, MemMapSwAddressMethodRef=VAR_PBCFG
          MSR_CODE: MemMapAddressingModeSetRef=VTTMemMap/MSR_CODE, MemMapSwAddressMethodRef=CODE, MemMapSwAddressMethodRef=CALLOUT_CODE, MemMapSwAddressMethodRef=CODE_FAST, MemMapSwAddressMethodRef=CODE_ISR
          MSR_VAR_NO_INIT: MemMapAddressingModeSetRef=VTTMemMap/MSR_VAR_NO_INIT, MemMapSwAddressMethodRef=VAR_FAST_NO_INIT_8, MemMapSwAddressMethodRef=VAR_FAST_NO_INIT_16, MemMapSwAddressMethodRef=VAR_FAST_NO_INIT_32, MemMapSwAddressMethodRef=VAR_FAST_NO_INIT_64, MemMapSwAddressMethodRef=VAR_FAST_NO_INIT_UNSPECIFIED, MemMapSwAddressMethodRef=VAR_NO_INIT_8, MemMapSwAddressMethodRef=VAR_NO_INIT_16, MemMapSwAddressMethodRef=VAR_NO_INIT_32, MemMapSwAddressMethodRef=VAR_NO_INIT_64, MemMapSwAddressMethodRef=VAR_NO_INIT_UNSPECIFIED, MemMapSwAddressMethodRef=VAR_NO_INIT_BOOLEAN, MemMapSwAddressMethodRef=VAR_FAST_NO_INIT_BOOLEAN, MemMapSwAddressMethodRef=VAR_NOCACHE_NO_INIT_8, MemMapSwAddressMethodRef=VAR_NOCACHE_NO_INIT_16, MemMapSwAddressMethodRef=VAR_NOCACHE_NO_INIT_32, MemMapSwAddressMethodRef=VAR_NOCACHE_NO_INIT_64, MemMapSwAddressMethodRef=VAR_NOCACHE_NO_INIT_BOOLEAN, MemMapSwAddressMethodRef=VAR_NOCACHE_NO_INIT_UNSPECIFIED, MemMapSwAddressMethodRef=VAR_FAST_NOINIT_8, MemMapSwAddressMethodRef=VAR_FAST_NOINIT_16, MemMapSwAddressMethodRef=VAR_FAST_NOINIT_32, MemMapSwAddressMethodRef=VAR_FAST_NOINIT_64, MemMapSwAddressMethodRef=VAR_FAST_NOINIT_UNSPECIFIED, MemMapSwAddressMethodRef=VAR_NOINIT_8, MemMapSwAddressMethodRef=VAR_NOINIT_16, MemMapSwAddressMethodRef=VAR_NOINIT_32, MemMapSwAddressMethodRef=VAR_NOINIT_64, MemMapSwAddressMethodRef=VAR_NOINIT_UNSPECIFIED, MemMapSwAddressMethodRef=VAR_NOINIT_BOOLEAN, MemMapSwAddressMethodRef=VAR_FAST_NOINIT_BOOLEAN, MemMapSwAddressMethodRef=VAR_NOCACHE_NOINIT_8, MemMapSwAddressMethodRef=VAR_NOCACHE_NOINIT_16, MemMapSwAddressMethodRef=VAR_NOCACHE_NOINIT_32, MemMapSwAddressMethodRef=VAR_NOCACHE_NOINIT_64, MemMapSwAddressMethodRef=VAR_NOCACHE_NOINIT_BOOLEAN, MemMapSwAddressMethodRef=VAR_NOCACHE_NOINIT_UNSPECIFIED, MemMapSwAddressMethodRef=VAR_NO_INIT, MemMapSwAddressMethodRef=VAR_FAST_NO_INIT, MemMapSwAddressMethodRef=VAR_NOCACHE_NO_INIT
      OS_Generic
        10 x MemMapGenericMapping:
          OS_GLOBALSHARED_VAR_SAVED_ZONE: MemMapAddressingModeSetRef=VTTMemMap/OS_GLOBALSHARED_VAR_SAVED_ZONE, MemMapSwAddressMethodRef=GLOBALSHARED_VAR_SAVED_ZONE
          OS_GLOBALSHARED_CONST: MemMapAddressingModeSetRef=VTTMemMap/MSR_CONST, MemMapSwAddressMethodRef=GLOBALSHARED_CONST, MemMapSwAddressMethodRef=GLOBALSHARED_CONST_FAST
          OS_GLOBALSHARED_VAR_ZERO_INIT: MemMapAddressingModeSetRef=VTTMemMap/OS_GLOBALSHARED_VAR_ZERO_INIT, MemMapSwAddressMethodRef=GLOBALSHARED_VAR_CLEARED, MemMapSwAddressMethodRef=GLOBALSHARED_VAR_FAST_CLEARED, MemMapSwAddressMethodRef=GLOBALSHARED_VAR_NOCACHE_CLEARED
          OS_GLOBALSHARED_VAR_NOINIT: MemMapAddressingModeSetRef=VTTMemMap/OS_GLOBALSHARED_VAR_NOINIT, MemMapSwAddressMethodRef=GLOBALSHARED_VAR_NO_INIT, MemMapSwAddressMethodRef=GLOBALSHARED_VAR_FAST_NO_INIT, MemMapSwAddressMethodRef=GLOBALSHARED_VAR_NOCACHE_NO_INIT
          OS_GLOBALSHARED_VAR_INIT: MemMapAddressingModeSetRef=VTTMemMap/OS_GLOBALSHARED_VAR_INIT, MemMapSwAddressMethodRef=GLOBALSHARED_VAR_INIT, MemMapSwAddressMethodRef=GLOBALSHARED_VAR_FAST_INIT, MemMapSwAddressMethodRef=GLOBALSHARED_VAR_NOCACHE_INIT
          OS_SystemApplication_OsCore0_VAR_ZERO_INIT: MemMapAddressingModeSetRef=VTTMemMap/OS_SystemApplication_OsCore0_VAR_ZERO_INIT, MemMapSwAddressMethodRef=SystemApplication_OsCore0_VAR_CLEARED, MemMapSwAddressMethodRef=SystemApplication_OsCore0_VAR_FAST_CLEARED, MemMapSwAddressMethodRef=SystemApplication_OsCore0_VAR_NOCACHE_CLEARED
          OS_SystemApplication_OsCore0_VAR_INIT: MemMapAddressingModeSetRef=VTTMemMap/OS_SystemApplication_OsCore0_VAR_INIT, MemMapSwAddressMethodRef=SystemApplication_OsCore0_VAR_INIT, MemMapSwAddressMethodRef=SystemApplication_OsCore0_VAR_FAST_INIT, MemMapSwAddressMethodRef=SystemApplication_OsCore0_VAR_NOCACHE_INIT
          OS_SystemApplication_OsCore0_VAR_NOINIT: MemMapAddressingModeSetRef=VTTMemMap/OS_SystemApplication_OsCore0_VAR_NOINIT, MemMapSwAddressMethodRef=SystemApplication_OsCore0_VAR_NO_INIT, MemMapSwAddressMethodRef=SystemApplication_OsCore0_VAR_FAST_NO_INIT, MemMapSwAddressMethodRef=SystemApplication_OsCore0_VAR_NOCACHE_NO_INIT
          OS_SystemApplication_OsCore0_VAR_SAVED_ZONE: MemMapAddressingModeSetRef=VTTMemMap/OS_SystemApplication_OsCore0_VAR_SAVED_ZONE, MemMapSwAddressMethodRef=SystemApplication_OsCore0_VAR_SAVED_ZONE
          OS_SystemApplication_OsCore0_CONST: MemMapAddressingModeSetRef=VTTMemMap/MSR_CONST, MemMapSwAddressMethodRef=SystemApplication_OsCore0_CONST, MemMapSwAddressMethodRef=SystemApplication_OsCore0_CONST_FAST
    4 x MemMapAddressingModeSet, all with MemMapCompilerMemClassSymbolImpl=:
      OS_SystemApplication_OsCore0_VAR_INIT
        OS_SystemApplication_OsCore0_VAR_INIT (MemMapAddressingMode):
          MemMapAlignmentSelector = BOOLEAN
          MemMapAlignmentSelector = 8
          MemMapAlignmentSelector = 16
          MemMapAlignmentSelector = 32
          MemMapAlignmentSelector = 64
          MemMapAlignmentSelector = UNSPECIFIED
      OS_SystemApplication_OsCore0_VAR_SAVED_ZONE
        OS_SystemApplication_OsCore0_VAR_SAVED_ZONE (MemMapAddressingMode):
          MemMapAlignmentSelector = BOOLEAN
          MemMapAlignmentSelector = 8
          MemMapAlignmentSelector = 16
          MemMapAlignmentSelector = 32
          MemMapAlignmentSelector = 64
          MemMapAlignmentSelector = UNSPECIFIED
      OS_SystemApplication_OsCore0_VAR_ZERO_INIT
        OS_SystemApplication_OsCore0_VAR_ZERO_INIT (MemMapAddressingMode):
          MemMapAlignmentSelector = BOOLEAN
          MemMapAlignmentSelector = 8
          MemMapAlignmentSelector = 16
          MemMapAlignmentSelector = 32
          MemMapAlignmentSelector = 64
          MemMapAlignmentSelector = UNSPECIFIED
      OS_SystemApplication_OsCore0_VAR_NOINIT
        OS_SystemApplication_OsCore0_VAR_NOINIT (MemMapAddressingMode):
          MemMapAlignmentSelector = BOOLEAN
          MemMapAlignmentSelector = 8
          MemMapAlignmentSelector = 16
          MemMapAlignmentSelector = 32
          MemMapAlignmentSelector = 64
          MemMapAlignmentSelector = UNSPECIFIED
  module config Pwm: implementation-config-variant=VARIANT-PRE-COMPILE, module-description=Pwm_Impl
    PwmChannelConfigSet
      PWM_FanMotor (PwmChannel): PwmChannelClass=PWM_FIXED_PERIOD, PwmDutycycleDefault=0, PwmIdleState=PWM_LOW, PwmPeriodDefault=0.01, PwmPolarity=PWM_LOW, PwmChannelId=0
    PwmConfigurationOfOptApiServices: PwmDeInitApi=true, PwmGetOutputState=true, PwmSetDutyCycle=true, PwmSetOutputToIdle=true, PwmSetPeriodAndDuty=true, PwmVersionInfoApi=false
    PwmGeneral: PwmDevErorDetect=true, PwmDutycycleUpdatedEndperiod=true, PwmNotificationSupported=true, PwmPeriodUpdatedEndperiod=true, PwmSafeBswChecks=false
  module config Adc: implementation-config-variant=VARIANT-PRE-COMPILE, module-description=Adc_Impl
    AdcConfigSet
      AdcHwUnit: AdcHwUnitId=Hw0, AdcPrescale=10
        AdcPower (AdcChannel):
          AdcChannelConvTime = 1000
          AdcChannelRefVoltsrcHigh = ADC_5V
          AdcChannelRefVoltsrcLow = ADC_0V
          AdcChannelResolution = 10
          AdcChannelSampTime = 254
          AdcChannelId = 0
        AdcGroupPower (AdcGroup):
          AdcGroupAccessMode = ADC_ACCESS_MODE_SINGLE
          AdcGroupConversionMode = ADC_CONV_MODE_ONESHOT
          AdcGroupTriggSrc = ADC_TRIGG_SRC_HW
          AdcStreamingNumSamples = 1
          AdcGroupId = 0
          AdcGroupPriority = 0
          AdcGroupReplacement = ADC_GROUP_REPL_ABORT_RESTART
          AdcHwTrigTimer = 0
          AdcHwTrigSignal = ADC_HW_TRIG_BOTH_EDGES
          AdcStreamingBufferMode = ADC_STREAM_BUFFER_LINEAR
          AdcNotification = RCtApController_ErrorDetection
          AdcGroupDefinition = AdcHwUnit/AdcPower
    AdcGeneral:
      AdcDeInitApi = true
      AdcDevErrorDetect = true
      AdcEnableLimitCheck = false
      AdcEnableQueuing = false
      AdcEnableStartStopGroupApi = true
      AdcGrpNotifCapability = true
      AdcHwTriggerApi = true
      AdcPriorityImplementation = ADC_PRIORITY_NONE
      AdcReadGroupApi = true
      AdcResultAlignment = ADC_ALIGN_RIGHT
      AdcVersionInfoApi = true
      AdcSafeBswChecks = false
    AdcPublishedInformation: AdcChannelValueSigned=false, AdcGroupFirstChannelFixed=false, AdcMaxChannelResolution=32
  module config VTTAdc: implementation-config-variant=VARIANT-PRE-COMPILE, module-description=VTTAdc_Impl
    AdcGeneral:
      AdcDeInitApi = true
      AdcDevErrorDetect = true
      AdcEnableLimitCheck = false
      AdcEnableQueuing = false
      AdcEnableStartStopGroupApi = true
      AdcGrpNotifCapability = true
      AdcHwTriggerApi = true
      AdcPriorityImplementation = ADC_PRIORITY_NONE
      AdcReadGroupApi = true
      AdcResultAlignment = ADC_ALIGN_RIGHT
      AdcVersionInfoApi = true
      AdcSafeBswChecks = false
    AdcPublishedInformation: AdcChannelValueSigned=false, AdcGroupFirstChannelFixed=false, AdcMaxChannelResolution=32
    AdcConfigSet
      AdcHwUnit: AdcHwUnitId=Hw0, AdcPrescale=10
        AdcPower (AdcChannel):
          AdcChannelConvTime = 1000
          AdcChannelRefVoltsrcHigh = ADC_5V
          AdcChannelRefVoltsrcLow = ADC_0V
          AdcChannelResolution = 10
          AdcChannelSampTime = 254
          AdcChannelId = 0
        AdcGroupPower (AdcGroup):
          AdcGroupAccessMode = ADC_ACCESS_MODE_SINGLE
          AdcGroupConversionMode = ADC_CONV_MODE_ONESHOT
          AdcGroupTriggSrc = ADC_TRIGG_SRC_HW
          AdcStreamingNumSamples = 1
          AdcGroupPriority = 0
          AdcGroupReplacement = ADC_GROUP_REPL_ABORT_RESTART
          AdcGroupId = 0
          AdcHwTrigTimer = 0
          AdcHwTrigSignal = ADC_HW_TRIG_BOTH_EDGES
          AdcStreamingBufferMode = ADC_STREAM_BUFFER_LINEAR
          AdcNotification = RCtApController_ErrorDetection
          AdcGroupDefinition = AdcHwUnit/AdcPower
  module config Nm: implementation-config-variant=VARIANT-PRE-COMPILE, module-description=Nm_Impl
    NmGlobalConfig
      NmGlobalProperties: NmSafeBswChecks=true, NmDevErrorDetect=true, NmVersionInfoApi=false
      NmGlobalConstants
      NmGlobalFeatures:
        NmBusSynchronizationEnabled = false
        NmCarWakeUpRxEnabled = false
        NmComControlEnabled = false
        NmComUserDataSupport = false
        NmCoordinatorSupportEnabled = false
        NmNodeDetectionEnabled = false
        NmNodeIdEnabled = false
        NmPduRxIndicationEnabled = false
        NmRemoteSleepIndEnabled = false
        NmRepeatMsgIndEnabled = false
        NmStateChangeIndEnabled = false
        NmUserDataEnabled = false
        NmMacroLayerEnabled = false
        NmCoordinatorSyncSupport = false
        NmRuntimeMeasurementSupport = false
        NmCoordinatorRequestChannelsInBusSleep = false
        NmCoordinatorPassiveStartUpForwarding = false
      NmGeneration:
        NmOutOfBoundsWriteSanitizer = false
        NmOutOfBoundsReadSanitizer = false
        NmShortSymbols = false
        NmInterfacesForDeactivatedData = false
        NmReferringKeysInComments = false
    NmChannelConfig:
      NmChannelId = 0
      NmChannelSleepMaster = false
      NmStateReportEnabled = false
      NmSynchronizingNetwork = false
      NmPassiveModeEnabled = false
      NmComMChannelRef = Connector_Fan_ECU_fbc5880ce1a0cdea_90249745
      NmBusType
        NmStandardBusNmConfig: NmStandardBusType=NM_BUSNM_CANNM
  module config CanNm: implementation-config-variant=VARIANT-PRE-COMPILE, module-description=CanNm_Impl
    CanNmGlobalConfig:
      CanNmSafeBswChecks = true
      CanNmBusLoadReductionEnabled = false
      CanNmBusSynchronizationEnabled = false
      CanNmComUserDataSupport = false
      CanNmCoordinatorSyncSupport = false
      CanNmDevErrorDetect = true
      CanNmImmediateTxconfEnabled = false
      CanNmMainFunctionPeriod = 0.01
      CanNmPassiveModeEnabled = false
      CanNmPduRxIndicationEnabled = false
      CanNmRemoteSleepIndEnabled = false
      CanNmStateChangeIndEnabled = false
      CanNmUserDataEnabled = false
      CanNmVersionInfoApi = false
      CanNmDisableTxErrReport = false
      CanNmApiOptimization = false
      CanNmCanIfRangeConfigDLCCheck = true
      CanNmRuntimeMeasurementSupport = false
      CanNmPnSyncShutdownErrorReactionEnabled = false
      CanNmRuntimeErrorReport = true
      CanNmGeneration: CanNmOutOfBoundsWriteSanitizer=false, CanNmOutOfBoundsReadSanitizer=false, CanNmInterfacesForDeactivatedData=false
      CanNmChannelConfig:
        CanNmBusLoadReductionActive = false
        CanNmCarWakeUpRxEnabled = false
        CanNmImmediateNmTransmissions = 0
        CanNmMsgCycleOffset = 0
        CanNmMsgCycleTime = 0.1
        CanNmMsgReducedTime = 0.08
        CanNmMsgTimeoutTime = 0.06
        CanNmNodeId = 0
        CanNmPduCbvPosition = CANNM_PDU_OFF
        CanNmPduNidPosition = CANNM_PDU_OFF
        CanNmRemoteSleepIndTime = 0.5
        CanNmRepeatMessageTime = 0.4
        CanNmTimeoutTime = 1
        CanNmUserDataLength = 0
        CanNmWaitBusSleepTime = 0.75
        CanNmActiveWakeupBitEnabled = false
        CanNmNodeIdEnabled = false
        CanNmNodeDetectionEnabled = false
        CanNmRepeatMsgIndEnabled = false
        CanNmImmediateRestartEnabled = false
        CanNmComControlEnabled = false
        CanNmCriBitAlwaysEnabled = false
        CanNmComMNetworkHandleRef = Connector_Fan_ECU_fbc5880ce1a0cdea_90249745
        CanNmRxPdu: CanNmRxPduId=0, CanNmRxPduRef=Comfort_Fan_NM_PDU_Rx_68476f29_Rx
        CanNmTxPdu: CanNmTxConfirmationPduId=0, CanNmTxPduRef=Comfort_Fan_NM_PDU_Tx_3bb98271_Tx
  module config Dcm: implementation-config-variant=VARIANT-PRE-COMPILE, module-description=Dcm_Impl
    DcmConfigSet
      DcmGeneral:
        DcmResetToFblAfterSessionFinalResponseEnabled = false
        DcmDevErrorDetect = true
        DcmRequestManufacturerNotificationEnabled = false
        DcmRequestSupplierNotificationEnabled = false
        DcmRespondAllRequest = true
        DcmTaskTime = 0.01
        DcmVersionInfoApi = false
        DcmDspDataDefaultEndianness = LITTLE_ENDIAN
        DcmSafeBswChecks = true
        DcmSupportedIDCalculationSuppressionEnabled = false
        DcmDtrDataProvisionViaDemEnabled = true
        DcmForeignDiagnosticRequestDetectionEnabled = false
        DcmSuppressResponseOnCanTpFuncMixedAddrRequests = false
        DcmSenderReceiverPRPortsEnabled = false
        DcmAutosarVersion = AUTOSAR_4_02_02
        DcmDemApiVersion = DCM_DEM_API_4_03_01
        DcmFinalResponseToFblEnabled = false
      DcmDsd
        DcmDsdServiceTable
          13 x DcmDsdService:
            ClearDiagInfo: DcmDsdSidTabServiceId=20, DcmDsdSidTabSubfuncAvail=false
            EcuReset: DcmDsdSidTabServiceId=17, DcmDsdSidTabSubfuncAvail=true
              Soft (DcmDsdSubService): DcmDsdSubServiceId=3
              Hard (DcmDsdSubService): DcmDsdSubServiceId=1
            ControlDtcSetting: DcmDsdSidTabServiceId=133, DcmDsdSidTabSubfuncAvail=true
              Disable (DcmDsdSubService): DcmDsdSubServiceId=2
              Enable (DcmDsdSubService): DcmDsdSubServiceId=1
            WriteDataById: DcmDsdSidTabServiceId=46, DcmDsdSidTabSubfuncAvail=false
            ReadDataById: DcmDsdSidTabServiceId=34, DcmDsdSidTabSubfuncAvail=false
            SecurityAccess: DcmDsdSidTabServiceId=39, DcmDsdSidTabSubfuncAvail=true, DcmDsdSidTabSessionLevelRef=DcmDspSession/Programming, DcmDsdSidTabSessionLevelRef=DcmDspSession/Extended
              SeedLevel1_Request (DcmDsdSubService): DcmDsdSubServiceId=1, DcmDsdSubServiceSessionLevelRef=DcmDspSession/Programming, DcmDsdSubServiceSessionLevelRef=DcmDspSession/Extended
              KeyLevel1_Send (DcmDsdSubService): DcmDsdSubServiceId=2, DcmDsdSubServiceSessionLevelRef=DcmDspSession/Programming, DcmDsdSubServiceSessionLevelRef=DcmDspSession/Extended
            ReadMemoryByAddress: DcmDsdSidTabServiceId=35, DcmDsdSidTabSubfuncAvail=false
            ReadDtcInfo: DcmDsdSidTabServiceId=25, DcmDsdSidTabSubfuncAvail=true
              14 x DcmDsdSubService:
                RDTCFDC: DcmDsdSubServiceId=20
                RMRCDTC: DcmDsdSubServiceId=14
                RDTCEDRBDN: DcmDsdSubServiceId=6
                RFTFDTC: DcmDsdSubServiceId=11
                RDTCSSI: DcmDsdSubServiceId=3
                RSUPDTC: DcmDsdSubServiceId=10
                RDTCBSM: DcmDsdSubServiceId=2
                RDTCBSMR: DcmDsdSubServiceId=8
                RNODTCBSM: DcmDsdSubServiceId=1
                RDTCSSBDTC: DcmDsdSubServiceId=4
                RNODTCBSMR: DcmDsdSubServiceId=7
                RFCDTC: DcmDsdSubServiceId=12
                RMRTFDTC: DcmDsdSubServiceId=13
                RSIODTC: DcmDsdSubServiceId=9
            TesterPresent: DcmDsdSidTabServiceId=62, DcmDsdSidTabSubfuncAvail=true
              TesterPresent (DcmDsdSubService): DcmDsdSubServiceId=0
            WriteMemoryByAddress: DcmDsdSidTabServiceId=61, DcmDsdSidTabSubfuncAvail=false
            CommunicationControl: DcmDsdSidTabServiceId=40, DcmDsdSidTabSubfuncAvail=true, DcmDsdSidTabSessionLevelRef=DcmDspSession/Programming, DcmDsdSidTabSessionLevelRef=DcmDspSession/Extended
              4 x DcmDsdSubService, all with DcmDsdSubServiceSessionLevelRef=DcmDspSession/Programming, DcmDsdSubServiceSessionLevelRef=DcmDspSession/Extended:
                DisableRxAndEnableTx: DcmDsdSubServiceId=2
                EnableRxAndDisableTx: DcmDsdSubServiceId=1
                DisableRxAndTx: DcmDsdSubServiceId=3
                EnableRxAndTx: DcmDsdSubServiceId=0
            RoutineControl: DcmDsdSidTabServiceId=49, DcmDsdSidTabSubfuncAvail=true, DcmDsdSidTabSessionLevelRef=DcmDspSession/Programming, DcmDsdSidTabSessionLevelRef=DcmDspSession/Extended
            DiagSessionControl: DcmDsdSidTabServiceId=16, DcmDsdSidTabSubfuncAvail=true
              3 x DcmDsdSubService:
                Programming: DcmDsdSubServiceId=2
                Default: DcmDsdSubServiceId=1
                Extended: DcmDsdSubServiceId=3
      DcmDsl
        DcmDslBuffer: DcmDslBufferSize=50
        DcmDslDiagResp: DcmDslDiagRespMaxNumRespPend=0, DcmDslDiagRespOnSecondDeclinedRequest=false, DcmDslDiagRespMaxNumOfDeclinedRequests=3
        DcmDslProtocol
          DcmDslProtocolRow:
            DcmDslProtocolEndiannessConvEnabled = false
            DcmDslProtocolID = DCM_UDS_ON_CAN
            DcmDslProtocolPreemptTimeout = 0
            DcmDslProtocolPriority = 0
            DcmSendRespPendOnTransToBoot = true
            DcmTimStrP2ServerAdjust = 0
            DcmTimStrP2StarServerAdjust = 0
            DcmSendRespPendOnRestart = false
            DcmDslProtocolMaximumResponseSize = 4095
            DcmDslProtocolRxBufferID = DcmDslBuffer
            DcmDslProtocolSIDTable = DcmDsdServiceTable
            DcmDslProtocolTxBufferID = DcmDslBuffer
            DcmDemClientRef = DemClient
            DcmDslConnection
              DcmDslMainConnection: DcmDslProtocolRxTesterSourceAddr=0, DcmDslProtocolRxConnectionId=0
                Diagnosis_Frame_Fan_Request_PDU_4dbbe21e_Rx (DcmDslProtocolRx):
                  DcmDslProtocolRxAddrType = DCM_PHYSICAL_TYPE
                  DcmDslProtocolRxChannelId = 0
                  DcmDslProtocolRxPduId = 0
                  DcmDslProtocolRxPduRef = Diag_Request_Fan_ECU_PDU_5809d877_Rx
                  DcmDslProtocolRxComMChannelRef = Connector_Fan_ECU_fbc5880ce1a0cdea_90249745
                DcmDslProtocolTx: DcmDslTxConfirmationPduId=0, DcmDslProtocolTxPduRef=EcucPduCollection/Diag_Response_Fan_ECU_PDU_15224d29_Tx
      DcmDsp: DcmDspMaxDidToRead=5, DcmDspReadDIDReportsNODIByte=false
        DcmDspSecurity
          UnlockedL1 (DcmDspSecurityRow):
            DcmDspSecurityDelayTime = 10
            DcmDspSecurityDelayTimeOnBoot = 0
            DcmDspSecurityKeySize = 4
            DcmDspSecurityLevel = 1
            DcmDspSecurityNumAttDelay = 3
            DcmDspSecuritySeedSize = 4
            DcmDspSecurityAttemptCounterEnabled = false
            DcmDspSecurityUsePort = USE_ASYNCH_CLIENT_SERVER
        DcmDspSession
          3 x DcmDspSessionRow, all with DcmDspSessionP2ServerMax=0.05, DcmDspSessionP2StarServerMax=5, DcmDspSessionForBoot=DCM_NO_BOOT:
            Default: DcmDspSessionLevel=1
            Programming: DcmDspSessionLevel=2
            Extended: DcmDspSessionLevel=3
        DidInfo_Hardware_Version (DcmDspDidInfo)
          DcmDspDidAccess
            DcmDspDidWrite
            DcmDspDidRead
        Example_DevelopmentData_CanDriverVersion (DcmDspData):
          DcmDspDataSize = 16
          DcmDspDataType = UINT16
          DcmDspDataUsePort = USE_DATA_ASYNCH_CLIENT_SERVER
          DcmDspDataInfoRef = DataInfo_Example_DevelopmentData_CanDriverVersion
        DataInfo_SerialNumber_SerialNumber (DcmDspDataInfo): DcmDspDataFixedLength=true
        Boot_Software (DcmDspDid): DcmDspDidIdentifier=61824, DcmDspDidUsed=true, DcmDspDidUsePort=USE_DATA_ELEMENT_SPECIFIC_INTERFACES, DcmDspDidInfoRef=DidInfo_Boot_Software
          NumberOfModules (DcmDspDidSignal): DcmDspDidDataPos=0, DcmDspDidDataRef=Boot_Software_NumberOfModules
          Boot_Software_Identification (DcmDspDidSignal): DcmDspDidDataPos=8, DcmDspDidDataRef=Boot_Software_Boot_Software_Identification
        DataInfo_Example_DevelopmentData_NmVersion (DcmDspDataInfo): DcmDspDataFixedLength=true
        RoutineInfo_Example_New_Routine_Control (DcmDspRoutineInfo)
          DcmDspRoutineAuthorization: DcmDspRoutineSessionRef=DcmDspSession/Programming, DcmDspRoutineSessionRef=DcmDspSession/Extended
        Fan_Current_Power (DcmDspDid): DcmDspDidIdentifier=2, DcmDspDidUsed=true, DcmDspDidUsePort=USE_DATA_ELEMENT_SPECIFIC_INTERFACES, DcmDspDidInfoRef=DidInfo_Fan_Current_Power
          Current (DcmDspDidSignal): DcmDspDidDataPos=0, DcmDspDidDataRef=Fan_Current_Power_Current
        Spare_Part_Number (DcmDspDid): DcmDspDidIdentifier=61831, DcmDspDidUsed=true, DcmDspDidUsePort=USE_DATA_ELEMENT_SPECIFIC_INTERFACES, DcmDspDidInfoRef=DidInfo_Spare_Part_Number
          Spare_Part_Number (DcmDspDidSignal): DcmDspDidDataPos=0, DcmDspDidDataRef=Spare_Part_Number_Spare_Part_Number
        Example_DevelopmentData_OperatingSystemVersion (DcmDspData):
          DcmDspDataSize = 16
          DcmDspDataType = UINT16
          DcmDspDataUsePort = USE_DATA_ASYNCH_CLIENT_SERVER
          DcmDspDataInfoRef = DataInfo_Example_DevelopmentData_OperatingSystemVersion
        DataInfo_Fan_Current_Power_Current (DcmDspDataInfo): DcmDspDataFixedLength=true
        Vehicle_Identification (DcmDspDid):
          DcmDspDidIdentifier = 61840
          DcmDspDidUsed = true
          DcmDspDidUsePort = USE_DATA_ELEMENT_SPECIFIC_INTERFACES
          DcmDspDidInfoRef = DidInfo_Vehicle_Identification
          VIN (DcmDspDidSignal): DcmDspDidDataPos=0, DcmDspDidDataRef=Vehicle_Identification_VIN
        Vehicle_Identification_VIN (DcmDspData): DcmDspDataSize=136, DcmDspDataType=UINT8_N, DcmDspDataUsePort=USE_DATA_ASYNCH_CLIENT_SERVER, DcmDspDataInfoRef=DataInfo_Vehicle_Identification_VIN
        DataInfo_Hardware_Version_Hardware_Version_Number (DcmDspDataInfo): DcmDspDataFixedLength=true
        Hardware_Version (DcmDspDid): DcmDspDidIdentifier=61843, DcmDspDidUsed=true, DcmDspDidUsePort=USE_DATA_ELEMENT_SPECIFIC_INTERFACES, DcmDspDidInfoRef=DidInfo_Hardware_Version
          Hardware_Version_Number (DcmDspDidSignal): DcmDspDidDataPos=0, DcmDspDidDataRef=Hardware_Version_Hardware_Version_Number
        DataInfo_Spare_Part_Number_Spare_Part_Number (DcmDspDataInfo): DcmDspDataFixedLength=true
        Example_DevelopmentData (DcmDspDid):
          DcmDspDidIdentifier = 256
          DcmDspDidUsed = true
          DcmDspDidUsePort = USE_DATA_ELEMENT_SPECIFIC_INTERFACES
          DcmDspDidInfoRef = DidInfo_Example_DevelopmentData
          5 x DcmDspDidSignal:
            TransportLayerVersion: DcmDspDidDataPos=64, DcmDspDidDataRef=Example_DevelopmentData_TransportLayerVersion
            CanDriverVersion: DcmDspDidDataPos=16, DcmDspDidDataRef=Example_DevelopmentData_CanDriverVersion
            DiagnosticModuleVersion: DcmDspDidDataPos=48, DcmDspDidDataRef=Example_DevelopmentData_DiagnosticModuleVersion
            NmVersion: DcmDspDidDataPos=32, DcmDspDidDataRef=Example_DevelopmentData_NmVersion
            OperatingSystemVersion: DcmDspDidDataPos=0, DcmDspDidDataRef=Example_DevelopmentData_OperatingSystemVersion
        DataInfo_Example_DevelopmentData_CanDriverVersion (DcmDspDataInfo): DcmDspDataFixedLength=true
        EcuIdentification (DcmDspDid): DcmDspDidIdentifier=61833, DcmDspDidUsed=true, DcmDspDidUsePort=USE_DATA_ELEMENT_SPECIFIC_INTERFACES, DcmDspDidInfoRef=DidInfo_EcuIdentification
          Part_Number (DcmDspDidSignal): DcmDspDidDataPos=0, DcmDspDidDataRef=EcuIdentification_Part_Number
        SerialNumber (DcmDspDid): DcmDspDidIdentifier=61836, DcmDspDidUsed=true, DcmDspDidUsePort=USE_DATA_ELEMENT_SPECIFIC_INTERFACES, DcmDspDidInfoRef=DidInfo_SerialNumber
          SerialNumber (DcmDspDidSignal): DcmDspDidDataPos=0, DcmDspDidDataRef=SerialNumber_SerialNumber
        DataInfo_Vehicle_Identification_VIN (DcmDspDataInfo): DcmDspDataFixedLength=true
        DataInfo_Example_DevelopmentData_DiagnosticModuleVersion (DcmDspDataInfo): DcmDspDataFixedLength=true
        Example_DevelopmentData_NmVersion (DcmDspData):
          DcmDspDataSize = 16
          DcmDspDataType = UINT16
          DcmDspDataUsePort = USE_DATA_ASYNCH_CLIENT_SERVER
          DcmDspDataInfoRef = DataInfo_Example_DevelopmentData_NmVersion
        DidInfo_SerialNumber (DcmDspDidInfo)
          DcmDspDidAccess
            DcmDspDidWrite
            DcmDspDidRead
        Fan_Current_Power_Current (DcmDspData): DcmDspDataSize=8, DcmDspDataType=UINT8, DcmDspDataUsePort=USE_DATA_ASYNCH_CLIENT_SERVER, DcmDspDataInfoRef=DataInfo_Fan_Current_Power_Current
        DidInfo_Fan_Current_Power (DcmDspDidInfo)
          DcmDspDidAccess
            DcmDspDidRead
        DataInfo_EcuIdentification_Part_Number (DcmDspDataInfo): DcmDspDataFixedLength=true
        EcuIdentification_Part_Number (DcmDspData):
          DcmDspDataSize = 104
          DcmDspDataType = UINT8_N
          DcmDspDataUsePort = USE_DATA_ASYNCH_CLIENT_SERVER
          DcmDspDataInfoRef = DataInfo_EcuIdentification_Part_Number
        Spare_Part_Number_Spare_Part_Number (DcmDspData):
          DcmDspDataSize = 32
          DcmDspDataType = UINT32
          DcmDspDataUsePort = USE_DATA_ASYNCH_CLIENT_SERVER
          DcmDspDataInfoRef = DataInfo_Spare_Part_Number_Spare_Part_Number
        DidInfo_Spare_Part_Number (DcmDspDidInfo)
          DcmDspDidAccess
            DcmDspDidWrite
            DcmDspDidRead
        Example_New_Routine_Control (DcmDspRoutine):
          DcmDspRequestResultsRoutineSupported = false
          DcmDspStopRoutineSupported = false
          DcmDspRoutineIdentifier = 256
          DcmDspRoutineFixedLength = false
          DcmDspRoutineUsePort = true
          DcmDspRoutineUsed = true
          DcmDspRoutineInfoRef = RoutineInfo_Example_New_Routine_Control
        DataInfo_Boot_Software_Boot_Software_Identification (DcmDspDataInfo): DcmDspDataFixedLength=true
        DidInfo_Boot_Software (DcmDspDidInfo)
          DcmDspDidAccess
            DcmDspDidWrite
            DcmDspDidRead
        SerialNumber_SerialNumber (DcmDspData): DcmDspDataSize=32, DcmDspDataType=UINT32, DcmDspDataUsePort=USE_DATA_ASYNCH_CLIENT_SERVER, DcmDspDataInfoRef=DataInfo_SerialNumber_SerialNumber
        DataInfo_Example_DevelopmentData_OperatingSystemVersion (DcmDspDataInfo): DcmDspDataFixedLength=true
        DidInfo_Example_DevelopmentData (DcmDspDidInfo)
          DcmDspDidAccess
            DcmDspDidWrite
            DcmDspDidRead
        DataInfo_Example_DevelopmentData_TransportLayerVersion (DcmDspDataInfo): DcmDspDataFixedLength=true
        DataInfo_Boot_Software_NumberOfModules (DcmDspDataInfo): DcmDspDataFixedLength=true
        DcmDspAuthentication: DcmDspAuthenticationRoleSize=1, DcmDspAuthenticationSetDeauthenticatedRoleApi=false, DcmDspAuthenticationDeauthenticatedRoleRef=Anybody
          6 x DcmDspAuthenticationRow:
            AfterSales: DcmDspAuthenticationRoleBitPosition=4
            Anybody: DcmDspAuthenticationRoleBitPosition=0
            Manufacturing: DcmDspAuthenticationRoleBitPosition=3
            ePTI: DcmDspAuthenticationRoleBitPosition=5
            Supplier: DcmDspAuthenticationRoleBitPosition=1
            Development: DcmDspAuthenticationRoleBitPosition=2
        Example_DevelopmentData_DiagnosticModuleVersion (DcmDspData):
          DcmDspDataSize = 16
          DcmDspDataType = UINT16
          DcmDspDataUsePort = USE_DATA_ASYNCH_CLIENT_SERVER
          DcmDspDataInfoRef = DataInfo_Example_DevelopmentData_DiagnosticModuleVersion
        ComControl (DcmDspComControl)
          DspComContolAllChannel (DcmDspComControlAllChannel): DcmDspAllComMChannelRef=Connector_Fan_ECU_fbc5880ce1a0cdea_90249745
        Boot_Software_Boot_Software_Identification (DcmDspData):
          DcmDspDataSize = 32
          DcmDspDataType = UINT32
          DcmDspDataUsePort = USE_DATA_ASYNCH_CLIENT_SERVER
          DcmDspDataInfoRef = DataInfo_Boot_Software_Boot_Software_Identification
        DidInfo_Vehicle_Identification (DcmDspDidInfo)
          DcmDspDidAccess
            DcmDspDidWrite
            DcmDspDidRead
        Hardware_Version_Hardware_Version_Number (DcmDspData):
          DcmDspDataSize = 32
          DcmDspDataType = UINT32
          DcmDspDataUsePort = USE_DATA_ASYNCH_CLIENT_SERVER
          DcmDspDataInfoRef = DataInfo_Hardware_Version_Hardware_Version_Number
        DidInfo_EcuIdentification (DcmDspDidInfo)
          DcmDspDidAccess
            DcmDspDidWrite
            DcmDspDidRead
        Boot_Software_NumberOfModules (DcmDspData): DcmDspDataSize=8, DcmDspDataType=UINT8, DcmDspDataUsePort=USE_DATA_ASYNCH_CLIENT_SERVER, DcmDspDataInfoRef=DataInfo_Boot_Software_NumberOfModules
        Example_DevelopmentData_TransportLayerVersion (DcmDspData):
          DcmDspDataSize = 16
          DcmDspDataType = UINT16
          DcmDspDataUsePort = USE_DATA_ASYNCH_CLIENT_SERVER
          DcmDspDataInfoRef = DataInfo_Example_DevelopmentData_TransportLayerVersion
        DcmDspMemory: DcmDspUseMemoryId=false
          DcmDspMemoryIdInfo
            DcmDspReadMemoryRangeInfo: DcmDspReadMemoryRangeHigh=4294967294, DcmDspReadMemoryRangeLow=0
            DcmDspWriteMemoryRangeInfo: DcmDspWriteMemoryRangeHigh=4294967294, DcmDspWriteMemoryRangeLow=0
      DcmPageBufferCfg: DcmPagedBufferEnabled=true
  module config Dem: implementation-config-variant=VARIANT-PRE-COMPILE, module-description=Dem_Impl
    DemGeneral:
      DemAgingCycleCounterProcessing = DEM_PROCESS_AGINGCTR_INTERN
      DemDebounceCounterBasedSupport = true
      DemDebounceTimeBasedSupport = true
      DemPTOSupport = false
      DemDtcStatusAvailabilityMask = 255
      DemGeneralInterfaceSupport = false
      DemDataElementDefaultEndianness = LITTLE_ENDIAN
      DemAgingRequieresTestedCycle = false
      DemMaxNumberEventEntryMirror = 0
      DemTriggerMonitorInitBeforeClearOk = true
      DemExtendedDataCapture = DEM_TRIGGER_EVENT_MEMORY_STORAGE
      DemFreezeFrameCapture = DEM_TRIGGER_EVENT_MEMORY_STORAGE
      DemOperationCycleProcessing = DEM_PROCESS_OPCYC_STATE
      DemAvailabilitySupport = DEM_NO_AVAILABILITY
      DemAvailabilityStorage = false
      DemBswErrorBufferSize = 0
      DemClearDTCBehavior = DEM_CLRRESP_VOLATILE
      DemClearDTCLimitation = DEM_ALL_SUPPORTED_DTCS
      DemDevErrorDetect = true
      DemEnableConditionSupport = false
      DemEventCombinationSupport = DEM_EVCOMB_DISABLED
      DemEventDisplacementStrategy = DEM_DISPLACEMENT_LEGACY_403
      DemMaxNumberEventEntryOBDFreezeFrame = 0
      DemMaxNumberEventEntryPermanent = 0
      DemMaxNumberPrestoredFF = 0
      DemMaxNumberTimeSeriesSnapshots = 0
      DemOBDSupport = DEM_OBD_NO_OBD_SUPPORT
      DemOccurrenceCounterProcessing = DEM_PROCESS_OCCCTR_TF
      DemOperationCycleStatusStorage = false
      DemResetConfirmedBitOnOverflow = true
      DemStatusBitHandlingTestFailedSinceLastClear = DEM_STATUS_BIT_NORMAL
      DemStatusBitStorageTestFailed = true
      DemStorageConditionSupport = false
      DemSuppressionSupport = DEM_NO_SUPPRESSION
      DemTaskTime = 0.01
      DemTriggerDcmReports = false
      DemTriggerDltReports = false
      DemTriggerFiMReports = false
      DemTriggerFiMReportsExtended = false
      DemTriggerMonitorInitForEnableConditions = false
      DemTypeOfDTCSupported = DEM_DTC_TRANSLATION_ISO14229_1
      DemVersionInfoApi = false
      DemBswApiVersion = DEM_BSW_API_4_XX_XX
      DemBswApiVersionNvM = DEM_BSW_API_4_XX_XX
      DemBswApiVersionFiM = DEM_BSW_API_4_XX_XX
      DemAgingAfterHealing = DEM_AGING_WHILE_HEALING
      DemAgingBehavior = DEM_AGING_TYPE_1
      DemAgingCounterBehavior = DEM_AGING_COUNT_ALWAYS
      DemAgingCounterReporting = DEM_AGING_NORMAL_REPORTING
      DemAgingRetainEnvironmentalData = false
      DemCompiledPostbuildCrc = 768933375
      DemCompiledPostbuildCrcMode = DEM_POSTBUILD_CRC_AUTOMATIC
      DemEventDisplacementFallbackStrategy = DEM_FALLBACK_DISCARD_NEW_EVENT
      DemGeneralDiagnosticInfoSupport = true
      DemJ1939Support = false
      DemNvSynchronizeSupport = false
      DemPendingDtcProcessing = DEM_PROCESS_PDTC_STOREDONLY
      DemResetDebounceBehavior = DEM_RESET_DEBOUNCE_ON_DISABLE_ENABLE_CONDITIONS
      DemResetTestFailedOnOperationCycleStart = false
      DemRetryStorageSupport = false
      DemSafeBswChecks = true
      DemUseMemcopyMacros = false
      DemUseRte = true
      DemUserControlledWirBehavior = DEM_ENABLED_DURING_CONTROLDTCSETTING
      DemUserDefinedCompareAndSwap = false
      DemWarningIndicatorRequestedProcessing = DEM_PROCESS_WIR_STOREDONLY
      DemUseMultiPartitionFiM = false
      DemReportSuppressedDTCsInService19x0A = false
      DemSupportAgingForAllDTCs = false
      DemLatchTestFailedBehavior = DEM_LATCH_TF_ONLY_THIS_CYCLE
      DemSupportService19x04DIDLength = false
      DemUseNvm = true
      DemClient: DemClientId=0
      DemEventMemorySet
        PrimaryMemory (DemPrimaryMemory):
          DemTypeOfFreezeFrameRecordNumeration = DEM_FF_RECNUM_CALCULATED
          DemMaxNumberEventEntryPrimary = 8
          DemEventMemoryEntryStorageTrigger = DEM_STORAGE_ON_TEST_FAILED
      DemPostbuild:
        DemEventAvailableDefaultSupport = true
        DemMaxSizeFreezeFrame = 1
        DemMaxNumberDtr = 0
        DemMaxSizeGlobalFreezeFrame = 0
        DemMaxSizeOBDonUDSFreezeFrame = 0
        DemMaxNumberEventsWithMonitorActivityData = 0
      OccurrenceCounter (DemExtendedDataRecordClass): DemExtendedDataRecordNumber=1, DemExtendedDataRecordUpdate=DEM_UPDATE_RECORD_NO, DemDataClassRef=OccurrenceCounter_OccurrenceCounter
      ExtendedDataClass_4f5344cd (DemExtendedDataClass): DemExtendedDataRecordClassRef=OccurrenceCounter, DemExtendedDataRecordClassRef=DTCAgingCounter
      FreezeFrameRecNumClass_f98c8aa7 (DemFreezeFrameRecNumClass): DemFreezeFrameRecordClassRef=First_Occurrence, DemFreezeFrameRecordClassRef=Last_Occurrence
      OBD_driving_cycle (DemOperationCycle): DemOperationCycleAutostart=true, DemOperationCycleType=DEM_OPCYC_OBD_DCY, DemOperationCycleAutomaticEnd=false
      First_Occurrence (DemFreezeFrameRecordClass): DemFreezeFrameRecordNumber=1, DemFreezeFrameRecordTrigger=DEM_TRIGGER_ON_TEST_FAILED, DemFreezeFrameRecordUpdate=DEM_UPDATE_RECORD_NO
      DTCAgingCounter (DemExtendedDataRecordClass):
        DemExtendedDataRecordNumber = 2
        DemExtendedDataRecordUpdate = DEM_UPDATE_RECORD_NO
        DemDataClassRef = DTCAgingCounter_Driving_Cycles_Since_Last_Failed
      FreezeFrameClass_e46843e0 (DemFreezeFrameClass): DemDidClassRef=DemGeneral/Fan_Current_Power
      OccurrenceCounter_OccurrenceCounter (DemDataClass): DemDataElementDataSize=1, DemDataElementInternalData=DEM_OCCCTR, DemDataElementUsePort=USE_DATA_INTERNAL, DemDataElementStoreNonVolatile=true
      DTCAgingCounter_Driving_Cycles_Since_Last_Failed (DemDataClass):
        DemDataElementDataSize = 1
        DemDataElementInternalData = DEM_CYCLES_SINCE_LAST_FAILED
        DemDataElementUsePort = USE_DATA_INTERNAL
        DemDataElementStoreNonVolatile = true
      DemGeneralOBD:
        DemOBDCentralizedPID21Handling = false
        DemOBDCentralizedPID31Handling = false
        DemOBDDestinationOfEvents = DEM_DTC_ORIGIN_PRIMARY_MEMORY
        DemOBDEventDisplacement = true
        DemOBDCompliancy = 1
        DemDelayWarmUpCycleToDcyEnd = false
        DemOBDFreezeFrameInService19 = false
        DemOBDHideOccurrences = false
        DemOBDLegislation = DEM_OBD_LEGISLATION_OBDII
        DemOBDPermanentEraseConditionDcy = false
        DemOBDPermanentMandatoryPfcAfterClear = false
        DemOBDRestartDcyOnClearDTC = false
        DemClearPermanentDtcBehavior = DEM_CLR_PERM_DTC_TYPE_1
        DemOBDSimilarConditionsSupport = false
        DemOBDPID41ComprehensiveComponentsAlwaysComplete = false
        DemOBDSupportMajorMonitors = false
        DemReportBlinkingMilAsActive = true
        DemOBDPermanentChronologyMaxNumberEvents = 1
        DemOBDFuelSystemAlwaysComplete = false
        DemOBDCompressionMisfireAlwaysComplete = false
      Fan_Current_Power (DemDidClass): DemDidIdentifier=2, DemDidDataClassRef=DID_0x2_Current
      Last_Occurrence (DemFreezeFrameRecordClass): DemFreezeFrameRecordNumber=2, DemFreezeFrameRecordTrigger=DEM_TRIGGER_ON_TEST_FAILED, DemFreezeFrameRecordUpdate=DEM_UPDATE_RECORD_NO
      DID_0x2_Current (DemDataClass): DemDataElementDataSize=1, DemDataElementDataType=UINT8, DemDataElementUsePort=USE_DATA_CLIENT_SERVER_PORT, DemDataElementStoreNonVolatile=true
      10 x DemNvRamBlockId:
        Dem_AdminData: DemNvRamBlockIdType=DEM_NVBLOCK_ADMIN, DemNvRamBlockIdRef=DemAdminDataBlock
        Dem_StatusData: DemNvRamBlockIdType=DEM_NVBLOCK_STATUS, DemNvRamBlockIdRef=DemStatusDataBlock
        Dem_PrimaryEntry{0..7}: DemNvRamBlockIdType=DEM_NVBLOCK_PRIMARY, DemNvRamBlockIdIndex={0..7}, DemNvRamBlockIdRef=DemPrimaryDataBlock{0..7}
    DemConfigSet
      DTCClass_DTC_0x000016 (DemDTCClass): DemDTCSeverity=DEM_DTC_SEV_NO_SEVERITY, DemUdsDTC=24, DemImmediateNvStorage=false, DemDTCAttributesRef=DtcAttributes_41914fb7
      Mechanical_Fault_Unexpected_High_Current (DemEventParameter):
        DemEventKind = DEM_EVENT_KIND_SWC
        DemEventLatchTestFailed = true
        DemEventAvailable = true
        DemEventId = 3
        DemEventAvailableInVariant = true
        DemEventCreateInfoPort = true
        DemMaxNumberFreezeFrameRecords = 10
        DemDTCClassRef = DTCClass_DTC_0x000017
        DemExtendedDataClassRef = ExtendedDataClass_4f5344cd
        DemFreezeFrameClassRef = FreezeFrameClass_e46843e0
        DemFreezeFrameRecNumClassRef = FreezeFrameRecNumClass_f98c8aa7
        DemEventClass:
          DemAgingAllowed = true
          DemAgingCycleCounterThreshold = 3
          DemEventPriority = 2
          DemEventSignificance = DEM_EVENT_SIGNIFICANCE_FAULT
          DemEventFailureCycleCounterThreshold = 3
          DemFFPrestorageSupported = false
          DemConsiderPtoStatus = false
          DemAgingCycleRef = OBD_driving_cycle
          DemOperationCycleRef = OBD_driving_cycle
          DemDebounceAlgorithmClass
            DemDebounceMonitorInternal
              DemCallbackGetFDC
      DTCClass_DTC_0x000017 (DemDTCClass): DemDTCSeverity=DEM_DTC_SEV_NO_SEVERITY, DemUdsDTC=25, DemImmediateNvStorage=false, DemDTCAttributesRef=DtcAttributes_41914fb7
      DtcAttributes_41914fb7 (DemDTCAttributes): DemMemoryDestinationRef=PrimaryMemory
      Electrical_Fault_Fan_Motor_Control_Circuit_Short (DemEventParameter):
        DemEventKind = DEM_EVENT_KIND_SWC
        DemEventLatchTestFailed = true
        DemEventAvailable = true
        DemEventId = 2
        DemEventAvailableInVariant = true
        DemEventCreateInfoPort = true
        DemMaxNumberFreezeFrameRecords = 10
        DemDTCClassRef = DTCClass_DTC_0x000012
        DemExtendedDataClassRef = ExtendedDataClass_4f5344cd
        DemFreezeFrameClassRef = FreezeFrameClass_e46843e0
        DemFreezeFrameRecNumClassRef = FreezeFrameRecNumClass_f98c8aa7
        DemEventClass:
          DemAgingAllowed = true
          DemAgingCycleCounterThreshold = 0
          DemEventPriority = 2
          DemEventSignificance = DEM_EVENT_SIGNIFICANCE_FAULT
          DemEventFailureCycleCounterThreshold = 0
          DemFFPrestorageSupported = false
          DemConsiderPtoStatus = false
          DemAgingCycleRef = OBD_driving_cycle
          DemOperationCycleRef = OBD_driving_cycle
          DemDebounceAlgorithmClass
            DemDebounceTimeBase: DemDebounceTimeFailedThreshold=5, DemDebounceTimePassedThreshold=11, DemDebounceBehavior=DEM_DEBOUNCE_FREEZE, DemDebounceContinuous=false
      Mechanical_Fault_Unexpected_Low_Current (DemEventParameter):
        DemEventKind = DEM_EVENT_KIND_SWC
        DemEventLatchTestFailed = true
        DemEventAvailable = true
        DemEventId = 4
        DemEventAvailableInVariant = true
        DemEventCreateInfoPort = true
        DemMaxNumberFreezeFrameRecords = 10
        DemDTCClassRef = DTCClass_DTC_0x000016
        DemExtendedDataClassRef = ExtendedDataClass_4f5344cd
        DemFreezeFrameClassRef = FreezeFrameClass_e46843e0
        DemFreezeFrameRecNumClassRef = FreezeFrameRecNumClass_f98c8aa7
        DemEventClass:
          DemAgingAllowed = true
          DemAgingCycleCounterThreshold = 3
          DemEventPriority = 2
          DemEventSignificance = DEM_EVENT_SIGNIFICANCE_FAULT
          DemEventFailureCycleCounterThreshold = 3
          DemFFPrestorageSupported = false
          DemConsiderPtoStatus = false
          DemAgingCycleRef = OBD_driving_cycle
          DemOperationCycleRef = OBD_driving_cycle
          DemDebounceAlgorithmClass
            DemDebounceMonitorInternal
              DemCallbackGetFDC
      DTCClass_DTC_0x000012 (DemDTCClass): DemDTCSeverity=DEM_DTC_SEV_NO_SEVERITY, DemUdsDTC=17, DemImmediateNvStorage=false, DemDTCAttributesRef=DtcAttributes_41914fb7
      Electrical_Fault_Fan_Motor_Control_Circuit_Open (DemEventParameter):
        DemEventKind = DEM_EVENT_KIND_SWC
        DemEventLatchTestFailed = true
        DemEventAvailable = true
        DemEventId = 1
        DemEventAvailableInVariant = true
        DemEventCreateInfoPort = true
        DemMaxNumberFreezeFrameRecords = 10
        DemDTCClassRef = DTCClass_DTC_0x000013
        DemExtendedDataClassRef = ExtendedDataClass_4f5344cd
        DemFreezeFrameClassRef = FreezeFrameClass_e46843e0
        DemFreezeFrameRecNumClassRef = FreezeFrameRecNumClass_f98c8aa7
        DemEventClass:
          DemAgingAllowed = true
          DemAgingCycleCounterThreshold = 0
          DemEventPriority = 2
          DemEventSignificance = DEM_EVENT_SIGNIFICANCE_FAULT
          DemEventFailureCycleCounterThreshold = 0
          DemFFPrestorageSupported = false
          DemConsiderPtoStatus = false
          DemAgingCycleRef = OBD_driving_cycle
          DemOperationCycleRef = OBD_driving_cycle
          DemDebounceAlgorithmClass
            DemDebounceTimeBase: DemDebounceTimeFailedThreshold=5, DemDebounceTimePassedThreshold=11, DemDebounceBehavior=DEM_DEBOUNCE_FREEZE, DemDebounceContinuous=false
      DTCClass_DTC_0x000013 (DemDTCClass): DemDTCSeverity=DEM_DTC_SEV_NO_SEVERITY, DemUdsDTC=19, DemImmediateNvStorage=false, DemDTCAttributesRef=DtcAttributes_41914fb7
  module config NvM: implementation-config-variant=VARIANT-PRE-COMPILE, module-description=NvM_Impl
    NvMCommon:
      NvMSafeBswChecks = true
      NvMApiConfigClass = NVM_API_CONFIG_CLASS_3
      NvMBswMMultiBlockJobStatusInformation = true
      NvMCompiledConfigId = 1
      NvMCrcNumOfBytes = 64
      NvMDatasetSelectionBits = 4
      NvMDevErrorDetect = true
      NvMDrvModeSwitch = true
      NvMDynamicConfiguration = false
      NvMJobPrioritization = false
      NvMPollingMode = true
      NvMSetRamBlockStatusApi = true
      NvMSizeStandardJobQueue = 8
      NvMVersionInfoApi = false
      NvMMaxNoOfWriteRetries = 1
      NvMMainFunctionPeriod = 0.01
      NvMUseBlockIdCheck = false
      NvMRepairRedundantBlocksApi = false
      NvMDetectedLossOfRedundancyCallback = NULL_PTR
    NvMConfigBlock (NvMBlockDescriptor):
      NvMBlockCrcType = NVM_CRC16
      NvMSelectBlockForWriteAll = true
      NvMBlockUseCrc = true
      NvMNvramBlockIdentifier = 1
      NvMBlockManagementType = NVM_BLOCK_REDUNDANT
      NvMNvBlockNum = 2
      NvMNvBlockLength = 2
      NvMSelectBlockForReadAll = true
      NvMResistantToChangedSw = true
      NvMUseInitCallback = false
      NvMCalcRamBlockCrc = false
      NvMRomBlockDataAddress = NULL_PTR
      NvMBlockPostReadTransformCallback = NULL_PTR
      NvMBlockPreWriteTransformCallback = NULL_PTR
      NvMBlockUseSetRamBlockStatus = true
      NvMBlockJobPriority = 127
      NvMBlockUseSyncMechanism = false
      NvMBlockWriteProt = false
      NvMBswMBlockStatusInformation = false
      NvMWriteBlockOnce = false
      NvMUseServicePorts = false
      NvMUseJobendCallback = false
      NvMBlockUseCRCCompMechanism = false
      NvMInvokeCallbacksForReadAll = true
      NvMInvokeCallbacksForWriteAll = true
      NvMCheckLossOfRedundancy = false
      NvMTargetBlockReference
        NvMFeeRef: NvMNameOfFeeBlock=FeeBlockConfiguration
    NvMCommonVendorParams: NvMDataIntegrityIntBuffer=true, NvMKillWriteAllApi=true, NvMPreReadAllApi=false, NvMJobForwardingToMemoryCore=false, NvMCfgCbkIncludeList=Dem_Cbk.h
    11 x NvMBlockDescriptor, all with NvMBlockCrcType=NVM_CRC16, NvMSelectBlockForWriteAll=true, NvMBlockJobPriority=127, NvMBlockManagementType=NVM_BLOCK_NATIVE, NvMBlockUseSyncMechanism=false, NvMBlockWriteProt=false, NvMBswMBlockStatusInformation=false, NvMNvBlockNum=1, NvMWriteBlockOnce=false, NvMUseServicePorts=false, NvMBlockUseCRCCompMechanism=false, NvMBlockUseSetRamBlockStatus=true, NvMInvokeCallbacksForReadAll=true, NvMInvokeCallbacksForWriteAll=true, NvMCheckLossOfRedundancy=false, NvMSelectBlockForReadAll=true:
      DemAdminDataBlock: NvMBlockUseCrc=true, NvMNvBlockLength=12, NvMNvramBlockIdentifier=2, NvMResistantToChangedSw=true, NvMUseJobendCallback=true, NvMUseInitCallback=true, NvMRamBlockDataAddress=Dem_Cfg_AdminData, NvMRomBlockDataAddress=NULL_PTR, NvMInitBlockCallback=Dem_NvM_InitAdminData, NvMSingleBlockCallback=Dem_NvM_JobFinished
        NvMTargetBlockReference
          NvMFeeRef: NvMNameOfFeeBlock=FeeDemAdminDataBlock
      DemStatusDataBlock: NvMBlockUseCrc=true, NvMNvBlockLength=1, NvMNvramBlockIdentifier=3, NvMResistantToChangedSw=true, NvMUseJobendCallback=true, NvMUseInitCallback=true, NvMRamBlockDataAddress=Dem_Cfg_StatusData, NvMRomBlockDataAddress=NULL_PTR, NvMInitBlockCallback=Dem_NvM_InitStatusData, NvMSingleBlockCallback=Dem_NvM_JobFinished
        NvMTargetBlockReference
          NvMFeeRef: NvMNameOfFeeBlock=FeeDemStatusDataBlock
      DemPrimaryDataBlock0: NvMBlockUseCrc=true, NvMNvBlockLength=1, NvMNvramBlockIdentifier=4, NvMResistantToChangedSw=true, NvMUseJobendCallback=true, NvMUseInitCallback=false, NvMRamBlockDataAddress=Dem_Cfg_PrimaryEntry_0, NvMRomBlockDataAddress=Dem_Cfg_MemoryEntryInit, NvMInitBlockCallback=NULL_PTR, NvMSingleBlockCallback=Dem_NvM_JobFinished
        NvMTargetBlockReference
          NvMFeeRef: NvMNameOfFeeBlock=FeeDemPrimaryDataBlock0
      DemPrimaryDataBlock1: NvMBlockUseCrc=true, NvMNvBlockLength=1, NvMNvramBlockIdentifier=5, NvMResistantToChangedSw=true, NvMUseJobendCallback=true, NvMUseInitCallback=false, NvMRamBlockDataAddress=Dem_Cfg_PrimaryEntry_1, NvMRomBlockDataAddress=Dem_Cfg_MemoryEntryInit, NvMInitBlockCallback=NULL_PTR, NvMSingleBlockCallback=Dem_NvM_JobFinished
        NvMTargetBlockReference
          NvMFeeRef: NvMNameOfFeeBlock=FeeDemPrimaryDataBlock1
      DemPrimaryDataBlock2: NvMBlockUseCrc=true, NvMNvBlockLength=1, NvMNvramBlockIdentifier=6, NvMResistantToChangedSw=true, NvMUseJobendCallback=true, NvMUseInitCallback=false, NvMRamBlockDataAddress=Dem_Cfg_PrimaryEntry_2, NvMRomBlockDataAddress=Dem_Cfg_MemoryEntryInit, NvMInitBlockCallback=NULL_PTR, NvMSingleBlockCallback=Dem_NvM_JobFinished
        NvMTargetBlockReference
          NvMFeeRef: NvMNameOfFeeBlock=FeeDemPrimaryDataBlock2
      DemPrimaryDataBlock3: NvMBlockUseCrc=true, NvMNvBlockLength=1, NvMNvramBlockIdentifier=7, NvMResistantToChangedSw=true, NvMUseJobendCallback=true, NvMUseInitCallback=false, NvMRamBlockDataAddress=Dem_Cfg_PrimaryEntry_3, NvMRomBlockDataAddress=Dem_Cfg_MemoryEntryInit, NvMInitBlockCallback=NULL_PTR, NvMSingleBlockCallback=Dem_NvM_JobFinished
        NvMTargetBlockReference
          NvMFeeRef: NvMNameOfFeeBlock=FeeDemPrimaryDataBlock3
      DemPrimaryDataBlock4: NvMBlockUseCrc=true, NvMNvBlockLength=1, NvMNvramBlockIdentifier=8, NvMResistantToChangedSw=true, NvMUseJobendCallback=true, NvMUseInitCallback=false, NvMRamBlockDataAddress=Dem_Cfg_PrimaryEntry_4, NvMRomBlockDataAddress=Dem_Cfg_MemoryEntryInit, NvMInitBlockCallback=NULL_PTR, NvMSingleBlockCallback=Dem_NvM_JobFinished
        NvMTargetBlockReference
          NvMFeeRef: NvMNameOfFeeBlock=FeeDemPrimaryDataBlock4
      DemPrimaryDataBlock5: NvMBlockUseCrc=true, NvMNvBlockLength=1, NvMNvramBlockIdentifier=9, NvMResistantToChangedSw=true, NvMUseJobendCallback=true, NvMUseInitCallback=false, NvMRamBlockDataAddress=Dem_Cfg_PrimaryEntry_5, NvMRomBlockDataAddress=Dem_Cfg_MemoryEntryInit, NvMInitBlockCallback=NULL_PTR, NvMSingleBlockCallback=Dem_NvM_JobFinished
        NvMTargetBlockReference
          NvMFeeRef: NvMNameOfFeeBlock=FeeDemPrimaryDataBlock5
      DemPrimaryDataBlock6: NvMBlockUseCrc=true, NvMNvBlockLength=1, NvMNvramBlockIdentifier=10, NvMResistantToChangedSw=true, NvMUseJobendCallback=true, NvMUseInitCallback=false, NvMRamBlockDataAddress=Dem_Cfg_PrimaryEntry_6, NvMRomBlockDataAddress=Dem_Cfg_MemoryEntryInit, NvMInitBlockCallback=NULL_PTR, NvMSingleBlockCallback=Dem_NvM_JobFinished
        NvMTargetBlockReference
          NvMFeeRef: NvMNameOfFeeBlock=FeeDemPrimaryDataBlock6
      DemPrimaryDataBlock7: NvMBlockUseCrc=true, NvMNvBlockLength=1, NvMNvramBlockIdentifier=11, NvMResistantToChangedSw=true, NvMUseJobendCallback=true, NvMUseInitCallback=false, NvMRamBlockDataAddress=Dem_Cfg_PrimaryEntry_7, NvMRomBlockDataAddress=Dem_Cfg_MemoryEntryInit, NvMInitBlockCallback=NULL_PTR, NvMSingleBlockCallback=Dem_NvM_JobFinished
        NvMTargetBlockReference
          NvMFeeRef: NvMNameOfFeeBlock=FeeDemPrimaryDataBlock7
      CpApControllerSnNvMPimFanCurrentDid: NvMBlockUseCrc=false, NvMNvBlockLength=1, NvMNvramBlockIdentifier=12, NvMResistantToChangedSw=false, NvMUseJobendCallback=false, NvMUseInitCallback=false, NvMRamBlockDataAddress=Rte_CpApController_PimFanCurrentDid, NvMRomBlockDataAddress=NULL_PTR  # UC:Derived from NvBlockNeeds
        NvMTargetBlockReference
          NvMFeeRef: NvMNameOfFeeBlock=FeeCpApControllerSnNvMPimFanCurrentDid
  module config Fee: implementation-config-variant=VARIANT-PRE-COMPILE, module-description=Fee_Impl
    FeeSpecificFeatures:
      FeeApplErrorCallbackFunction = Appl_FeeCriticalErrorCallback
      FeeApplErrorCallbackIncludeFile = ApplMain.h
      FeeGetEraseCycleApi = false
      FeeGetWriteCycleApi = false
      FeeUseApplErrorCallback = false
      FeeUseJobCache = false
      FeeForceSectorSwitchApi = false
      FeeDataConversionApi = false
      FeeFblConfig = false
      FeeMaxLinkTableSize = 4095
      FeeFssControlApi = false
      FeeExtendedSectorHeaderCheck = true
      FeeUseReliableEraseProcedure = true
    FeeBlockConfiguration:
      FeeBlockNumber = 208
      FeeBlockSize = 4
      FeeImmediateData = false
      FeeNumberOfWriteCycles = 10000
      FeeNumberOfChunkInstances = 1
      FeeNumberOfDatasets = 2
      FeeBlockIdFixed = false
      FeeBlockId = 0
      FeeBlockIsCritical = false
      FeeIsLookupTableBlock = false
      FeePartition = FeePartitionConfiguration
    FeeGeneral:
      FeeDevErrorDetect = true
      FeeIndex = 0
      FeeNvmJobEndNotification = NvM_JobEndNotification
      FeeNvmJobErrorNotification = NvM_JobErrorNotification
      FeePollingMode = true
      FeeVersionInfoApi = false
      FeeInternalBufferSize = 64
      FeeMainFunctionPeriod = 0.005
      FeeMainFunctionTriggering = FixedCycleTime
      FeeSafeBswChecks = false
      FeeDevErrorChecks: FeeDetErrorhook=Det_ReportError, FeeDetIncludeFile=Det.h
    FeePublishedInformation: FeeBlockOverhead=2, FeeMaximumBlockingTime=1, FeePageOverhead=0, FeeChunkHeader=16, FeeChunkLink=8, FeeSectorHeader=8
    FeePartitionConfiguration:
      FeeBssThresholdReserved = 2048
      FeeFssThresholdReserved = 1024
      FeeLowerSectorAddress = 0
      FeeLowerSectorSize = 16384
      FeeUpperSectorAddress = 16384
      FeeUpperSectorSize = 16384
      FeeAddressAlignment = 16
      FeeWriteAlignment = 8
      FeePartitionDevice = Fls/FlsConfigSet
    12 x FeeBlockConfiguration, all with FeeImmediateData=false, FeeNumberOfWriteCycles=10000, FeeNumberOfChunkInstances=1, FeeNumberOfDatasets=1, FeeBlockIdFixed=false, FeeBlockIsCritical=false, FeeIsLookupTableBlock=false, FeePartition=FeePartitionConfiguration, FeeDeviceIndex=Fls/FlsGeneral:
      FeeDemAdminDataBlock: FeeBlockNumber=192, FeeBlockSize=14, FeeBlockId=1
      FeeDemPrimaryDataBlock0: FeeBlockNumber=176, FeeBlockSize=3, FeeBlockId=2
      FeeDemPrimaryDataBlock1: FeeBlockNumber=160, FeeBlockSize=3, FeeBlockId=3
      FeeDemPrimaryDataBlock2: FeeBlockNumber=144, FeeBlockSize=3, FeeBlockId=4
      FeeDemPrimaryDataBlock3: FeeBlockNumber=128, FeeBlockSize=3, FeeBlockId=5
      FeeDemPrimaryDataBlock4: FeeBlockNumber=112, FeeBlockSize=3, FeeBlockId=6
      FeeDemPrimaryDataBlock5: FeeBlockNumber=96, FeeBlockSize=3, FeeBlockId=7
      FeeDemPrimaryDataBlock6: FeeBlockNumber=80, FeeBlockSize=3, FeeBlockId=8
      FeeDemPrimaryDataBlock7: FeeBlockNumber=64, FeeBlockSize=3, FeeBlockId=9
      FeeDemStatusDataBlock: FeeBlockNumber=48, FeeBlockSize=3, FeeBlockId=10
      FeeDemDebounceDataBlock: FeeBlockNumber=32, FeeBlockSize=3, FeeBlockId=11
      FeeCpApControllerSnNvMPimFanCurrentDid: FeeBlockNumber=16, FeeBlockSize=1, FeeBlockId=12
  module config Fls: implementation-config-variant=VARIANT-PRE-COMPILE, module-description=Fls_Impl
    FlsGeneral:
      FlsSafeBswChecks = true
      FlsBaseAddress = 0
      FlsCancelApi = true
      FlsCompareApi = false
      FlsDevErrorDetect = false
      FlsDriverIndex = 0
      FlsGetJobResultApi = true
      FlsGetStatusApi = true
      FlsSetModeApi = false
      FlsTotalSize = 131072
      FlsVersionInfoApi = false
    FlsConfigSet: FlsCallCycle=0.01, FlsDefaultMode=MEMIF_MODE_SLOW, FlsMaxReadFastMode=16, FlsMaxReadNormalMode=8, FlsMaxWriteFastMode=16, FlsMaxWriteNormalMode=8
      FlsSectorList
        FlsSector: FlsNumberOfSectors=16, FlsPageSize=8, FlsSectorSize=8192, FlsSectorStartaddress=0
    FlsPublishedInformation: FlsErasedValue=255
  module config VTTFls: implementation-config-variant=VARIANT-PRE-COMPILE, module-description=VTTFls_Impl
    FlsGeneral:
      FlsBaseAddress = 0
      FlsCancelApi = true
      FlsCompareApi = false
      FlsDevErrorDetect = false
      FlsDriverIndex = 0
      FlsGetJobResultApi = true
      FlsGetStatusApi = true
      FlsSetModeApi = false
      FlsTotalSize = 131072
      FlsVersionInfoApi = false
      FlsSafeBswChecks = true
    FlsPublishedInformation: FlsErasedValue=255
    FlsConfigSet: FlsCallCycle=0.01, FlsDefaultMode=MEMIF_MODE_SLOW, FlsMaxReadFastMode=16, FlsMaxReadNormalMode=8, FlsMaxWriteFastMode=16, FlsMaxWriteNormalMode=8
      FlsSectorList
        FlsSector: FlsNumberOfSectors=16, FlsPageSize=8, FlsSectorSize=8192, FlsSectorStartaddress=0
  module config CanTp: implementation-config-variant=VARIANT-PRE-COMPILE, module-description=CanTp_Impl
    CanTpGeneral:
      CanTpSafeBswChecks = true
      CanTpUseOnlyFirstFc = true
      CanTpChangeParameterApi = false
      CanTpDevErrorDetect = true
      CanTpPaddingByte = 204
      CanTpReadParameterApi = false
      CanTpVersionInfoApi = false
      CanTpPaddingActive = true
      CanTpHavePaddingByte = false
      CanTpNumRxChannels = 0
      CanTpNumTxChannels = 0
      CanTpEnableSplitMainFunction = false
      CanTpSupportStandardAddressing = true
      CanTpSupportExtendedAddressing = true
      CanTpSupportMixed11Addressing = true
      CanTpSupportMixed29Addressing = true
      CanTpSupportNormalFixedAddressing = true
      CanTpSupportCustomAddressing = false
      CanTpOnlyNotifyInformedAppl = true
      CanTpRc = false
      CanTpTc = true
      CanTpEnableSynchronousTransmit = true
    CanTpConfig: CanTpMainFunctionPeriod=0.01
      CanTpChannel: CanTpChannelMode=CANTP_MODE_FULL_DUPLEX
        CanTpRxNSdu:
          CanTpNbr = 0.1
          CanTpRxAddressingFormat = CANTP_STANDARD
          CanTpRxNSduId = 0
          CanTpRxPaddingActivation = CANTP_ON
          CanTpRxTaType = CANTP_PHYSICAL
          CanTpRxWftMax = 15
          CanTpSTmin = 0.02
          CanTpNar = 0.1
          CanTpNcr = 0.5
          CanTpBs = 8
          CanTpRxDl = 8
          CanTpRxNSduRef = EcucPduCollection/Diag_Request_Fan_ECU_PDU_96ea3459_Rx
          CanTpRxNPdu: CanTpRxNPduId=0, CanTpRxNPduRef=Comfort_TP_Diag_Request_Fan_ECU_Frame_PDU_c4e708c3_Rx
          CanTpTxFcNPdu: CanTpTxFcNPduConfirmationPduId=0, CanTpTxFcNPduRef=Comfort_TP_Diag_Response_Fan_ECU_Frame_PDU_44cf1fc1_Tx
        CanTpTxNSdu:
          CanTpNas = 0.1
          CanTpNcs = 0.2
          CanTpTc = false
          CanTpTxAddressingFormat = CANTP_STANDARD
          CanTpTxNSduId = 0
          CanTpTxPaddingActivation = CANTP_ON
          CanTpTxTaType = CANTP_PHYSICAL
          CanTpNbs = 0.5
          CanTpTxDl = 8
          CanTpTxNSduRef = EcucPduCollection/Diag_Response_Fan_ECU_PDU_a20a679e_Tx
          CanTpTxNPdu: CanTpTxNPduConfirmationPduId=0, CanTpTxNPduRef=Comfort_TP_Diag_Response_Fan_ECU_Frame_PDU_44cf1fc1_Tx
          CanTpRxFcNPdu: CanTpRxFcNPduId=0, CanTpRxFcNPduRef=Comfort_TP_Diag_Request_Fan_ECU_Frame_PDU_c4e708c3_Rx
  module config MemIf: implementation-config-variant=VARIANT-PRE-COMPILE, module-description=MemIf_Impl
    MemIfGeneral: MemIfSafeBswChecks=true, MemIfDevErrorDetect=true, MemIfVersionInfoApi=false
    MemIfMemHwA: MemIfMemHwAId=0, MemIfMemHwARef=FeeGeneral
  module config Crc: implementation-config-variant=VARIANT-PRE-COMPILE, module-description=Crc_Impl
    CrcGeneral:
      Crc16Mode = CRC_16_RUNTIME
      Crc32Mode = CRC_32_RUNTIME
      Crc8H2FMode = CRC_8H2F_RUNTIME
      Crc8Mode = CRC_8_RUNTIME
      CrcVersionInfoApi = true
      Crc32P4Mode = CRC_32P4_RUNTIME
      Crc64Mode = CRC_64_RUNTIME
  module config Can: implementation-config-variant=VARIANT-PRE-COMPILE, module-description=Can_Impl
    CanGeneral:
      CanIndex = 0
      CanChangeBaudrateApi = false
      CanDevErrorDetection = true
      CanHardwareCancellation = false
      CanIdenticalIdCancellation = false
      CanMainFunctionBusoffPeriod = 0.01
      CanMainFunctionModePeriod = 0.01
      CanMainFunctionWakeupPeriod = 0.01
      CanMultiplexedTransmission = false
      CanSetBaudrateApi = true
      CanTimeoutDuration = 0.01
      CanVersionInfoApi = false
      CanGenericPrecopy = false
      CanHardwareLoopCheck = false
      CanRxFullCANSupport = false
      CanTxFullCANSupport = false
      CanRxBasicCANSupport = true
      CanUseNestedCANInterrupts = false
      CanHardwareCancelByAppl = false
      CanIndividualProcessing = false
      CanGenericConfirmation = false
      CanGenericConfirmationAPI2 = false
      CanRxQueue = false
      CanSupportMixedID = false
      CanRxQueueSize = 10
      CanMultipleBasicCANObjects = false
      CanMultipleBasicCANTxObjects = false
      CanHardwareHandleType = UINT8
      CanOptimizeOneController = true
      CanInterruptCategory = CATEGORY2
      CanGetStatus = false
      CanInterruptLock = DRIVER
      CanWakeupSupport = true
      CanRamCheck = None
      CanOverrunNotification = DET
      CanReinitStart = false
      CanGenericPreTransmit = false
      CanFdSupport = NONE
      CanRuntimeMeasurementSupport = false
      CanMaxRxDataLen = 8
      CanMaxTxDataLen = 8
      CanUsePeripheralAccessApi = false
      CanMirrorModeSupport = false
      CanUseOsInterruptControl = false
      CanSafeBswChecks = false
      CanSilentModeSupport = false
      CanHwTxFifoSupport = false
      CanCheckWakeupCanRetType = false
      CanFdHardwareBufferOptimization = false
      CanEnableSecurityEventReporting = false
      CanCounterRef = Os/SystemTimer
      CanMainFunctionRWPeriods
    CanConfigSet
      Controller_Fan_ECU_02f7c8db915351a9_92c03ed2 (CanController):  # Comfort
        CanBusName = Comfort
        CanControllerActivation = true
        CanBusoffProcessing = INTERRUPT
        CanControllerBaseAddress = 0
        CanControllerId = 0
        CanRxProcessing = INTERRUPT
        CanTxProcessing = INTERRUPT
        CanWakeupProcessing = INTERRUPT
        CanWakeupSupport = true
        CanWakeupSourceId = 32
        CanControllerDefaultBaudrate = Controller_Fan_ECU_02f7c8db915351a9_92c03ed2/CanControllerBaudrateConfig
        CanControllerSystemRef = Controller_Fan_ECU_02f7c8db915351a9
        CanWakeupSourceRef = ECUM_WKSOURCE_CAN
        CanCpuClockRef = McuClockReferencePoint
        CanControllerBaudrateConfig:
          CanControllerBaudRate = 500
          CanControllerBaudRateConfigID = 0
          CanControllerPropSeg = 7
          CanControllerSeg1 = 4
          CanControllerSeg2 = 4
          CanControllerSyncJumpWidth = 1
          CanBaudrateClock = 80000
          CanBaudratePrescaler = 10
          CanSamplingMode = OneSample
        CanFilterMask: CanFilterMaskValue=0, CanFilterCodeValue=0, IsLocked=false
      Connector_Fan_ECU_fbc5880ce1a0cdea_6fd0fec7_Rx (CanHardwareObject):
        CanHandleType = BASIC
        CanIdType = STANDARD
        CanIdValue = 0
        CanObjectType = RECEIVE
        CanObjectId = 1
        CanHwProcessing = false
        CanObjectHwSize = 2
        CanObjectHwHandle = 1
        CanMaxDataLen = 8
        CanFdPaddingValue = 0
        CanObjectMultiplexedTransmission = false
        CanObjectHwFifo = false
        CanControllerRef = CanConfigSet/Controller_Fan_ECU_02f7c8db915351a9_92c03ed2
        CanFilterMaskRef = Controller_Fan_ECU_02f7c8db915351a9_92c03ed2/CanFilterMask
      Connector_Fan_ECU_fbc5880ce1a0cdea_90249745_Tx (CanHardwareObject):
        CanHandleType = BASIC
        CanIdValue = 0
        CanObjectType = TRANSMIT
        CanIdType = STANDARD
        CanObjectId = 0
        CanHwProcessing = false
        CanObjectHwSize = 1
        CanObjectHwHandle = 0
        CanMaxDataLen = 8
        CanFdPaddingValue = 0
        CanObjectMultiplexedTransmission = false
        CanObjectHwFifo = false
        CanControllerRef = CanConfigSet/Controller_Fan_ECU_02f7c8db915351a9_92c03ed2
  module config VTTPwm: implementation-config-variant=VARIANT-PRE-COMPILE, module-description=VTTPwm_Impl
    PwmConfigurationOfOptApiServices: PwmDeInitApi=true, PwmGetOutputState=true, PwmSetDutyCycle=true, PwmSetOutputToIdle=true, PwmSetPeriodAndDuty=true, PwmVersionInfoApi=false
    PwmGeneral: PwmDevErorDetect=true, PwmDutycycleUpdatedEndperiod=true, PwmNotificationSupported=true, PwmPeriodUpdatedEndperiod=true, PwmSafeBswChecks=false
    PwmChannelConfigSet
      PWM_FanMotor (PwmChannel): PwmChannelClass=PWM_FIXED_PERIOD, PwmDutycycleDefault=0, PwmIdleState=PWM_LOW, PwmPeriodDefault=0.01, PwmPolarity=PWM_LOW
