AUTOSAR XML (schema 00050)
package /InitialEcuC
  ecuc value collection InitialEcuC: ecuc-values=[Dcm, Dem]
  module config Dcm: module-description=Dcm_Impl
    DcmConfigSet
      DcmGeneral: DcmResetToFblAfterSessionFinalResponseEnabled=false
      DcmDsd
        DcmDsdServiceTable
          13 x DcmDsdService:
            DiagSessionControl: DcmDsdSidTabServiceId=16, DcmDsdSidTabSubfuncAvail=true
              3 x DcmDsdSubService:
                Default: DcmDsdSubServiceId=1
                Programming: DcmDsdSubServiceId=2
                Extended: DcmDsdSubServiceId=3
            EcuReset: DcmDsdSidTabServiceId=17, DcmDsdSidTabSubfuncAvail=true
              Hard (DcmDsdSubService): DcmDsdSubServiceId=1
              Soft (DcmDsdSubService): DcmDsdSubServiceId=3
            ClearDiagInfo: DcmDsdSidTabServiceId=20, DcmDsdSidTabSubfuncAvail=false
            ReadDtcInfo: DcmDsdSidTabServiceId=25, DcmDsdSidTabSubfuncAvail=true
              14 x DcmDsdSubService:
                RNODTCBSM: DcmDsdSubServiceId=1
                RDTCBSM: DcmDsdSubServiceId=2
                RDTCSSI: DcmDsdSubServiceId=3
                RDTCSSBDTC: DcmDsdSubServiceId=4
                RDTCEDRBDN: DcmDsdSubServiceId=6
                RNODTCBSMR: DcmDsdSubServiceId=7
                RDTCBSMR: DcmDsdSubServiceId=8
                RSIODTC: DcmDsdSubServiceId=9
                RSUPDTC: DcmDsdSubServiceId=10
                RFTFDTC: DcmDsdSubServiceId=11
                RFCDTC: DcmDsdSubServiceId=12
                RMRTFDTC: DcmDsdSubServiceId=13
                RMRCDTC: DcmDsdSubServiceId=14
                RDTCFDC: DcmDsdSubServiceId=20
            ReadDataById: DcmDsdSidTabServiceId=34, DcmDsdSidTabSubfuncAvail=false
            ReadMemoryByAddress: DcmDsdSidTabServiceId=35, DcmDsdSidTabSubfuncAvail=false
            SecurityAccess: DcmDsdSidTabServiceId=39, DcmDsdSidTabSubfuncAvail=true, DcmDsdSidTabSessionLevelRef=DcmDspSession/Programming, DcmDsdSidTabSessionLevelRef=DcmDspSession/Extended
              SeedLevel1_Request (DcmDsdSubService): DcmDsdSubServiceId=1, DcmDsdSubServiceSessionLevelRef=DcmDspSession/Programming, DcmDsdSubServiceSessionLevelRef=DcmDspSession/Extended
              KeyLevel1_Send (DcmDsdSubService): DcmDsdSubServiceId=2, DcmDsdSubServiceSessionLevelRef=DcmDspSession/Programming, DcmDsdSubServiceSessionLevelRef=DcmDspSession/Extended
            CommunicationControl: DcmDsdSidTabServiceId=40, DcmDsdSidTabSubfuncAvail=true, DcmDsdSidTabSessionLevelRef=DcmDspSession/Programming, DcmDsdSidTabSessionLevelRef=DcmDspSession/Extended
              4 x DcmDsdSubService, all with DcmDsdSubServiceSessionLevelRef=DcmDspSession/Programming, DcmDsdSubServiceSessionLevelRef=DcmDspSession/Extended:
                EnableRxAndTx: DcmDsdSubServiceId=0
                EnableRxAndDisableTx: DcmDsdSubServiceId=1
                DisableRxAndEnableTx: DcmDsdSubServiceId=2
                DisableRxAndTx: DcmDsdSubServiceId=3
            WriteDataById: DcmDsdSidTabServiceId=46, DcmDsdSidTabSubfuncAvail=false
            RoutineControl: DcmDsdSidTabServiceId=49, DcmDsdSidTabSubfuncAvail=true, DcmDsdSidTabSessionLevelRef=DcmDspSession/Programming, DcmDsdSidTabSessionLevelRef=DcmDspSession/Extended
            WriteMemoryByAddress: DcmDsdSidTabServiceId=61, DcmDsdSidTabSubfuncAvail=false
            TesterPresent: DcmDsdSidTabServiceId=62, DcmDsdSidTabSubfuncAvail=true
              TesterPresent (DcmDsdSubService): DcmDsdSubServiceId=0
            ControlDtcSetting: DcmDsdSidTabServiceId=133, DcmDsdSidTabSubfuncAvail=true
              Enable (DcmDsdSubService): DcmDsdSubServiceId=1
              Disable (DcmDsdSubService): DcmDsdSubServiceId=2
      DcmDsp: DcmDspMaxDidToRead=5
        Fan_Current_Power_Current (DcmDspData): DcmDspDataSize=8, DcmDspDataType=UINT8, DcmDspDataInfoRef=DataInfo_Fan_Current_Power_Current
        DataInfo_Fan_Current_Power_Current (DcmDspDataInfo): DcmDspDataFixedLength=true
        Example_DevelopmentData_OperatingSystemVersion (DcmDspData): DcmDspDataSize=16, DcmDspDataType=UINT16, DcmDspDataInfoRef=DataInfo_Example_DevelopmentData_OperatingSystemVersion
        DataInfo_Example_DevelopmentData_OperatingSystemVersion (DcmDspDataInfo): DcmDspDataFixedLength=true
        Example_DevelopmentData_CanDriverVersion (DcmDspData): DcmDspDataSize=16, DcmDspDataType=UINT16, DcmDspDataInfoRef=DataInfo_Example_DevelopmentData_CanDriverVersion
        DataInfo_Example_DevelopmentData_CanDriverVersion (DcmDspDataInfo): DcmDspDataFixedLength=true
        Example_DevelopmentData_NmVersion (DcmDspData): DcmDspDataSize=16, DcmDspDataType=UINT16, DcmDspDataInfoRef=DataInfo_Example_DevelopmentData_NmVersion
        DataInfo_Example_DevelopmentData_NmVersion (DcmDspDataInfo): DcmDspDataFixedLength=true
        Example_DevelopmentData_DiagnosticModuleVersion (DcmDspData): DcmDspDataSize=16, DcmDspDataType=UINT16, DcmDspDataInfoRef=DataInfo_Example_DevelopmentData_DiagnosticModuleVersion
        DataInfo_Example_DevelopmentData_DiagnosticModuleVersion (DcmDspDataInfo): DcmDspDataFixedLength=true
        Example_DevelopmentData_TransportLayerVersion (DcmDspData): DcmDspDataSize=16, DcmDspDataType=UINT16, DcmDspDataInfoRef=DataInfo_Example_DevelopmentData_TransportLayerVersion
        DataInfo_Example_DevelopmentData_TransportLayerVersion (DcmDspDataInfo): DcmDspDataFixedLength=true
        Boot_Software_NumberOfModules (DcmDspData): DcmDspDataSize=8, DcmDspDataType=UINT8, DcmDspDataInfoRef=DataInfo_Boot_Software_NumberOfModules
        DataInfo_Boot_Software_NumberOfModules (DcmDspDataInfo): DcmDspDataFixedLength=true
        Boot_Software_Boot_Software_Identification (DcmDspData): DcmDspDataSize=32, DcmDspDataType=UINT32, DcmDspDataInfoRef=DataInfo_Boot_Software_Boot_Software_Identification
        DataInfo_Boot_Software_Boot_Software_Identification (DcmDspDataInfo): DcmDspDataFixedLength=true
        Spare_Part_Number_Spare_Part_Number (DcmDspData): DcmDspDataSize=32, DcmDspDataType=UINT32, DcmDspDataInfoRef=DataInfo_Spare_Part_Number_Spare_Part_Number
        DataInfo_Spare_Part_Number_Spare_Part_Number (DcmDspDataInfo): DcmDspDataFixedLength=true
        EcuIdentification_Part_Number (DcmDspData): DcmDspDataSize=104, DcmDspDataType=UINT8_N, DcmDspDataInfoRef=DataInfo_EcuIdentification_Part_Number
        DataInfo_EcuIdentification_Part_Number (DcmDspDataInfo): DcmDspDataFixedLength=true
        SerialNumber_SerialNumber (DcmDspData): DcmDspDataSize=32, DcmDspDataType=UINT32, DcmDspDataInfoRef=DataInfo_SerialNumber_SerialNumber
        DataInfo_SerialNumber_SerialNumber (DcmDspDataInfo): DcmDspDataFixedLength=true
        Vehicle_Identification_VIN (DcmDspData): DcmDspDataSize=136, DcmDspDataType=UINT8_N, DcmDspDataInfoRef=DataInfo_Vehicle_Identification_VIN
        DataInfo_Vehicle_Identification_VIN (DcmDspDataInfo): DcmDspDataFixedLength=true
        Hardware_Version_Hardware_Version_Number (DcmDspData): DcmDspDataSize=32, DcmDspDataType=UINT32, DcmDspDataInfoRef=DataInfo_Hardware_Version_Hardware_Version_Number
        DataInfo_Hardware_Version_Hardware_Version_Number (DcmDspDataInfo): DcmDspDataFixedLength=true
        8 x DcmDspDid:
          Fan_Current_Power: DcmDspDidIdentifier=2, DcmDspDidInfoRef=DidInfo_Fan_Current_Power
            Current (DcmDspDidSignal): DcmDspDidDataPos=0, DcmDspDidDataRef=Fan_Current_Power_Current
          Example_DevelopmentData: DcmDspDidIdentifier=256, DcmDspDidInfoRef=DidInfo_Example_DevelopmentData
            5 x DcmDspDidSignal:
              OperatingSystemVersion: DcmDspDidDataPos=0, DcmDspDidDataRef=Example_DevelopmentData_OperatingSystemVersion
              CanDriverVersion: DcmDspDidDataPos=16, DcmDspDidDataRef=Example_DevelopmentData_CanDriverVersion
              NmVersion: DcmDspDidDataPos=32, DcmDspDidDataRef=Example_DevelopmentData_NmVersion
              DiagnosticModuleVersion: DcmDspDidDataPos=48, DcmDspDidDataRef=Example_DevelopmentData_DiagnosticModuleVersion
              TransportLayerVersion: DcmDspDidDataPos=64, DcmDspDidDataRef=Example_DevelopmentData_TransportLayerVersion
          Boot_Software: DcmDspDidIdentifier=61824, DcmDspDidInfoRef=DidInfo_Boot_Software
            NumberOfModules (DcmDspDidSignal): DcmDspDidDataPos=0, DcmDspDidDataRef=Boot_Software_NumberOfModules
            Boot_Software_Identification (DcmDspDidSignal): DcmDspDidDataPos=8, DcmDspDidDataRef=Boot_Software_Boot_Software_Identification
          Spare_Part_Number: DcmDspDidIdentifier=61831, DcmDspDidInfoRef=DidInfo_Spare_Part_Number
            Spare_Part_Number (DcmDspDidSignal): DcmDspDidDataPos=0, DcmDspDidDataRef=Spare_Part_Number_Spare_Part_Number
          EcuIdentification: DcmDspDidIdentifier=61833, DcmDspDidInfoRef=DidInfo_EcuIdentification
            Part_Number (DcmDspDidSignal): DcmDspDidDataPos=0, DcmDspDidDataRef=EcuIdentification_Part_Number
          SerialNumber: DcmDspDidIdentifier=61836, DcmDspDidInfoRef=DidInfo_SerialNumber
            SerialNumber (DcmDspDidSignal): DcmDspDidDataPos=0, DcmDspDidDataRef=SerialNumber_SerialNumber
          Vehicle_Identification: DcmDspDidIdentifier=61840, DcmDspDidInfoRef=DidInfo_Vehicle_Identification
            VIN (DcmDspDidSignal): DcmDspDidDataPos=0, DcmDspDidDataRef=Vehicle_Identification_VIN
          Hardware_Version: DcmDspDidIdentifier=61843, DcmDspDidInfoRef=DidInfo_Hardware_Version
            Hardware_Version_Number (DcmDspDidSignal): DcmDspDidDataPos=0, DcmDspDidDataRef=Hardware_Version_Hardware_Version_Number
        8 x DcmDspDidInfo:
          DidInfo_Fan_Current_Power
            DcmDspDidAccess
              DcmDspDidRead
          DidInfo_Example_DevelopmentData
            DcmDspDidAccess
              DcmDspDidRead
              DcmDspDidWrite
          DidInfo_Boot_Software
            DcmDspDidAccess
              DcmDspDidRead
              DcmDspDidWrite
          DidInfo_Spare_Part_Number
            DcmDspDidAccess
              DcmDspDidRead
              DcmDspDidWrite
          DidInfo_EcuIdentification
            DcmDspDidAccess
              DcmDspDidRead
              DcmDspDidWrite
          DidInfo_SerialNumber
            DcmDspDidAccess
              DcmDspDidRead
              DcmDspDidWrite
          DidInfo_Vehicle_Identification
            DcmDspDidAccess
              DcmDspDidRead
              DcmDspDidWrite
          DidInfo_Hardware_Version
            DcmDspDidAccess
              DcmDspDidRead
              DcmDspDidWrite
        Example_New_Routine_Control (DcmDspRoutine):
          DcmDspRequestResultsRoutineSupported = false
          DcmDspStopRoutineSupported = false
          DcmDspRoutineIdentifier = 256
          DcmDspRoutineInfoRef = RoutineInfo_Example_New_Routine_Control
        RoutineInfo_Example_New_Routine_Control (DcmDspRoutineInfo)
          DcmDspRoutineAuthorization: DcmDspRoutineSessionRef=DcmDspSession/Programming, DcmDspRoutineSessionRef=DcmDspSession/Extended
        DcmDspSecurity
          UnlockedL1 (DcmDspSecurityRow):
            DcmDspSecurityDelayTime = 10
            DcmDspSecurityDelayTimeOnBoot = 0
            DcmDspSecurityKeySize = 4
            DcmDspSecurityLevel = 1
            DcmDspSecurityNumAttDelay = 3
            DcmDspSecuritySeedSize = 4
        DcmDspAuthentication: DcmDspAuthenticationRoleSize=1, DcmDspAuthenticationDeauthenticatedRoleRef=Anybody
          6 x DcmDspAuthenticationRow:
            Anybody: DcmDspAuthenticationRoleBitPosition=0
            Supplier: DcmDspAuthenticationRoleBitPosition=1
            Development: DcmDspAuthenticationRoleBitPosition=2
            Manufacturing: DcmDspAuthenticationRoleBitPosition=3
            AfterSales: DcmDspAuthenticationRoleBitPosition=4
            ePTI: DcmDspAuthenticationRoleBitPosition=5
        DcmDspSession
          3 x DcmDspSessionRow, all with DcmDspSessionP2ServerMax=0.05, DcmDspSessionP2StarServerMax=5, DcmDspSessionForBoot=DCM_NO_BOOT:
            Default: DcmDspSessionLevel=1
            Programming: DcmDspSessionLevel=2
            Extended: DcmDspSessionLevel=3
        ComControl (DcmDspComControl)
          DspComContolAllChannel (DcmDspComControlAllChannel)
  module config Dem: module-description=Dem_Impl
    DemConfigSet
      DtcAttributes_41914fb7 (DemDTCAttributes): DemMemoryDestinationRef=PrimaryMemory
      DTCClass_DTC_0x000012 (DemDTCClass): DemDTCSeverity=DEM_DTC_SEV_NO_SEVERITY, DemUdsDTC=17, DemDTCAttributesRef=DtcAttributes_41914fb7
      Electrical_Fault_Fan_Motor_Control_Circuit_Short (DemEventParameter):
        DemEventKind = DEM_EVENT_KIND_SWC
        DemEventLatchTestFailed = true
        DemDTCClassRef = DTCClass_DTC_0x000012
        DemExtendedDataClassRef = ExtendedDataClass_4f5344cd
        DemFreezeFrameClassRef = FreezeFrameClass_e46843e0
        DemFreezeFrameRecNumClassRef = FreezeFrameRecNumClass_f98c8aa7
        DemEventClass:
          DemAgingAllowed = true
          DemAgingCycleCounterThreshold = 0
          DemEventPriority = 2
          DemEventSignificance = DEM_EVENT_SIGNIFICANCE_FAULT
          DemEventFailureCycleCounterThreshold = 0
          DemFFPrestorageSupported = false
          DemAgingCycleRef = OBD_driving_cycle
          DemOperationCycleRef = OBD_driving_cycle
          DemDebounceAlgorithmClass
            DemDebounceTimeBase: DemDebounceTimeFailedThreshold=5, DemDebounceTimePassedThreshold=11, DemDebounceBehavior=DEM_DEBOUNCE_FREEZE
      DTCClass_DTC_0x000013 (DemDTCClass): DemDTCSeverity=DEM_DTC_SEV_NO_SEVERITY, DemUdsDTC=19, DemDTCAttributesRef=DtcAttributes_41914fb7
      Electrical_Fault_Fan_Motor_Control_Circuit_Open (DemEventParameter):
        DemEventKind = DEM_EVENT_KIND_SWC
        DemEventLatchTestFailed = true
        DemDTCClassRef = DTCClass_DTC_0x000013
        DemExtendedDataClassRef = ExtendedDataClass_4f5344cd
        DemFreezeFrameClassRef = FreezeFrameClass_e46843e0
        DemFreezeFrameRecNumClassRef = FreezeFrameRecNumClass_f98c8aa7
        DemEventClass:
          DemAgingAllowed = true
          DemAgingCycleCounterThreshold = 0
          DemEventPriority = 2
          DemEventSignificance = DEM_EVENT_SIGNIFICANCE_FAULT
          DemEventFailureCycleCounterThreshold = 0
          DemFFPrestorageSupported = false
          DemAgingCycleRef = OBD_driving_cycle
          DemOperationCycleRef = OBD_driving_cycle
          DemDebounceAlgorithmClass
            DemDebounceTimeBase: DemDebounceTimeFailedThreshold=5, DemDebounceTimePassedThreshold=11, DemDebounceBehavior=DEM_DEBOUNCE_FREEZE
      DTCClass_DTC_0x000016 (DemDTCClass): DemDTCSeverity=DEM_DTC_SEV_NO_SEVERITY, DemUdsDTC=24, DemDTCAttributesRef=DtcAttributes_41914fb7
      Mechanical_Fault_Unexpected_Low_Current (DemEventParameter):
        DemEventKind = DEM_EVENT_KIND_SWC
        DemEventLatchTestFailed = true
        DemDTCClassRef = DTCClass_DTC_0x000016
        DemExtendedDataClassRef = ExtendedDataClass_4f5344cd
        DemFreezeFrameClassRef = FreezeFrameClass_e46843e0
        DemFreezeFrameRecNumClassRef = FreezeFrameRecNumClass_f98c8aa7
        DemEventClass:
          DemAgingAllowed = true
          DemAgingCycleCounterThreshold = 3
          DemEventPriority = 2
          DemEventSignificance = DEM_EVENT_SIGNIFICANCE_FAULT
          DemEventFailureCycleCounterThreshold = 3
          DemFFPrestorageSupported = false
          DemAgingCycleRef = OBD_driving_cycle
          DemOperationCycleRef = OBD_driving_cycle
          DemDebounceAlgorithmClass
            DemDebounceMonitorInternal
              DemCallbackGetFDC
      DTCClass_DTC_0x000017 (DemDTCClass): DemDTCSeverity=DEM_DTC_SEV_NO_SEVERITY, DemUdsDTC=25, DemDTCAttributesRef=DtcAttributes_41914fb7
      Mechanical_Fault_Unexpected_High_Current (DemEventParameter):
        DemEventKind = DEM_EVENT_KIND_SWC
        DemEventLatchTestFailed = true
        DemDTCClassRef = DTCClass_DTC_0x000017
        DemExtendedDataClassRef = ExtendedDataClass_4f5344cd
        DemFreezeFrameClassRef = FreezeFrameClass_e46843e0
        DemFreezeFrameRecNumClassRef = FreezeFrameRecNumClass_f98c8aa7
        DemEventClass:
          DemAgingAllowed = true
          DemAgingCycleCounterThreshold = 3
          DemEventPriority = 2
          DemEventSignificance = DEM_EVENT_SIGNIFICANCE_FAULT
          DemEventFailureCycleCounterThreshold = 3
          DemFFPrestorageSupported = false
          DemAgingCycleRef = OBD_driving_cycle
          DemOperationCycleRef = OBD_driving_cycle
          DemDebounceAlgorithmClass
            DemDebounceMonitorInternal
              DemCallbackGetFDC
      DTCClass_DTC_0x700006 (DemDTCClass): DemDTCSeverity=DEM_DTC_SEV_NO_SEVERITY, DemUdsDTC=7340038, DemDTCAttributesRef=DtcAttributes_41914fb7
      Algorithm_Fault_Wrong_Input_Speed (DemEventParameter):
        DemEventKind = DEM_EVENT_KIND_SWC
        DemEventLatchTestFailed = true
        DemDTCClassRef = DTCClass_DTC_0x700006
        DemExtendedDataClassRef = ExtendedDataClass_4f5344cd
        DemEventClass:
          DemAgingAllowed = true
          DemAgingCycleCounterThreshold = 0
          DemEventPriority = 2
          DemEventSignificance = DEM_EVENT_SIGNIFICANCE_FAULT
          DemEventFailureCycleCounterThreshold = 0
          DemFFPrestorageSupported = false
          DemAgingCycleRef = OBD_driving_cycle
          DemOperationCycleRef = OBD_driving_cycle
          DemDebounceAlgorithmClass
            DemDebounceMonitorInternal
              DemCallbackGetFDC
    DemGeneral:
      DemAgingCycleCounterProcessing = DEM_PROCESS_AGINGCTR_INTERN
      DemDebounceCounterBasedSupport = true
      DemDebounceTimeBasedSupport = true
      DemPTOSupport = false
      DemDtcStatusAvailabilityMask = 255
      DemEventMemorySet
        PrimaryMemory (DemPrimaryMemory): DemTypeOfFreezeFrameRecordNumeration=DEM_FF_RECNUM_CONFIGURED
      Fan_Current_Power (DemDidClass): DemDidIdentifier=2, DemDidDataClassRef=DID_0x2_Current
      ExtendedDataClass_4f5344cd (DemExtendedDataClass): DemExtendedDataRecordClassRef=OccurrenceCounter, DemExtendedDataRecordClassRef=DTCAgingCounter
      OccurrenceCounter (DemExtendedDataRecordClass): DemExtendedDataRecordNumber=1, DemExtendedDataRecordUpdate=DEM_UPDATE_RECORD_NO, DemDataClassRef=OccurrenceCounter_OccurrenceCounter
      DTCAgingCounter (DemExtendedDataRecordClass):
        DemExtendedDataRecordNumber = 2
        DemExtendedDataRecordUpdate = DEM_UPDATE_RECORD_NO
        DemDataClassRef = DTCAgingCounter_Driving_Cycles_Since_Last_Failed
      FreezeFrameClass_e46843e0 (DemFreezeFrameClass): DemDidClassRef=DemGeneral/Fan_Current_Power
      First_Occurrence (DemFreezeFrameRecordClass): DemFreezeFrameRecordNumber=1, DemFreezeFrameRecordTrigger=DEM_TRIGGER_ON_TEST_FAILED, DemFreezeFrameRecordUpdate=DEM_UPDATE_RECORD_NO
      Last_Occurrence (DemFreezeFrameRecordClass): DemFreezeFrameRecordNumber=2, DemFreezeFrameRecordTrigger=DEM_TRIGGER_ON_TEST_FAILED, DemFreezeFrameRecordUpdate=DEM_UPDATE_RECORD_NO
      FreezeFrameRecNumClass_f98c8aa7 (DemFreezeFrameRecNumClass): DemFreezeFrameRecordClassRef=First_Occurrence, DemFreezeFrameRecordClassRef=Last_Occurrence
      OBD_driving_cycle (DemOperationCycle): DemOperationCycleAutostart=true, DemOperationCycleType=DEM_OPCYC_OBD_DCY
      3 x DemDataClass, all with DemDataElementDataSize=1:
        DID_0x2_Current: DemDataElementDataType=UINT8, DemDataElementUsePort=USE_DATA_CLIENT_SERVER_PORT, DemDataElementStoreNonVolatile=true
        OccurrenceCounter_OccurrenceCounter: DemDataElementInternalData=DEM_OCCCTR, DemDataElementUsePort=USE_DATA_INTERNAL
        DTCAgingCounter_Driving_Cycles_Since_Last_Failed: DemDataElementInternalData=DEM_CYCLES_SINCE_LAST_FAILED, DemDataElementUsePort=USE_DATA_INTERNAL
      DemGeneralOBD
