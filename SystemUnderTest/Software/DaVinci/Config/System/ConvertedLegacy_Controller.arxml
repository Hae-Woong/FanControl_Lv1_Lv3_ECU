AUTOSAR XML (schema 00048)
# Copyright (c) 2018 Vector Informatik GmbH.
standard types defined: boolean, float32
package /VehicleProject
  system System
package /NM
  nm config NmConfig: can-nm-cluster-coupling=coupled-cluster=CAN00_CAN
    can nm cluster CAN00_CAN: communication-cluster=CAN00, nm-channel-id=0, nm-msg-cycle-time=0.1, nm-network-timeout=1, nm-repeat-message-time=0.4, nm-wait-bus-sleep-time=0.75
      can nm node Controller: controller=CT_CAN00, nm-if-ecu=Controller_CAN, nm-node-id=2, tx-nm-pdu=NmController_oCAN00, nm-msg-cycle-offset=0, nm-msg-reduced-time=0.05, nm-range-config={lower-can-id=1024, upper-can-id=1087}
      can nm node Fan: nm-if-ecu=Fan_CAN, nm-node-id=3, nm-msg-cycle-offset=0, nm-msg-reduced-time=0.05, nm-range-config={lower-can-id=1024, upper-can-id=1087}
      can nm node HeadUnit: nm-if-ecu=HeadUnit_CAN, nm-node-id=1, nm-msg-cycle-offset=0, nm-msg-reduced-time=0.05, nm-range-config={lower-can-id=1024, upper-can-id=1087}
    nm-if-ecus:
      nm ecu Controller_CAN: ecu-instance=Controller, nm-node-id-enabled=false, nm-user-data-enabled=true
      nm ecu Fan_CAN: nm-node-id-enabled=false, nm-user-data-enabled=true
      nm ecu HeadUnit_CAN: nm-node-id-enabled=false, nm-user-data-enabled=true
package /Cluster
  can cluster CAN00: baudrate=500000, protocol-name=CAN
    can physical channel CHNL: comm-connectors=CN_CAN00
      frame Des_Speed_oCAN00: id 0x268, from Controller, frame-length=4, can-addressing-mode=STANDARD
        pdu Des_Speed_oCAN00: length=4, minimum-delay=0, transmission-mode-false-timing=cyclic-timing={time-offset=0, time-period=0.01}, transmission-mode-true-timing=cyclic-timing={time-offset=0, time-period=0.01}, unused-bit-pattern=0
          signal Des_Speed_oDes_Speed_oCAN00: start 0, 32 bit, little-endian, i-signal-type=PRIMITIVE, init-value=0, base-type=float32, compu {identical}, range raw 0..INF, transfer-property=PENDING
      frame Health_oCAN00: id 0x278, from Controller, frame-length=8, can-addressing-mode=STANDARD
        pdu Health_oCAN00: length=8, minimum-delay=0, transmission-mode-false-timing=cyclic-timing={time-offset=0, time-period=0.01}, transmission-mode-true-timing=cyclic-timing={time-offset=0, time-period=0.01}, unused-bit-pattern=0
          signal Health_oHealth_oCAN00: start 0, 1 bit, little-endian, i-signal-type=PRIMITIVE, init-value=0, base-type=boolean, compu {0=Cx0_healthy, 1=Cx1_faulty}, range raw 0..1, transfer-property=PENDING
      frame Meas_Speed_oCAN00: id 0x269, to Controller, frame-length=8, can-addressing-mode=STANDARD
        pdu Meas_Speed_oCAN00: length=8, minimum-delay=0, transmission-mode-false-timing=cyclic-timing={time-offset=0, time-period=0.01}, transmission-mode-true-timing=cyclic-timing={time-offset=0, time-period=0.01}, unused-bit-pattern=0
          signal Meas_Speed_oMeas_Speed_oCAN00: start 0, 32 bit, little-endian, i-signal-type=PRIMITIVE, init-value=0, base-type=float32, compu {identical}, range raw 0..INF, transfer-property=PENDING, to Controller
      frame NmController_oCAN00: id 0x402, from Controller, frame-length=8, can-addressing-mode=STANDARD
        nm pdu NmController_oCAN00: length=8, unused-bit-pattern=0
      frame Power_oCAN00: id 0x210, to Controller, frame-length=4, can-addressing-mode=STANDARD
        pdu Power_oCAN00: length=4, minimum-delay=0, transmission-mode-false-timing=cyclic-timing={time-offset=0, time-period=0.1}, transmission-mode-true-timing=cyclic-timing={time-offset=0, time-period=0.1}, unused-bit-pattern=0
          signal Power_oPower_oCAN00: start 0, 32 bit, little-endian, i-signal-type=PRIMITIVE, init-value=0, base-type=float32, compu {identical}, range raw -INF..INF, transfer-property=PENDING, to Controller
      frame PWM_oCAN00: id 0x209, from Controller, frame-length=4, can-addressing-mode=STANDARD
        pdu PWM_oCAN00: length=4, minimum-delay=0, transmission-mode-false-timing=cyclic-timing={time-offset=0, time-period=0.01}, transmission-mode-true-timing=cyclic-timing={time-offset=0, time-period=0.01}, unused-bit-pattern=0
          signal PWM_oPWM_oCAN00: start 0, 32 bit, little-endian, i-signal-type=PRIMITIVE, init-value=0, base-type=float32, compu {identical}, range raw -INF..INF, transfer-property=PENDING
package /ECU
  ecu instance Controller: associated-com-i-pdu-group=[Controller_oCAN00_Rx, Controller_oCAN00_Tx]
    can communication controller CT_CAN00
    can communication connector CN_CAN00: comm-controller=CT_CAN00
package /IPDUGroup
  i signal i pdu group Controller_oCAN00_Rx: communication-direction=IN, i-signal-i-pdus=[Meas_Speed_oCAN00, Power_oCAN00]
  i signal i pdu group Controller_oCAN00_Tx: communication-direction=OUT, i-signal-i-pdus=[Des_Speed_oCAN00, Health_oCAN00, PWM_oCAN00]
