VERSION ""

NS_ :

BS_:

BU_: Fan HeadUnit Controller

BO_ 1025 NmHeadUnit: 8 HeadUnit

BO_ 1027 NmFan: 8 Fan

BO_ 1026 NmController: 8 Controller

BO_ 632 Health: 8 Controller
 SG_ Health : 0|1@1+ (1,0) [0|1] ""  HeadUnit

BO_ 617 Meas_Speed: 8 Fan
 SG_ Meas_Speed : 0|32@1- (1,0) [0|3.4E+038] ""  Controller

BO_ 521 PWM: 4 Controller
 SG_ PWM : 0|32@1- (1,0) [-3.4E+038|3.4E+038] ""  Fan

BO_ 616 Des_Speed: 4 Controller
 SG_ Des_Speed : 0|32@1- (1,0) [0|3.4E+038] ""  Fan

BO_ 528 Power: 4 HeadUnit
 SG_ Power : 0|32@1- (1,0) [-3.4E+038|3.4E+038] ""  Controller

BA_DEF_ BU_  "NodeLayerModules" STRING ;
BA_DEF_ BO_  "GenMsgCycleTime" INT 0 0;
BA_DEF_ BO_  "GenMsgSendType" ENUM  "Cyclic","NotUsed","NotUsed","NotUsed","NotUsed","NotUsed","NotUsed","NotUsed","NoMsgSendType";
BA_DEF_ SG_  "GenSigCycleTime" INT 0 0;
BA_DEF_ SG_  "GenSigSendType" ENUM  "Cyclic","OnWrite","NotUsed","OnChange","NotUsed","NotUsed","NotUsed","NoSigSendType";
BA_DEF_  "Baudrate" INT 0 1000000;
BA_DEF_  "BusType" STRING ;
BA_DEF_  "NmType" STRING ;
BA_DEF_  "Manufacturer" STRING ;
BA_DEF_  "NmAsrWaitBusSleepTime" INT 0 65535;
BA_DEF_  "NmAsrTimeoutTime" INT 0 65535;
BA_DEF_  "NmAsrRepeatMessageTime" INT 0 65535;
BA_DEF_ BU_  "NmAsrNode" ENUM  "no","yes";
BA_DEF_  "NmAsrMessageCount" INT 0 256;
BA_DEF_ BO_  "NmAsrMessage" ENUM  "no","yes";
BA_DEF_ BU_  "NmAsrCanMsgReducedTime" INT 0 65535;
BA_DEF_  "NmAsrCanMsgCycleTime" INT 0 65535;
BA_DEF_  "NmAsrBaseAddress" HEX 0 65535;
BA_DEF_ BU_  "ILUsed" ENUM  "no","yes";
BA_DEF_ BO_  "GenMsgILSupport" ENUM  "no","yes";
BA_DEF_DEF_  "NodeLayerModules" "CANoeILNLVector.dll";
BA_DEF_DEF_  "GenMsgCycleTime" 0;
BA_DEF_DEF_  "GenMsgSendType" "NoMsgSendType";
BA_DEF_DEF_  "GenSigCycleTime" 0;
BA_DEF_DEF_  "GenSigSendType" "Cyclic";
BA_DEF_DEF_  "Baudrate" 500000;
BA_DEF_DEF_  "BusType" "";
BA_DEF_DEF_  "NmType" "";
BA_DEF_DEF_  "Manufacturer" "Vector";
BA_DEF_DEF_  "NmAsrWaitBusSleepTime" 750;
BA_DEF_DEF_  "NmAsrTimeoutTime" 1000;
BA_DEF_DEF_  "NmAsrRepeatMessageTime" 400;
BA_DEF_DEF_  "NmAsrNode" "yes";
BA_DEF_DEF_  "NmAsrMessageCount" 64;
BA_DEF_DEF_  "NmAsrMessage" "no";
BA_DEF_DEF_  "NmAsrCanMsgReducedTime" 50;
BA_DEF_DEF_  "NmAsrCanMsgCycleTime" 100;
BA_DEF_DEF_  "NmAsrBaseAddress" 1024;
BA_DEF_DEF_  "ILUsed" "yes";
BA_DEF_DEF_  "GenMsgILSupport" "yes";
BA_ "BusType" "CAN";
BA_ "NmType" "NmAsr";
BA_ "NmAsrMessage" BO_ 1025 1;
BA_ "GenMsgSendType" BO_ 1025 0;
BA_ "GenMsgCycleTime" BO_ 1025 10;
BA_ "NmAsrMessage" BO_ 1027 1;
BA_ "GenMsgSendType" BO_ 1027 0;
BA_ "GenMsgCycleTime" BO_ 1027 10;
BA_ "NmAsrMessage" BO_ 1026 1;
BA_ "GenMsgSendType" BO_ 1026 0;
BA_ "GenMsgCycleTime" BO_ 1026 10;
BA_ "GenMsgCycleTime" BO_ 632 10;
BA_ "GenMsgSendType" BO_ 632 0;
BA_ "GenMsgCycleTime" BO_ 617 10;
BA_ "GenMsgSendType" BO_ 617 0;
BA_ "GenMsgSendType" BO_ 521 0;
BA_ "GenMsgCycleTime" BO_ 521 10;
BA_ "GenMsgCycleTime" BO_ 616 10;
BA_ "GenMsgSendType" BO_ 616 0;
BA_ "GenMsgCycleTime" BO_ 528 100;
BA_ "GenMsgSendType" BO_ 528 0;
BA_ "GenSigCycleTime" SG_ 632 Health 10;
BA_ "GenSigCycleTime" SG_ 617 Meas_Speed 10;
BA_ "GenSigCycleTime" SG_ 521 PWM 10;
BA_ "GenSigCycleTime" SG_ 616 Des_Speed 10;
BA_ "GenSigCycleTime" SG_ 528 Power 10;
VAL_ 632 Health 0 "healthy" 1 "faulty" ;
SIG_VALTYPE_ 617 Meas_Speed : 1;
SIG_VALTYPE_ 521 PWM : 1;
SIG_VALTYPE_ 616 Des_Speed : 1;
SIG_VALTYPE_ 528 Power : 1;
