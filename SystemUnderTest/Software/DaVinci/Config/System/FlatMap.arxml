AUTOSAR XML (schema 00050)
package /COM/VECTOR/CFG/WORKFLOW/SYSDESC/SYNC
  flat map FLATMAP
    9 x flat instance descriptor:
      CpCddIoHwAb: upstream-reference=EcuSwComposition.CpCddIoHwAb, ecu-extract-reference=COMPOSITIONTYPE.CpCddIoHwAb
      CpApController: upstream-reference=EcuSwComposition.CpApController, ecu-extract-reference=COMPOSITIONTYPE.CpApController
      Signal_Fan_Fault_f777c54e31a89d5c: upstream-reference=EcuSwComposition.PpFault.DeFault, ecu-extract-reference=COMPOSITIONTYPE.PpFault.DeFault
      PpFault: upstream-reference=EcuSwComposition.PpFault, ecu-extract-reference=COMPOSITIONTYPE.PpFault
      Signal_Fan_Setpoint_7226b1dfc825beac: upstream-reference=EcuSwComposition.PpSpeed.DeSpeed, ecu-extract-reference=COMPOSITIONTYPE.PpSpeed.DeSpeed
      PpSpeed: upstream-reference=EcuSwComposition.PpSpeed, ecu-extract-reference=COMPOSITIONTYPE.PpSpeed
      CpApControllerSnNvMPimFanCurrentDid: upstream-reference=COMPOSITIONTYPE.CpApController.SnNvMPimFanCurrentDid
      Signal_Comfort_DrivingCycle_d5cecd98dc1c368d: upstream-reference=EcuSwComposition.PpOBDdrivingCycle.DeOBDdrivingCycle, ecu-extract-reference=COMPOSITIONTYPE.PpOBDdrivingCycle.DeOBDdrivingCycle
      PpOBDdrivingCycle: upstream-reference=EcuSwComposition.PpOBDdrivingCycle, ecu-extract-reference=COMPOSITIONTYPE.PpOBDdrivingCycle
