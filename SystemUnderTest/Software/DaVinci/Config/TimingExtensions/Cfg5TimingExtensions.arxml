AUTOSAR XML (schema 00050)
package /COM/VECTOR/CFG/TimingExtensions
  ecu timing Cfg5TimingExtension
