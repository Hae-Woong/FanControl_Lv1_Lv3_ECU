AUTOSAR XML (schema 00050)
package /MICROSAR/Dem_ib_bswmd/BswModuleDescriptions
  bsw module description Dem: provided-entrys=[Dem_MasterMainFunction, Dem_SatelliteMainFunction]
    bsw internal behavior DemBehavior
      5 x exclusive area:
        DEM_EXCLUSIVE_AREA_0  # (DiagMonitor) Ensures consistency and atomicity of event reports
        DEM_EXCLUSIVE_AREA_1  # (StateManager) Ensures consistent status updates when receiving ECU states managed outside the Dem
        DEM_EXCLUSIVE_AREA_2  # (DcmAPI) Ensures consistent status updates when receiving ECU states managed outside the Dem
        DEM_EXCLUSIVE_AREA_3  # (CrossCoreComm) Ensures consistent prestorage when called from multiple clients. Ensures data consistency between satellites and master if the platform does not provide a specific compareAndSwap instruction
        DEM_EXCLUSIVE_AREA_4  # (NonAtomic32bit) Ensures consistency if the platform does not provide an atomic 32bit access
      bsw schedulable entity Dem_MasterMainFunction: can-enter-exclusive-area=[DEM_EXCLUSIVE_AREA_0, DEM_EXCLUSIVE_AREA_1, DEM_EXCLUSIVE_AREA_2, DEM_EXCLUSIVE_AREA_3, DEM_EXCLUSIVE_AREA_4], implemented-entry=Dem_MasterMainFunction
      bsw schedulable entity Dem_SatelliteMainFunction: can-enter-exclusive-area=[DEM_EXCLUSIVE_AREA_0, DEM_EXCLUSIVE_AREA_1, DEM_EXCLUSIVE_AREA_2, DEM_EXCLUSIVE_AREA_3, DEM_EXCLUSIVE_AREA_4], implemented-entry=Dem_SatelliteMainFunction
      bsw timing event Dem_MasterMainFunctionTimingEvent0: starts-on-event=Dem_MasterMainFunction, period=0.01
      bsw timing event Dem_SatelliteMainFunctionTimingEvent0: starts-on-event=Dem_SatelliteMainFunction, period=0.01
  bsw module entry Dem_MasterMainFunction: call-type=SCHEDULED, execution-context=TASK
  bsw module entry Dem_SatelliteMainFunction: call-type=SCHEDULED, execution-context=TASK
