AUTOSAR XML (schema 00048)
package /MICROSAR/Can_CanoeemuCanoe_ib_bswmd/BswModuleDescriptions
  bsw module description Can: provided-entrys=[Can_MainFunction_BusOff, Can_MainFunction_Wakeup, Can_MainFunction_Mode]
    bsw internal behavior Can_CanoeemuCanoeBehavior
      8 x exclusive area:
        CAN_EXCLUSIVE_AREA_{0..7}
      bsw schedulable entity Can_MainFunction_BusOff: can-enter-exclusive-area=[CAN_EXCLUSIVE_AREA_0, CAN_EXCLUSIVE_AREA_1, CAN_EXCLUSIVE_AREA_2, CAN_EXCLUSIVE_AREA_3, CAN_EXCLUSIVE_AREA_4, CAN_EXCLUSIVE_AREA_5, CAN_EXCLUSIVE_AREA_6, CAN_EXCLUSIVE_AREA_7], implemented-entry=Can_MainFunction_BusOff
      bsw schedulable entity Can_MainFunction_Wakeup: can-enter-exclusive-area=[CAN_EXCLUSIVE_AREA_0, CAN_EXCLUSIVE_AREA_1, CAN_EXCLUSIVE_AREA_2, CAN_EXCLUSIVE_AREA_3, CAN_EXCLUSIVE_AREA_4, CAN_EXCLUSIVE_AREA_5, CAN_EXCLUSIVE_AREA_6, CAN_EXCLUSIVE_AREA_7], implemented-entry=Can_MainFunction_Wakeup
      bsw schedulable entity Can_MainFunction_Mode: can-enter-exclusive-area=[CAN_EXCLUSIVE_AREA_0, CAN_EXCLUSIVE_AREA_1, CAN_EXCLUSIVE_AREA_2, CAN_EXCLUSIVE_AREA_3, CAN_EXCLUSIVE_AREA_4, CAN_EXCLUSIVE_AREA_5, CAN_EXCLUSIVE_AREA_6, CAN_EXCLUSIVE_AREA_7], implemented-entry=Can_MainFunction_Mode
      bsw timing event Can_MainFunction_BusOffTimingEvent0: starts-on-event=Can_MainFunction_BusOff, period=0.01
      bsw timing event Can_MainFunction_WakeupTimingEvent0: starts-on-event=Can_MainFunction_Wakeup, period=0.01
      bsw timing event Can_MainFunction_ModeTimingEvent0: starts-on-event=Can_MainFunction_Mode, period=0.01
  bsw module entry Can_MainFunction_BusOff: call-type=SCHEDULED, execution-context=TASK
  bsw module entry Can_MainFunction_Wakeup: call-type=SCHEDULED, execution-context=TASK
  bsw module entry Can_MainFunction_Mode: call-type=SCHEDULED, execution-context=TASK
