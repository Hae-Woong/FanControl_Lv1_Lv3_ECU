AUTOSAR XML (schema 00050)
package /MICROSAR
  bsw implementation CanTp_Impl: programming-language=C, sw-version=5.01.00, used-code-generator=DaVinci Configurator, vendor-id=30, ar-release-version=4.00.03
package /MICROSAR/CanTp_ib_bswmd/BswModuleDescriptions
  bsw module description CanTp: provided-entrys=CanTp_MainFunction
    bsw internal behavior CanTpBehavior
      exclusive area CANTP_EXCLUSIVE_AREA_0
      bsw schedulable entity CanTp_MainFunction: can-enter-exclusive-area=CANTP_EXCLUSIVE_AREA_0, implemented-entry=CanTp_MainFunction
      bsw timing event CanTp_MainFunctionTimingEvent0: starts-on-event=CanTp_MainFunction, period=0.01
  bsw module entry CanTp_MainFunction: call-type=SCHEDULED, execution-context=TASK
