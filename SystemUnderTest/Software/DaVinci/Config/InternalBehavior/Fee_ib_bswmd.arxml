AUTOSAR XML (schema 00050)
package /MICROSAR
  bsw implementation Fee_Impl: programming-language=C, sw-version=10.00.04, used-code-generator=DaVinci Configurator, vendor-id=30, ar-release-version=4.00.03
package /MICROSAR/Fee_ib_bswmd/BswModuleDescriptions
  bsw module description Fee: provided-entrys=Fee_MainFunction
    bsw internal behavior FeeBehavior
      exclusive area FEE_EXCLUSIVE_AREA_0
      bsw schedulable entity Fee_MainFunction: can-enter-exclusive-area=FEE_EXCLUSIVE_AREA_0, implemented-entry=Fee_MainFunction
      bsw timing event Fee_MainFunctionTimingEvent0: starts-on-event=Fee_MainFunction, period=0.005
  bsw module entry Fee_MainFunction: call-type=SCHEDULED, execution-context=TASK
