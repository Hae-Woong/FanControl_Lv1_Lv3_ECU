AUTOSAR XML (schema 00050)
package /MICROSAR
  bsw implementation SomeIpXf_Impl: programming-language=C, sw-version=4.31.00, used-code-generator=DaVinci Configurator, vendor-id=30, ar-release-version=4.03.01
