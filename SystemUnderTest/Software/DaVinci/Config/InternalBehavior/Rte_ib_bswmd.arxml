AUTOSAR XML (schema 00050)
package /MICROSAR
  bsw implementation Rte_Impl: programming-language=C, sw-version=4.31.00, used-code-generator=DaVinci Configurator, vendor-id=30, ar-release-version=4.03.01
    resource consumption ResourceConsumption
      24 x memory section:
        CODE: sw-addrmethod=CODE
        VAR_NOINIT_UNSPECIFIED: sw-addrmethod=VAR_NO_INIT
        VAR_ZERO_INIT_UNSPECIFIED: sw-addrmethod=VAR_CLEARED
        VAR_ZERO_INIT_8BIT: sw-addrmethod=VAR_CLEARED
        VAR_INIT_UNSPECIFIED: sw-addrmethod=VAR_INIT
        CONST_UNSPECIFIED: sw-addrmethod=CONST
        APPL_CODE: sw-addrmethod=CODE
        IDLETASK_OSCORE0_CODE: sw-addrmethod=CODE
        INIT_TASK_CODE: sw-addrmethod=CODE
        MAIN_TASK_CODE: sw-addrmethod=CODE
        RTE_TASK_CODE: sw-addrmethod=CODE
        IO_TASK_CODE: sw-addrmethod=CODE
        SPEEDTASK_CODE: sw-addrmethod=CODE
        BSWM_APPL_CODE: sw-addrmethod=CODE
        COMM_APPL_CODE: sw-addrmethod=CODE
        CTAPCONTROLLER_APPL_CODE: sw-addrmethod=CODE
        CTCDDIOHWAB_APPL_CODE: sw-addrmethod=CODE
        DCM_APPL_CODE: sw-addrmethod=CODE
        DEMMASTER_0_APPL_CODE: sw-addrmethod=CODE
        DEMSATELLITE_0_APPL_CODE: sw-addrmethod=CODE
        DET_APPL_CODE: sw-addrmethod=CODE
        ECUM_APPL_CODE: sw-addrmethod=CODE
        NVM_APPL_CODE: sw-addrmethod=CODE
        VAR_DEFAULT_RTE_PIM_GROUP_UNSPECIFIED: sw-addrmethod=VAR_NO_INIT
package /MICROSAR/Rte_ib_bswmd/BswModuleDescriptions
  bsw module description Rte
    bsw internal behavior RteBehavior
