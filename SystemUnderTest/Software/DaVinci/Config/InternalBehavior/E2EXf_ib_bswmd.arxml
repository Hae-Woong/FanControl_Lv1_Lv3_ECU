AUTOSAR XML (schema 00048)
package /MICROSAR
  bsw implementation E2EXf_Impl: programming-language=C, sw-version=4.31.00, used-code-generator=DaVinci Configurator, vendor-id=30, ar-release-version=4.03.01
